AUTOSAR XML (schema 00049)
package /ServiceDeployment/Someip
  19 x someip service interface deployment, all with service-interface-version={major-version=1, minor-version=0}:
    SoaDriverSeat: service-interface=SoaDriverSeat, service-interface-id=4946
      4 x someip field deployment:
        soaDrvSeatDeviceNormal: field=soaDrvSeatDeviceNormal
          get Get_soaDrvSeatDeviceNormal: method-id=1, transport-protocol=UDP
          notifier Notification_soaDrvSeatDeviceNormal: event-id=16385, transport-protocol=UDP
        soaDrvSeatMotorDirection: field=soaDrvSeatMotorDirection
          get Get_soaDrvSeatMotorDirection: method-id=2, transport-protocol=UDP
          notifier Notify_soaDrvSeatMotorDirection: event-id=16386, transport-protocol=UDP
        soaDrvSeatMotorPosition: field=soaDrvSeatMotorPosition
          get Get_soaDrvSeatMotorPosition: method-id=3, transport-protocol=UDP
          notifier Notify_soaDrvSeatMotorPosition: event-id=16387, transport-protocol=UDP
        soaDrvSeatSwVersion: field=soaDrvSeatSwVersion
          get Get_soaDrvSeatSwVersion: method-id=4, transport-protocol=UDP
          notifier Notify_soaDrvSeatSwVersion: event-id=16388, transport-protocol=UDP
      4 x someip method deployment, all with transport-protocol=UDP:
        RequestMoveDrvSeatHeight: method=RequestMoveDrvSeatHeight, method-id=16387
        RequestMoveDrvSeatRecline: method=RequestMoveDrvSeatRecline, method-id=16386
        RequestMoveDrvSeatSlide: method=RequestMoveDrvSeatSlide, method-id=16385
        RequestMoveDrvSeatTilt: method=RequestMoveDrvSeatTilt, method-id=16388
      4 x someip event group:
        Eventgroup_Notification_soaDrvSeatDeviceNormal: event-group-id=8705, event=Notification_soaDrvSeatDeviceNormal
        Eventgroup_Notification_soaDrvSeatMotorDirection: event-group-id=8706, event=Notify_soaDrvSeatMotorDirection
        Eventgroup_Notification_soaDrvSeatMotorPosition: event-group-id=8707, event=Notify_soaDrvSeatMotorPosition
        Eventgroup_Notification_soaDrvSeatSwVersion: event-group-id=8708, event=Notify_soaDrvSeatSwVersion
    SoaMlm: service-interface=SoaMlm, service-interface-id=4945
      someip field deployment soaMlmStatus: field=soaMlmStatus
        get Get_soaMlmStatus: method-id=1, transport-protocol=UDP
        notifier Notification_soaMlmStatus: event-id=16385, transport-protocol=UDP
      someip field deployment soaMlmSwVersion: field=soaMlmSwVersion
        get Get_soaMlmSwVersion: method-id=2, transport-protocol=UDP
        notifier Notify_soaMlmSwVersion: event-id=16386, transport-protocol=UDP
      someip method deployment RequestMlmSetBrightness: method=RequestMlmSetBrightness, method-id=16387, transport-protocol=UDP
      someip method deployment RequestMlmSetMode: method=RequestMlmSetMode, method-id=16386, transport-protocol=UDP
      someip method deployment RequestMlmSetRgbColor: method=RequestMlmSetRgbColor, method-id=16385, transport-protocol=UDP
      someip event group Eventgroup_Notification_soaMlmStatus: event-group-id=8705, event=Notification_soaMlmStatus
      someip event group Eventgroup_Notification_soaMlmSwVersion: event-group-id=8706, event=Notify_soaMlmSwVersion
    SoaPower: service-interface=SoaPower, service-interface-id=4944
      someip field deployment soaPowerDeviceNormal: field=soaPowerDeviceNormal
        get Get_soaPowerDeviceNormal: method-id=1, transport-protocol=UDP
        notifier Notify_soaPowerDeviceNormal: event-id=16385, transport-protocol=UDP
      someip field deployment soaPowerSwVersion: field=soaPowerSwVersion
        get Get_soaPowerSwVersion: method-id=2, transport-protocol=UDP
        notifier Notify_soaPowerSwVersion: event-id=16386, transport-protocol=UDP
      someip event group Eventgroup_Notification_soaPowerDeviceNormal: event-group-id=8193, event=Notify_soaPowerDeviceNormal
      someip event group Eventgroup_Notify_soaPowerSwVersion: event-group-id=8194, event=Notify_soaPowerSwVersion
    SoaRcurtain: service-interface=SoaRcurtain, service-interface-id=4948
      someip field deployment soaRctnStatus: field=soaRctnStatus
        get Get_soaRctnStatus: method-id=1, transport-protocol=UDP
        notifier Notification_soaRctnStatus: event-id=16385, transport-protocol=UDP
      someip field deployment soaRctnSwVersion: field=soaRctnSwVersion
        get Get_soaRctnSwVersion: method-id=2, transport-protocol=UDP
        notifier Notify_soaRctnSwVersion: event-id=16386, transport-protocol=UDP
      someip method deployment RequestRearCurtainOperation: method=RequestRearCurtainOperation, method-id=16385, transport-protocol=UDP
      someip method deployment RequestRearCurtainPosition: method=RequestRearCurtainPosition, method-id=16386, transport-protocol=UDP
      someip event group Eventgroup_Notification_soaRctnStatus: event-group-id=8705, event=Notification_soaRctnStatus
      someip event group Eventgroup_Notification_soaRctnSwVersion: event-group-id=8706, event=Notify_soaRctnSwVersion
    SoaRoa: service-interface=SoaRoa, service-interface-id=4947
      7 x someip field deployment:
        soaRoaDetectCount: field=soaRoaDetectCount
          get Get_soaRoaDetectCount: method-id=5, transport-protocol=UDP
          notifier Notify_soaRoaDetectCount: event-id=16389, transport-protocol=UDP
        soaRoaDetectState: field=soaRoaDetectState
          get Get_soaRoaDetectState: method-id=4, transport-protocol=UDP
          notifier Notify_soaRoaDetectState: event-id=16388, transport-protocol=UDP
        soaRoaDeviceNormal: field=soaRoaDeviceNormal
          get Get_soaRoaDeviceNormal: method-id=1, transport-protocol=UDP
          notifier Notify_soaRoaDeviceNormal: event-id=16385, transport-protocol=UDP
        soaRoaMode: field=soaRoaMode
          get Get_soaRoaMode: method-id=3, transport-protocol=UDP
          notifier Notify_soaRoaMode: event-id=16387, transport-protocol=UDP
        soaRoaRunningState: field=soaRoaRunningState
          get Get_soaRoaRunningState: method-id=2, transport-protocol=UDP
          notifier Notify_soaRoaRunningState: event-id=16386, transport-protocol=UDP
        soaRoaSensorError: field=soaRoaSensorError
          get Get_soaRoaSensorError: method-id=6, transport-protocol=UDP
          notifier Notify_soaRoaSensorError: event-id=16390, transport-protocol=UDP
        soaRoaSwVersion: field=soaRoaSwVersion
          get Get_soaRoaSwVersion: method-id=7, transport-protocol=UDP
          notifier Notify_soaRoaSwVersion: event-id=16391, transport-protocol=UDP
      4 x someip method deployment, all with transport-protocol=UDP:
        ResetRoaDetectInfo: method=ResetRoaDetectInfo, method-id=16387
        SetRoaMode: method=SetRoaMode, method-id=16388
        StartRoa: method=StartRoa, method-id=16385
        StopRoa: method=StopRoa, method-id=16386
      7 x someip event group:
        Eventgroup3_Notification_soaRoaDetectState: event-group-id=8708, event=Notify_soaRoaDetectState
        Eventgroup_Notification_soaRoaDetectCount: event-group-id=8709, event=Notify_soaRoaDetectCount
        Eventgroup_Notification_soaRoaDeviceNormal: event-group-id=8705, event=Notify_soaRoaDeviceNormal
        Eventgroup_Notification_soaRoaMode: event-group-id=8707, event=Notify_soaRoaMode
        Eventgroup_Notification_soaRoaRunningState: event-group-id=8706, event=Notify_soaRoaRunningState
        Eventgroup_Notification_soaRoaSensorError: event-group-id=8710, event=Notify_soaRoaSensorError
        Eventgroup_Notification_soaRoaSwVersion: event-group-id=8711, event=Notify_soaRoaSwVersion
    SoaWiper: service-interface=SoaWiper, service-interface-id=4949
      someip field deployment soaWiperDeviceNormal: field=soaWiperDeviceNormal
        get Get_soaWiperDeviceNormal: method-id=1, transport-protocol=UDP
        notifier Notify_soaWiperDeviceNormal: event-id=16385, transport-protocol=UDP
      someip field deployment soaWiperStatus: field=soaWiperStatus
        get Get_soaWiperStatus: method-id=2, transport-protocol=UDP
        notifier Notify_soaWiperStatus: event-id=16386, transport-protocol=UDP
      someip field deployment soaWiperSwVersion: field=soaWiperSwVersion
        get Get_soaWiperSwVersion: method-id=3, transport-protocol=UDP
        notifier Notify_soaWiperSwVersion: event-id=16387, transport-protocol=UDP
      someip method deployment RequestWiperOperation: method=RequestWiperOperation, method-id=16386, transport-protocol=UDP
      someip method deployment SetWiperAutoSpeed: method=SetWiperAutoSpeed, method-id=16385, transport-protocol=UDP
      someip event group Eventgroup_Notification_soaWiperDeviceNormal: event-group-id=8705, event=Notify_soaWiperDeviceNormal
      someip event group Eventgroup_Notification_soaWiperStatus: event-group-id=8706, event=Notify_soaWiperStatus
      someip event group Eventgroup_Notification_soaWiperSwVersion: event-group-id=8707, event=Notify_soaWiperSwVersion
    Zone1DrvSeat: service-interface=Zone1DrvSeat, service-interface-id=5408
      someip field deployment zone1DrvSeatMotorDir: field=zone1DrvSeatMotorDir
        get Get_zone1DrvSeatMotorDir: method-id=2088, transport-protocol=UDP
        notifier Notify_zone1DrvSeatMotorDir: event-id=2045, transport-protocol=UDP
      someip field deployment zone1DrvSeatMotorPos: field=zone1DrvSeatMotorPos
        get Get_zone1DrvSeatMotorPos: method-id=2089, transport-protocol=UDP
        notifier Notify_zone1DrvSeatMotorPos: event-id=2046, transport-protocol=UDP
      someip method deployment controlMotor: method=controlMotor, method-id=2090, transport-protocol=UDP
      someip event group Eventgroup_Notify_zone1DrvSeatMotorDir: event-group-id=1002, event=[Notify_zone1DrvSeatMotorDir, Notify_zone1DrvSeatMotorPos]
    Zone1Mlm: service-interface=Zone1Mlm, service-interface-id=5392
      someip field deployment zone1MlmStatus: field=zone1MlmStatus
        get Get_zone1MlmStatus: method-id=2041, transport-protocol=UDP
        notifier Notify_zone1MlmStatus: event-id=2023, transport-protocol=UDP
      someip method deployment setMlmBrightness: method=setMlmBrightness, method-id=2042, transport-protocol=UDP
      someip method deployment setMlmColor: method=setMlmColor, method-id=2044, transport-protocol=UDP
      someip event group Eventgroup_Notify_zone1MlmStatus: event-group-id=1001, event=Notify_zone1MlmStatus
    Zone1Power: service-interface=Zone1Power, service-interface-id=5377
    Zone1Rsv: service-interface=Zone1RsvA, service-interface-id=5472
      someip field deployment zone1DeviceNormal: field=zone1DeviceNormal
        get Get_zone1DeviceNormal: method-id=2051, transport-protocol=UDP
        notifier Notify_zone1DeviceNormal: event-id=2027, transport-protocol=UDP
      someip event group Eventgroup_Notify_zone1DeviceNormal: event-group-id=1006, event=Notify_zone1DeviceNormal
    Zone2Power: service-interface=Zone2Power, service-interface-id=5633
    Zone2Roa: service-interface=Zone2Roa, service-interface-id=5648
      someip field deployment zone2RoaSnsrStatus: field=zone2RoaSnsrStatus
        get Get_zone2RoaSnsrStatus: method-id=2045, transport-protocol=UDP
        notifier Notify_zone2RoaSnsrStatus: event-id=2024, transport-protocol=UDP
      someip method deployment controlRoa: method=controlRoa, method-id=2093, transport-protocol=UDP
      someip event group Eventgroup_Notify_zone2RoaSnsrStatus: event-group-id=1011, event=Notify_zone2RoaSnsrStatus
    Zone2Rsv: service-interface=Zone2RsvA, service-interface-id=5680
      someip field deployment zone2DeviceNormal: field=zone2DeviceNormal
        get Get_zone2DeviceNormal: method-id=2071, transport-protocol=UDP
        notifier Notify_zone2DeviceNormal: event-id=2037, transport-protocol=UDP
      someip event group Eventgroup_Notify_zone2DeviceNormal: event-group-id=1013, event=Notify_zone2DeviceNormal
    Zone3Power: service-interface=Zone3Power, service-interface-id=5889
    Zone3Rcurtain: service-interface=Zone3Rcurtain, service-interface-id=5904
      someip field deployment zone3RcurtainStatus: field=zone3RcurtainStatus
        get Get_zone3RcurtainStatus: method-id=2086, transport-protocol=UDP
        notifier Notify_zone3RcurtainStatus: event-id=2044, transport-protocol=UDP
      someip method deployment controlRcurtain: method=controlRcurtain, method-id=2087, transport-protocol=UDP
      someip event group Eventgroup_Notify_zone3RcurtainStatus: event-group-id=1021, event=Notify_zone3RcurtainStatus
    Zone3RsvA: service-interface=Zone3RsvA, service-interface-id=5920
      someip field deployment zone3DeviceNormal: field=zone3DeviceNormal
        get Get_zone3DeviceNormal: method-id=2082, transport-protocol=UDP
        notifier Notify_zone3DeviceNormal: event-id=2042, transport-protocol=UDP
      someip event group Eventgroup_Notify_zone3DeviceNormal: event-group-id=1022, event=Notify_zone3DeviceNormal
    Zone4Power: service-interface=Zone4Power, service-interface-id=6145
    Zone4RsvA: service-interface=Zone4RsvA, service-interface-id=6176
      someip field deployment zone4DeviceNormal: field=zone4DeviceNormal
        get Get_zone4DeviceNormal: method-id=2059, transport-protocol=UDP
        notifier Notify_zone4DeviceNormal: event-id=2031, transport-protocol=UDP
      someip event group Eventgroup_Notify_zone4DeviceNormal: event-group-id=1032, event=Notify_zone4DeviceNormal
    Zone4Wiper: service-interface=Zone4Wiper, service-interface-id=6160
      someip field deployment zone4WiperOpStatus: field=zone4WiperOpStatus
        get Get_zone4WiperOpStatus: method-id=2084, transport-protocol=UDP
        notifier Notify_zone4WiperOpStatus: event-id=2043, transport-protocol=UDP
      someip method deployment controlWiper: method=controlWiper, method-id=2085, transport-protocol=UDP
      someip event group Eventgroup_Notify_zone4WiperOpStatus: event-group-id=1031, event=Notify_zone4WiperOpStatus
package /ServiceInstance/Endpoint
  25 x someip service instance to machine mapping, all with communication-connector=eth0:
    EEVP_SOA_DriverSeat_SomeIpConsumer: service-instance=Consumer_SoaDriverSeat, tcp-port=37775, udp-port=37775
    EEVP_SOA_DriverSeat_SomeIpProvider: service-instance=Provider_SoaDriverSeat, tcp-port=37774, udp-port=37774
    EEVP_SOA_MLM_SomeIpConsumer: service-instance=Consumer_SoaMlm, tcp-port=37767, udp-port=37767
    EEVP_SOA_MLM_SomeIpProvider: service-instance=Provider_SoaMlm, tcp-port=37766, udp-port=37766
    EEVP_SOA_POWER_SomeIpConsumer: service-instance=Consumer_SoaPower, tcp-port=37763, udp-port=37763
    EEVP_SOA_POWER_SomeIpProvider: service-instance=Provider_SoaPower, tcp-port=37762, udp-port=37762
    EEVP_SOA_RCRTN_SomeIpConsumer: service-instance=Consumer_SoaRcurtain, tcp-port=37765, udp-port=37765
    EEVP_SOA_RCRTN_SomeIpProvider: service-instance=Provider_SoaRcurtain, tcp-port=37764, udp-port=37764
    EEVP_SOA_ROA_SomeIpConsumer: service-instance=Consumer_SoaRoa, tcp-port=37769, udp-port=37769
    EEVP_SOA_ROA_SomeIpProvider: service-instance=Provider_SoaRoa, tcp-port=37768, udp-port=37768
    EEVP_SOA_Wiper_SomeIpConsumer: service-instance=Consumer_SoaWiper, tcp-port=37773, udp-port=37773
    EEVP_SOA_Wiper_SomeIpProvider: service-instance=Provider_SoaWiper, tcp-port=37772, udp-port=37772
    EEVP_ZONE1_DrvSeat_SomeIpConsumer: service-instance=Consumer_Zone1DrvSeat, tcp-port=1030, udp-port=1030
    EEVP_ZONE1_MLM_SomeIpConsumer: service-instance=Consumer_Zone1Mlm, tcp-port=1031, udp-port=1031
    EEVP_ZONE1_Power_SomeIpConsumer: service-instance=Consumer_Zone1Power, tcp-port=1032, udp-port=1032
    EEVP_ZONE1_RSVA_SomeIpConsumer: service-instance=Consumer_Zone1Rsv, tcp-port=1033, udp-port=1033
    EEVP_ZONE2_Power_SomeIpConsumer: service-instance=Consumer_Zone2Power, tcp-port=1034, udp-port=1034
    EEVP_ZONE2_ROA_SomeIpConsumer: service-instance=Consumer_Zone2Roa, tcp-port=1035, udp-port=1035
    EEVP_ZONE2_RSVA_SomeIpConsumer: service-instance=Consumer_Zone2Rsv, tcp-port=1036, udp-port=1036
    EEVP_ZONE3_Power_SomeIpConsumer: service-instance=Consumer_Zone3Power, tcp-port=1037, udp-port=1037
    EEVP_ZONE3_RSVA_SomeIpConsumer: service-instance=Consumer_Zone3Rsv, tcp-port=1039, udp-port=1039
    EEVP_ZONE3_Rcrtn_SomeIpConsumer: service-instance=Consumer_Zone3Rcurtain, tcp-port=1038, udp-port=1038
    EEVP_ZONE4_Power_SomeIpConsumer: service-instance=Consumer_Zone4Power, tcp-port=1040, udp-port=1040
    EEVP_ZONE4_RSVA_SomeIpConsumer: service-instance=Consumer_Zone4Rsv, tcp-port=1041, udp-port=1041
    EEVP_ZONE4_Wiper_SomeIpConsumer: service-instance=Consumer_Zone4Wiper, tcp-port=1042, udp-port=1042
package /ServiceInstance/SdTimingConfig/Client
  someip sd client service instance config DefaultClientConfig: initial-find-behavior={initial-delay-max-value=0.1, initial-delay-min-value=0.1, initial-repetitions-base-delay=0.1, initial-repetitions-max=3}, service-find-time-to-live=16777215
package /ServiceInstance/SdTimingConfig/Server
  someip sd server service instance config DefaultSdServerConfig: initial-offer-behavior={initial-delay-max-value=0.1, initial-delay-min-value=0.1, initial-repetitions-base-delay=0.1, initial-repetitions-max=2}, offer-cyclic-delay=0.5, request-response-delay={max-value=0.0, min-value=0.0}, service-offer-time-to-live=16777215
package /ServiceInstance/SdTimingConfig/Subscription
  someip sd client event group timing config DefaultSdSubscribeConfig: request-response-delay={max-value=0.0, min-value=0.0}, subscribe-eventgroup-retry-delay=0.0, subscribe-eventgroup-retry-max=3, time-to-live=16777215
package /ServiceInstance/Someip/Consumer
  19 x required someip service instance, all with required-service-instance-id=ANY:
    Consumer_SoaDriverSeat: service-interface-deployment=SoaDriverSeat, sd-client-config=DefaultSdClientConfig
      method-request-propss:
        Get_soaDrvSeatDeviceNormal
        Get_soaDrvSeatMotorDirection
        Get_soaDrvSeatMotorPosition
        Get_soaDrvSeatSwVersion
        RequestMoveDrvSeatHeight
        RequestMoveDrvSeatRecline
        RequestMoveDrvSeatSlide
        RequestMoveDrvSeatTilt
      4 x someip required event group, all with sd-client-event-group-timing-config=DefaultSdSubscribeConfig:
        Eventgroup_Notification_soaDrvSeatDeviceNormal: event-group=Eventgroup_Notification_soaDrvSeatDeviceNormal
        Eventgroup_Notification_soaDrvSeatDevicePosition: event-group=Eventgroup_Notification_soaDrvSeatMotorPosition
        Eventgroup_Notification_soaDrvSeatDeviceSwVersion: event-group=Eventgroup_Notification_soaDrvSeatSwVersion
        Eventgroup_Notification_soaDrvSeatMotorDevice: event-group=Eventgroup_Notification_soaDrvSeatMotorDirection
    Consumer_SoaMlm: service-interface-deployment=SoaMlm, method-request-propss=[Get_soaMlmStatus, Get_soaMlmSwVersion, RequestMlmSetBrightness, RequestMlmSetMode, RequestMlmSetRgbColor], sd-client-config=DefaultSdClientConfig
      someip required event group Eventgroup_Notification_soaMlmStatus: event-group=Eventgroup_Notification_soaMlmStatus, sd-client-event-group-timing-config=DefaultSdSubscribeConfig
      someip required event group Eventgroup_Notification_soaMlmSwVersion: event-group=Eventgroup_Notification_soaMlmSwVersion, sd-client-event-group-timing-config=DefaultSdSubscribeConfig
    Consumer_SoaPower: service-interface-deployment=SoaPower, method-request-propss=[Get_soaPowerDeviceNormal, method=Get_soaPowerSwVersion], sd-client-config=DefaultSdClientConfig
      someip required event group Eventgroup_Notification_soaPowerDeviceNormal: event-group=Eventgroup_Notification_soaPowerDeviceNormal, sd-client-event-group-timing-config=DefaultSdSubscribeConfig
      someip required event group Eventgroup_Notify_soaPowerSwVersion: event-group=Eventgroup_Notify_soaPowerSwVersion, sd-client-event-group-timing-config=DefaultSdSubscribeConfig
    Consumer_SoaRcurtain: service-interface-deployment=SoaRcurtain, sd-client-config=DefaultClientConfig
      method-request-propss:
        Get_soaRctnStatus
        method=Get_soaRctnSwVersion
        method=RequestRearCurtainOperation
        RequestRearCurtainPosition
      someip required event group Eventgroup_Notification_soaRctnStatus: event-group=Eventgroup_Notification_soaRctnStatus, sd-client-event-group-timing-config=DefaultSdSubscribeConfig
      someip required event group Eventgroup_Notification_soaRctnSwVersion: event-group=Eventgroup_Notification_soaRctnSwVersion, sd-client-event-group-timing-config=DefaultSdSubscribeConfig
    Consumer_SoaRoa: service-interface-deployment=SoaRoa, sd-client-config=DefaultSdClientConfig
      method-request-propss:
        Get_soaRoaDetectCount
        Get_soaRoaDetectState
        collection-props=udp-collection-trigger=NEVER, method=Get_soaRoaDeviceNormal
        Get_soaRoaMode
        method=Get_soaRoaRunningState
        Get_soaRoaSensorError
        Get_soaRoaSwVersion
        ResetRoaDetectInfo
        SetRoaMode
        StartRoa
        StopRoa
      7 x someip required event group, all with sd-client-event-group-timing-config=DefaultSdSubscribeConfig:
        Eventgroup_Notification_soaRoaDetectCount: event-group=Eventgroup_Notification_soaRoaDetectCount
        Eventgroup_Notification_soaRoaDetectState: event-group=Eventgroup3_Notification_soaRoaDetectState
        Eventgroup_Notification_soaRoaDeviceNormal: event-group=Eventgroup_Notification_soaRoaDeviceNormal
        Eventgroup_Notification_soaRoaMode: event-group=Eventgroup_Notification_soaRoaMode
        Eventgroup_Notification_soaRoaRunningState: event-group=Eventgroup_Notification_soaRoaRunningState
        Eventgroup_Notification_soaRoaSensorError: event-group=Eventgroup_Notification_soaRoaSensorError
        Eventgroup_Notification_soaRoaSwVersion: event-group=Eventgroup_Notification_soaRoaSwVersion
    Consumer_SoaWiper: service-interface-deployment=SoaWiper, sd-client-config=DefaultClientConfig
      method-request-propss:
        method=Get_soaWiperDeviceNormal
        Get_soaWiperStatus
        Get_soaWiperSwVersion
        RequestWiperOperation
        SetWiperAutoSpeed
      someip required event group Eventgroup_Notification_soaWiperDeviceNormal: event-group=Eventgroup_Notification_soaWiperDeviceNormal, sd-client-event-group-timing-config=DefaultSdSubscribeConfig
      someip required event group Eventgroup_Notification_soaWiperStatus: event-group=Eventgroup_Notification_soaWiperStatus, sd-client-event-group-timing-config=DefaultSdSubscribeConfig
      someip required event group Eventgroup_Notification_soaWiperSwVersion: event-group=Eventgroup_Notification_soaWiperSwVersion, sd-client-event-group-timing-config=DefaultSdSubscribeConfig
    Consumer_Zone1DrvSeat: service-interface-deployment=Zone1DrvSeat, method-request-propss=[Get_zone1DrvSeatMotorDir, Get_zone1DrvSeatMotorPos, method=controlMotor], sd-client-config=DefaultSdClientConfig
      someip required event group Eventgroup_Notify_zone1DrvSeatMotorDir: event-group=Eventgroup_Notify_zone1DrvSeatMotorDir, sd-client-event-group-timing-config=DefaultSdSubscribeConfig
    Consumer_Zone1Mlm: service-interface-deployment=Zone1Mlm, method-request-propss=[Get_zone1MlmStatus, setMlmColor, method=setMlmBrightness], sd-client-config=DefaultSdClientConfig
      someip required event group Eventgroup_Notify_zone1MlmStatus: event-group=Eventgroup_Notify_zone1MlmStatus, sd-client-event-group-timing-config=DefaultSdSubscribeConfig
    Consumer_Zone1Power: service-interface-deployment=Zone1Power, sd-client-config=DefaultSdClientConfig
    Consumer_Zone1Rsv: service-interface-deployment=Zone1Rsv, someip-method-props=Get_zone1DeviceNormal, sd-client-config=DefaultSdClientConfig
      someip required event group Eventgroup_Notify_zone1DeviceNormal: event-group=Eventgroup_Notify_zone1DeviceNormal, sd-client-event-group-timing-config=DefaultSdSubscribeConfig
    Consumer_Zone2Power: service-interface-deployment=Zone2Power, sd-client-config=DefaultSdClientConfig
    Consumer_Zone2Roa: service-interface-deployment=Zone2Roa, method-request-propss=[method=Get_zone2RoaSnsrStatus, controlRoa], sd-client-config=DefaultSdClientConfig
      someip required event group Eventgroup_Notify_zone2RoaSnsrStatus: event-group=Eventgroup_Notify_zone2RoaSnsrStatus, sd-client-event-group-timing-config=DefaultSdSubscribeConfig
    Consumer_Zone2Rsv: service-interface-deployment=Zone2Rsv, someip-method-props=method=Get_zone2DeviceNormal, sd-client-config=DefaultSdClientConfig
      someip required event group Eventgroup_Notify_zone2DeviceNormal: event-group=Eventgroup_Notify_zone2DeviceNormal, sd-client-event-group-timing-config=DefaultSdSubscribeConfig
    Consumer_Zone3Power: service-interface-deployment=Zone3Power, sd-client-config=DefaultSdClientConfig
    Consumer_Zone3Rcurtain: service-interface-deployment=Zone3Rcurtain, method-request-propss=[Get_zone3RcurtainStatus, controlRcurtain], sd-client-config=DefaultSdClientConfig
      someip required event group Eventgroup_Notify_zone3RcurtainStatus: event-group=Eventgroup_Notify_zone3RcurtainStatus, sd-client-event-group-timing-config=DefaultSdSubscribeConfig
    Consumer_Zone3Rsv: service-interface-deployment=Zone3RsvA, someip-method-props=Get_zone3DeviceNormal, sd-client-config=DefaultSdClientConfig
      someip required event group Eventgroup_Notify_zone3DeviceNormal: event-group=Eventgroup_Notify_zone3DeviceNormal, sd-client-event-group-timing-config=DefaultSdSubscribeConfig
    Consumer_Zone4Power: service-interface-deployment=Zone4Power, sd-client-config=DefaultSdClientConfig
    Consumer_Zone4Rsv: service-interface-deployment=Zone4RsvA, someip-method-props=method=Get_zone4DeviceNormal, sd-client-config=DefaultSdClientConfig
      someip required event group Eventgroup_Notify_zone4DeviceNormal: event-group=Eventgroup_Notify_zone4DeviceNormal, sd-client-event-group-timing-config=DefaultSdSubscribeConfig
    Consumer_Zone4Wiper: service-interface-deployment=Zone4Wiper, method-request-propss=[method=Get_zone4WiperOpStatus, controlWiper], sd-client-config=DefaultSdClientConfig
      someip required event group Eventgroup_Notify_zone4WiperOpStatus: event-group=Eventgroup_Notify_zone4WiperOpStatus, sd-client-event-group-timing-config=DefaultSdSubscribeConfig
package /ServiceInstance/Someip/Provider
  6 x provided someip service instance, all with sd-server-config=DefaultSdServerConfig:
    Provider_SoaDriverSeat: service-interface-deployment=SoaDriverSeat, service-instance-id=4962
      event-propss:
        event=Notification_soaDrvSeatDeviceNormal
        Notify_soaDrvSeatMotorDirection
        Notify_soaDrvSeatMotorPosition
        event=Notify_soaDrvSeatSwVersion
      method-response-propss:
        Get_soaDrvSeatDeviceNormal
        method=Get_soaDrvSeatMotorDirection
        Get_soaDrvSeatMotorPosition
        Get_soaDrvSeatSwVersion
        RequestMoveDrvSeatHeight
        RequestMoveDrvSeatRecline
        RequestMoveDrvSeatSlide
        RequestMoveDrvSeatTilt
      4 x someip provided event group, all with multicast-threshold=0, sd-server-event-group-timing-config=DefaultSdPublishConfig:
        Eventgroup_Notification_soaDrvSeatMotorDirection: event-group=Eventgroup_Notification_soaDrvSeatMotorDirection
        Eventgroup_Notification_soaDrvSeatMotorPosition: event-group=Eventgroup_Notification_soaDrvSeatMotorPosition
        Eventgroup_Notification_soaDrvSeatNormal: event-group=Eventgroup_Notification_soaDrvSeatDeviceNormal
        Eventgroup_Notification_soaDrvSeatSwVersion: event-group=Eventgroup_Notification_soaDrvSeatSwVersion
    Provider_SoaMlm: service-interface-deployment=SoaMlm, service-instance-id=4961
      event-propss:
        collection-props=udp-collection-trigger=NEVER, event=Notification_soaMlmStatus
        Notify_soaMlmSwVersion
      method-response-propss:
        Get_soaMlmStatus
        method=RequestMlmSetRgbColor
        RequestMlmSetMode
        RequestMlmSetBrightness
        Get_soaMlmSwVersion
      someip provided event group Eventgroup_Notification_soaMlmStatus: event-group=Eventgroup_Notification_soaMlmStatus, multicast-threshold=0, sd-server-event-group-timing-config=DefaultSdPublishConfig
      someip provided event group Eventgroup_Notification_soaMlmSwVersion: event-group=Eventgroup_Notification_soaMlmSwVersion, multicast-threshold=0, sd-server-event-group-timing-config=DefaultSdPublishConfig
    Provider_SoaPower: service-interface-deployment=SoaPower, someip-event-props=Notify_soaPowerDeviceNormal, method-response-propss=[method=Get_soaPowerDeviceNormal, Get_soaPowerSwVersion], service-instance-id=4960
      someip provided event group Eventgroup_Notification_soaPowerDeviceNormal: event-group=Eventgroup_Notification_soaPowerDeviceNormal, multicast-threshold=0, sd-server-event-group-timing-config=DefaultSdPublishConfig
      someip provided event group ProvidedEventgroup1: event-group=Eventgroup_Notify_soaPowerSwVersion, multicast-threshold=0, sd-server-event-group-timing-config=DefaultSdPublishConfig
    Provider_SoaRcurtain: service-interface-deployment=SoaRcurtain, event-propss=[Notification_soaRctnStatus, Notify_soaRctnSwVersion], method-response-propss=[Get_soaRctnStatus, Get_soaRctnSwVersion, RequestRearCurtainOperation, RequestRearCurtainPosition], service-instance-id=4964
      someip provided event group Eventgroup_Notification_soaRctnStatus: event-group=Eventgroup_Notification_soaRctnStatus, multicast-threshold=0, sd-server-event-group-timing-config=DefaultSdPublishConfig
      someip provided event group Eventgroup_Notification_soaRctnSwVersion: event-group=Eventgroup_Notification_soaRctnSwVersion, multicast-threshold=0, sd-server-event-group-timing-config=DefaultSdPublishConfig
    Provider_SoaRoa: service-interface-deployment=SoaRoa, service-instance-id=4963
      event-propss:
        event=Notify_soaRoaDetectCount
        Notify_soaRoaDetectState
        Notify_soaRoaDeviceNormal
        Notify_soaRoaMode
        Notify_soaRoaRunningState
        Notify_soaRoaSensorError
        Notify_soaRoaSwVersion
      method-response-propss:
        Get_soaRoaDetectCount
        Get_soaRoaDetectState
        Get_soaRoaDeviceNormal
        Get_soaRoaMode
        Get_soaRoaRunningState
        Get_soaRoaSensorError
        Get_soaRoaSwVersion
        ResetRoaDetectInfo
        SetRoaMode
        StartRoa
        StopRoa
      7 x someip provided event group, all with multicast-threshold=0, sd-server-event-group-timing-config=DefaultSdPublishConfig:
        Eventgroup_Notification_soaRoaDetectCount: event-group=Eventgroup_Notification_soaRoaDetectCount
        Eventgroup_Notification_soaRoaDetectState: event-group=Eventgroup3_Notification_soaRoaDetectState
        Eventgroup_Notification_soaRoaDeviceNormal: event-group=Eventgroup_Notification_soaRoaDeviceNormal
        Eventgroup_Notification_soaRoaMode: event-group=Eventgroup_Notification_soaRoaMode
        Eventgroup_Notification_soaRoaRunningState: event-group=Eventgroup_Notification_soaRoaRunningState
        Eventgroup_Notification_soaRoaSensorError: event-group=Eventgroup_Notification_soaRoaSensorError
        Eventgroup_Notification_soaRoaSwVersion: event-group=Eventgroup_Notification_soaRoaSwVersion
    Provider_SoaWiper: service-interface-deployment=SoaWiper, event-propss=[Notify_soaWiperDeviceNormal, Notify_soaWiperStatus, Notify_soaWiperSwVersion], service-instance-id=4965
      method-response-propss:
        Get_soaWiperDeviceNormal
        Get_soaWiperStatus
        Get_soaWiperSwVersion
        RequestWiperOperation
        SetWiperAutoSpeed
      someip provided event group Eventgroup_Notification_soaWiperDeviceNormal: event-group=Eventgroup_Notification_soaWiperDeviceNormal, multicast-threshold=0, sd-server-event-group-timing-config=DefaultSdPublishConfig
      someip provided event group Eventgroup_Notification_soaWiperStatus: event-group=Eventgroup_Notification_soaWiperStatus, multicast-threshold=0, sd-server-event-group-timing-config=DefaultSdPublishConfig
      someip provided event group Eventgroup_Notification_soaWiperSwVersion: event-group=Eventgroup_Notification_soaWiperSwVersion, multicast-threshold=0, sd-server-event-group-timing-config=DefaultSdPublishConfig
package /ServiceInterface
  19 x service interface:
    SoaDriverSeat: category=COMMUNICATION_GROUP, major-version=1, minor-version=0
      namespaces:
        symbol props eevp
        symbol props control
      4 x field, all with has-getter=true, has-notifier=true, has-setter=false:
        soaDrvSeatDeviceNormal: type=SoaDeviceIsNormal
        soaDrvSeatMotorDirection: type=SoaSeatMotorDirection
        soaDrvSeatMotorPosition: type=SoaSeatMotorPosition
        soaDrvSeatSwVersion: type=uint8_t
      methods:
        4 x operation, all with fire-and-forget=true:
          RequestMoveDrvSeatHeight
            arg dir: type=SoaSeatHeightDirection, direction=IN
          RequestMoveDrvSeatRecline
            arg dir: type=SoaSeatReclineDirection, direction=IN
          RequestMoveDrvSeatSlide
            arg dir: type=SoaSeatSlideDirection, direction=IN
          RequestMoveDrvSeatTilt
            arg dir: type=SoaSeatTiltDirection, direction=IN
    SoaMlm: category=COMMUNICATION_GROUP, major-version=1, minor-version=0
      namespaces:
        symbol props eevp
        symbol props control
      field soaMlmStatus: type=SoaMlmStatus, has-getter=true, has-notifier=true, has-setter=false
      field soaMlmSwVersion: type=uint8_t, has-getter=true, has-notifier=true, has-setter=false
      methods:
        operation RequestMlmSetBrightness: fire-and-forget=true
          arg brightness: type=uint16_t, direction=IN
        operation RequestMlmSetMode: fire-and-forget=true
          arg mood: type=SoaMlmMoodMode, direction=IN
        operation RequestMlmSetRgbColor: fire-and-forget=true
          arg colorTableIndex: type=uint8_t, direction=IN
    SoaPower: category=COMMUNICATION_GROUP, major-version=1, minor-version=0
      namespaces:
        symbol props eevp
        symbol props control
      field soaPowerDeviceNormal: type=SoaDeviceIsNormal, has-getter=true, has-notifier=true, has-setter=false
      field soaPowerSwVersion: type=uint8_t, has-getter=true, has-notifier=true, has-setter=false
    SoaRcurtain: category=COMMUNICATION_GROUP, major-version=1, minor-version=0
      namespaces:
        symbol props eevp
        symbol props control
      field soaRctnStatus: type=SoaRctnStatus, has-getter=true, has-notifier=true, has-setter=false
      field soaRctnSwVersion: type=uint8_t, has-getter=true, has-notifier=true, has-setter=false
      methods:
        operation RequestRearCurtainOperation: fire-and-forget=false
          arg motorDir: type=SoaRctnMotorDir, direction=IN
          arg err: type=SoaErrorState, direction=OUT
        operation RequestRearCurtainPosition: fire-and-forget=true
          arg posPercentage: type=uint8_t, direction=IN
    SoaRoa: category=COMMUNICATION_GROUP, major-version=1, minor-version=0
      namespaces:
        symbol props eevp
        symbol props control
      7 x field, all with has-getter=true, has-notifier=true, has-setter=false:
        soaRoaDetectCount: type=uint8_t
        soaRoaDetectState: type=SoaRoaDetectState
        soaRoaDeviceNormal: type=SoaDeviceIsNormal
        soaRoaMode: type=SoaRoaMode
        soaRoaRunningState: type=SoaRoaRunningState
        soaRoaSensorError: type=SoaRoaSensorError
        soaRoaSwVersion: type=uint8_t
      methods:
        4 x operation, all with fire-and-forget=true:
          ResetRoaDetectInfo
          SetRoaMode
            arg mode: type=SoaRoaMode, direction=IN
          StartRoa
          StopRoa
    SoaWiper: category=COMMUNICATION_GROUP, major-version=1, minor-version=0
      namespaces:
        symbol props eevp
        symbol props control
      field soaWiperDeviceNormal: type=SoaDeviceIsNormal, has-getter=true, has-notifier=true, has-setter=false
      field soaWiperStatus: type=SoaWiperStatus, has-getter=true, has-notifier=true, has-setter=false
      field soaWiperSwVersion: type=uint8_t, has-getter=true, has-notifier=true, has-setter=false
      methods:
        operation RequestWiperOperation: fire-and-forget=true
          arg mode: type=SoaWiperMode, direction=IN
        operation SetWiperAutoSpeed: fire-and-forget=true
          arg isAutoSpeed: type=bool, direction=IN
    Zone1DrvSeat
      namespaces:
        symbol props zone1
        symbol props drvseat
        symbol props control
      field zone1DrvSeatMotorDir: type=EcuDrvSeatMotorDirection, has-getter=true, has-notifier=true, has-setter=false
      field zone1DrvSeatMotorPos: type=EcuDrvseatMotorPosition, has-getter=true, has-notifier=true, has-setter=false
      methods:
        operation controlMotor: fire-and-forget=true
          arg inst: type=EcuDrvSeatMotorInst, direction=IN
    Zone1Mlm
      namespaces:
        symbol props zone1
        symbol props mlm
        symbol props control
      field zone1MlmStatus: type=EcuMlmState, has-getter=true, has-notifier=true, has-setter=false
      methods:
        operation setMlmBrightness: fire-and-forget=true
          arg brightness: type=uint8_t, direction=IN
        operation setMlmColor: fire-and-forget=true
          arg colorIndex: type=uint8_t, direction=IN
    Zone1Power
      namespaces:
        symbol props zone1
        symbol props power
        symbol props control
      field zone1Current: type=EcuZ1PowerCurrent, has-getter=true, has-notifier=true, has-setter=false
      field zone1PowerState: type=EcuZ1PowerState, has-getter=true, has-notifier=true, has-setter=false
      methods:
        operation controlDrvseatPower: fire-and-forget=false
          arg turnon: type=bool, direction=IN
          arg error: type=uint8_t, direction=OUT
        operation controlMfswPower: fire-and-forget=false
          arg turnon: type=bool, direction=IN
          arg error: type=uint8_t, direction=OUT
        operation controlMlmPower: fire-and-forget=false
          arg turnon: type=bool, direction=IN
          arg error: type=uint8_t, direction=OUT
    Zone1RsvA
      namespaces:
        symbol props zone1
        symbol props reserved
        symbol props a
      field zone1DeviceNormal: type=uint8_t, has-getter=true, has-notifier=true, has-setter=false
    Zone2Power
      namespaces:
        symbol props zone2
        symbol props power
        symbol props control
      field zone2Current: type=EcuZ2PowerCurrent, has-getter=true, has-notifier=true, has-setter=false
      field zone2PowerState: type=EcuZ2PowerState, has-getter=true, has-notifier=true, has-setter=false
      methods:
        operation controlRainSnsrPower: fire-and-forget=false
          arg turnon: type=bool, direction=IN
          arg error: type=uint8_t, direction=OUT
        operation controlRoaPower: fire-and-forget=false
          arg turnon: type=bool, direction=IN
          arg error: type=uint8_t, direction=OUT
    Zone2Roa
      namespaces:
        symbol props zone2
        symbol props roa
        symbol props control
      field zone2RoaSnsrStatus: type=EcmRoaSnsrStatus, has-getter=true, has-notifier=true, has-setter=false
      methods:
        operation controlRoa: fire-and-forget=true
          arg snsrRunReq: type=uint8_t, direction=IN
    Zone2RsvA
      namespaces:
        symbol props zone2
        symbol props reserved
        symbol props a
      field zone2DeviceNormal: type=uint8_t, has-getter=true, has-notifier=true, has-setter=false
    Zone3Power
      namespaces:
        symbol props zone3
        symbol props power
        symbol props control
      field zone3Current: type=EcuZ3PowerCurrent, has-getter=true, has-notifier=true, has-setter=false
      field zone3PowerState: type=EcuZ3PowerState, has-getter=true, has-notifier=true, has-setter=false
      methods:
        operation controlRcurtPower: fire-and-forget=false
          arg turnon: type=bool, direction=IN
          arg error: type=uint8_t, direction=OUT
        operation controlRpdwPower: fire-and-forget=false
          arg turnon: type=bool, direction=IN
          arg error: type=uint8_t, direction=OUT
    Zone3Rcurtain
      namespaces:
        symbol props zone3
        symbol props rcurtain
        symbol props control
      field zone3RcurtainStatus: type=EcuRcurtainStatus, has-getter=true, has-notifier=true, has-setter=false
      methods:
        operation controlRcurtain: fire-and-forget=true
          arg motorPos: type=uint8_t, direction=IN
    Zone3RsvA
      namespaces:
        symbol props zone3
        symbol props reserved
        symbol props a
      field zone3DeviceNormal: type=uint8_t, has-getter=true, has-notifier=true, has-setter=false
    Zone4Power
      namespaces:
        symbol props zone4
        symbol props power
        symbol props control
      field zone4Current: type=EcuZ4PowerCurrent, has-getter=true, has-notifier=true, has-setter=false
      field zone4PowerState: type=EcuZ4PowerState, has-getter=true, has-notifier=true, has-setter=false
      methods:
        operation controlFpdwPower: fire-and-forget=false
          arg turnon: type=bool, direction=IN
          arg error: type=uint8_t, direction=OUT
        operation controlWiperPower: fire-and-forget=false
          arg turnon: type=bool, direction=IN
          arg error: type=uint8_t, direction=OUT
    Zone4RsvA
      namespaces:
        symbol props zone4
        symbol props reserved
        symbol props a
      field zone4DeviceNormal: type=uint8_t, has-getter=true, has-notifier=true, has-setter=false
    Zone4Wiper
      namespaces:
        symbol props zone4
        symbol props wiper
        symbol props control
      field zone4WiperOpStatus: type=EcuWiperOperationStatus, has-getter=true, has-notifier=true, has-setter=false
      methods:
        operation controlWiper: fire-and-forget=true
          arg mode: type=uint8_t, direction=IN
