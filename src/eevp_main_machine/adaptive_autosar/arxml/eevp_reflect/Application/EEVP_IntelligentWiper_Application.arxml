AUTOSAR XML (schema 00049)
package /Application/DltConfig
  dlt log channel to process mapping DltLogChannelToProcessMapping_IntelligentWiper_TO_IntelligentWiper: dlt-log-channel=IntelligentWiper, process=IntelligentWiper
package /Application/Executable
  executable IntelligentWiper: category=APPLICATION_LEVEL, logging-behavior=USES-LOGGING, reporting-behavior=REPORTS-EXECUTION-STATE, version=1.0.0
    root sw component prototype AA: application-type=IntelligentWiper
package /Application/Manifest
  service instance to port prototype mapping IntelligentWiper_AA_RPort_BCM_WiperWash: port-prototype=AA.RPort_BCM_WiperWash, service-instance=EEVP_IntelligentWiper_Consumer_BCM_WiperWash
package /Application/Process
  process IntelligentWiper: executable=IntelligentWiper, state-dependent-startup-config{execution-dependency=CM.Running, function-group-state=MachineFG.Startup, resource-group=DefaultResourceGroup, startup-config=IntelligentWiper}
    process state machine IntelligentWiper: type=ProcessState
package /Application/StartupConfig
  startup config set EEVP_IntelligentWiper_StartupConfig
    startup config IntelligentWiper: scheduling-policy=SCHED_OTHER, scheduling-priority=0
package /Application/SwComponent
  adaptive application sw component type IntelligentWiper
    require port RPort_BCM_WiperWash: required-interface=BCM_WiperWash
