AUTOSAR XML (schema 00049)
package /ServiceInstance/Endpoint
  someip service instance to machine mapping EEVP_KATECH_SomeipConsumers_Roa: communication-connector=eth0, service-instance=EEVP_KATECH_Consumer_SoaRoa, tcp-port=55091, udp-port=55091
  someip service instance to machine mapping EEVP_KATECH_SomeipProviders_RearCurtain: communication-connector=eth0, service-instance=EEVP_KATECH_Provider_SoaRcurtain, tcp-port=50091, udp-port=50091
package /ServiceInstance/Someip/Consumer
  required someip service instance EEVP_KATECH_Consumer_SoaRoa: service-interface-deployment=SoaRoa, required-minor-version=ANY, required-service-instance-id=ANY, sd-client-config=DefaultClientConfig, version-driven-find-behavior=EXACT-OR-ANY-MINOR-VERSION
    method-request-propss:
      Get_soaRoaDetectCount
      Get_soaRoaDetectState
      Get_soaRoaDeviceNormal
      Get_soaRoaMode
      Get_soaRoaRunningState
      Get_soaRoaSensorError
      ResetRoaDetectInfo
      SetRoaMode
      StartRoa
      StopRoa
    someip required event group Eventgroup3_Notification_soaRoaDetectState: event-group=Eventgroup3_Notification_soaRoaDetectState, sd-client-event-group-timing-config=DefaultSdSubscribeConfig
    someip required event group Eventgroup_Notification_soaRoaDetectCount: event-group=Eventgroup_Notification_soaRoaDetectCount, sd-client-event-group-timing-config=DefaultSdSubscribeConfig
package /ServiceInstance/Someip/Provider
  provided someip service instance EEVP_KATECH_Provider_SoaRcurtain: service-interface-deployment=SoaRcurtain, someip-method-props=method=RequestRearCurtainOperation, sd-server-config=DefaultSdServerConfig, service-instance-id=1
