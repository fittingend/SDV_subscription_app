AUTOSAR XML (schema 00049)
package /ServiceDeployment/Someip
  someip service interface deployment MonitoringManagement: service-interface=MonitoringManagement, service-interface-id=4881, service-interface-version={major-version=1, minor-version=0}
    7 x someip event deployment, all with transport-protocol=UDP:
      DistanceLevel: event=DistanceLevel, event-id=501
      eventServiceError: event=eventServiceError, event-id=3
      eventServiceInfo: event=eventServiceInfo, event-id=1
      eventServiceInfoSpare: event=eventServiceInfoSpare, event-id=4
      eventServiceStatus: event=eventServiceStatus, event-id=2
      eventServiceStatusSpare: event=eventServiceStatusSpare, event-id=5
      eventUpdatableService: event=eventUpdatableService, event-id=6
    21 x someip field deployment:
      mbTemp: field=mbTemp
        get Get_mbTemp: method-id=13, transport-protocol=UDP
        notifier Notify_mbTemp: event-id=13, transport-protocol=UDP
      soaDrvSeatDeviceNormal: field=soaDrvSeatDeviceNormal
        get Get_soaDrvSeatDeviceNormal: method-id=751, transport-protocol=UDP
        notifier Notify_soaDrvSeatDeviceNormal: event-id=751, transport-protocol=UDP
      soaDrvSeatMotorDirection: field=soaDrvSeatMotorDirection
        get Get_soaDrvSeatMotorDirection: method-id=752, transport-protocol=UDP
        notifier Notify_soaDrvSeatMotorDirection: event-id=752, transport-protocol=UDP
      soaDrvSeatMotorPosition: field=soaDrvSeatMotorPosition
        get Get_soaDrvSeatMotorPosition: method-id=753, transport-protocol=UDP
        notifier Notify_soaDrvSeatMotorPosition: event-id=753, transport-protocol=UDP
      soaDrvSeatSwVersion: field=soaDrvSeatSwVersion
        get Get_soaDrvSeatSwVersion: method-id=754, transport-protocol=UDP
        notifier Notify_soaDrvSeatSwVersion: event-id=754, transport-protocol=UDP
      soaMlmStatus: field=soaMlmStatus
        get Get_soaMlmStatus: method-id=401, transport-protocol=UDP
        notifier Notify_soaMlmStatus: event-id=401, transport-protocol=UDP
      soaMlmSwVersion: field=soaMlmSwVersion
        get Get_soaMlmSwVersion: method-id=402, transport-protocol=UDP
        notifier Notify_soaMlmSwVersion: event-id=402, transport-protocol=UDP
      soaPowerDeviceNormal: field=soaPowerDeviceNormal
        get Get_soaPowerDeviceNormal: method-id=1051, transport-protocol=UDP
        notifier Notify_soaPowerDeviceNormal: event-id=1051, transport-protocol=UDP
      soaPowerSwVersion: field=soaPowerSwVersion
        get Get_soaPowerSwVersion: method-id=1052, transport-protocol=UDP
        notifier Notify_soaPowerSwVersion: event-id=1052, transport-protocol=UDP
      soaRctnStatus: field=soaRctnStatus
        get Get_soaRctnStatus: method-id=901, transport-protocol=UDP
        notifier Notify_soaRctnStatus: event-id=901, transport-protocol=UDP
      soaRctnSwVersion: field=soaRctnSwVersion
        get Get_soaRctnSwVersion: method-id=902, transport-protocol=UDP
        notifier Notify_soaRctnSwVersion: event-id=902, transport-protocol=UDP
      soaRoaDetectCount: field=soaRoaDetectCount
        get Get_soaRoaDetectCount: method-id=651, transport-protocol=UDP
        notifier Notify_soaRoaDetectCount: event-id=651, transport-protocol=UDP
      soaRoaDetectState: field=soaRoaDetectState
        get Get_soaRoaDetectState: method-id=652, transport-protocol=UDP
        notifier Notify_soaRoaDetectState: event-id=652, transport-protocol=UDP
      soaRoaDeviceNormal: field=soaRoaDeviceNormal
        get Get_soaRoaDeviceNormal: method-id=653, transport-protocol=UDP
        notifier Notify_soaRoaDeviceNormal: event-id=653, transport-protocol=UDP
      soaRoaMode: field=soaRoaMode
        get Get_soaRoaMode: method-id=654, transport-protocol=UDP
        notifier Notify_soaRoaMode: event-id=654, transport-protocol=UDP
      soaRoaRunningState: field=soaRoaRunningState
        get Get_soaRoaRunningState: method-id=65, transport-protocol=UDP
        notifier Notify_soaRoaRunningState: event-id=655, transport-protocol=UDP
      soaRoaSensorError: field=soaRoaSensorError
        get Get_soaRoaSensorError: method-id=656, transport-protocol=UDP
        notifier Notify_soaRoaSensorError: event-id=656, transport-protocol=UDP
      soaRoaSwVersion: field=soaRoaSwVersion
        get Get_soaRoaSwVersion: method-id=657, transport-protocol=UDP
        notifier Notify_soaRoaSwVersion: event-id=657, transport-protocol=UDP
      soaWiperDeviceNormal: field=soaWiperDeviceNormal
        get Get_soaWiperDeviceNormal: method-id=801, transport-protocol=UDP
        notifier Notify_soaWiperDeviceNormal: event-id=801, transport-protocol=UDP
      soaWiperStatus: field=soaWiperStatus
        get Get_soaWiperStatus: method-id=802, transport-protocol=UDP
        notifier Notify_soaWiperStatus: event-id=802, transport-protocol=UDP
      soaWiperSwVersion: field=soaWiperSwVersion
        get Get_soaWiperSwVersion: method-id=803, transport-protocol=UDP
        notifier Notify_soaWiperSwVersion: event-id=803, transport-protocol=UDP
    24 x someip method deployment, all with transport-protocol=UDP:
      RequestMlmSetRgbColor: method=RequestMlmSetRgbColor, method-id=405
      RequestMoveDrvSeatHeight: method=RequestMoveDrvSeatHeight, method-id=701
      RequestMoveDrvSeatRecline: method=RequestMoveDrvSeatRecline, method-id=702
      RequestMoveDrvSeatSlide: method=RequestMoveDrvSeatSlide, method-id=703
      RequestMoveDrvSeatTilt: method=RequestMoveDrvSeatTilt, method-id=704
      RequestRearCurtainOperation: method=RequestRearCurtainOperation, method-id=903
      RequestRearCurtainPosition: method=RequestRearCurtainPosition, method-id=904
      RequestWiperOperation: method=RequestWiperOperation, method-id=804
      ResetRoaDetectInfo: method=ResetRoaDetectInfo, method-id=601
      SetRoaMode: method=SetRoaMode, method-id=602
      SetWiperAutoSpeed: method=SetWiperAutoSpeed, method-id=805
      StartRoa: method=StartRoa, method-id=603
      StopRoa: method=StopRoa, method-id=604
      requestAppInstall: method=requestAppInstall, method-id=1
      requestAppUpdate: method=requestAppUpdate, method-id=2
      requestControllerServiceInfo: method=requestControllerServiceInfo, method-id=3
      requestControllerServiceInfoAll: method=requestControllerServiceInfoAll, method-id=4
      requestControllerServiceInfoAllSpare: method=requestControllerServiceInfoAllSpare, method-id=8
      requestControllerServiceStatus: method=requestControllerServiceStatus, method-id=5
      requestControllerServiceStatusAll: method=requestControllerServiceStatusAll, method-id=6
      requestControllerServiceStatusAllSpare: method=requestControllerServiceStatusAllSpare, method-id=9
      resetUcmTest: method=resetUcmTest, method-id=12
      setControlControllerService: method=setControlControllerService, method-id=10
      setEnableControllerService: method=setEnableControllerService, method-id=7
    someip event group Eventgroup_eventService: event-group-id=1, event=[DistanceLevel, eventServiceError, eventServiceInfoSpare, eventServiceStatusSpare, eventUpdatableService, Notify_mbTemp, Notify_soaDrvSeatDeviceNormal, Notify_soaDrvSeatMotorDirection, Notify_soaDrvSeatMotorPosition, Notify_soaDrvSeatSwVersion, Notify_soaMlmStatus, Notify_soaMlmSwVersion, Notify_soaPowerDeviceNormal, Notify_soaPowerSwVersion, Notify_soaRctnStatus, Notify_soaRctnSwVersion, Notify_soaRoaDetectCount, Notify_soaRoaDetectState, Notify_soaRoaDeviceNormal, Notify_soaRoaMode, Notify_soaRoaRunningState, Notify_soaRoaSensorError, Notify_soaRoaSwVersion, Notify_soaWiperDeviceNormal, Notify_soaWiperStatus, Notify_soaWiperSwVersion]
package /ServiceInstance/Endpoint
  10 x someip service instance to machine mapping, all with communication-connector=eth0:
    EEVP_MonitoringManager_SomeipConsumers_DrvSeat: service-instance=EEVP_MonitoringManager_Consumer_SoaDriverSeat, tcp-port=55055, udp-port=55055
    EEVP_MonitoringManager_SomeipConsumers_MoodLamp: service-instance=EEVP_MonitoringManager_Consumer_MoodLamp, tcp-port=55061, udp-port=55061
    EEVP_MonitoringManager_SomeipConsumers_OtaMonitoring: service-instance=EEVP_MonitoringManager_Consumer_OtaMonitoring, tcp-port=55031, udp-port=55031
    EEVP_MonitoringManager_SomeipConsumers_PDW: service-instance=EEVP_MonitoringManager_Consumer_PDW, tcp-port=55081, udp-port=55081
    EEVP_MonitoringManager_SomeipConsumers_Power: service-instance=EEVP_MonitoringManager_Consumer_SoaPower, tcp-port=55045, udp-port=55045
    EEVP_MonitoringManager_SomeipConsumers_RearCurtain: service-instance=EEVP_MonitoringManager_Consumer_RearCurtain, tcp-port=55071, udp-port=55071
    EEVP_MonitoringManager_SomeipConsumers_Roa: service-instance=EEVP_MonitoringManager_Consumer_SoaRoa, tcp-port=55048, udp-port=55048
    EEVP_MonitoringManager_SomeipConsumers_StateManager: service-instance=EEVP_MonitoringManager_Consumer_StateManager, tcp-port=55051, udp-port=55051
    EEVP_MonitoringManager_SomeipConsumers_Wiper: service-instance=EEVP_MonitoringManager_Consumer_Wiper, tcp-port=55021, udp-port=55021
    EEVP_MonitoringManager_SomeipProviders_MonitoringManagement: service-instance=EEVP_MonitoringManager_Provider_MonitoringManagement, tcp-port=55011, udp-port=55011
package /ServiceInstance/Someip/Consumer
  9 x required someip service instance, all with required-minor-version=ANY, required-service-instance-id=ANY, version-driven-find-behavior=EXACT-OR-ANY-MINOR-VERSION:
    EEVP_MonitoringManager_Consumer_MoodLamp: service-interface-deployment=SoaMlm, sd-client-config=DefaultSdClientConfig
      method-request-propss:
        method=Get_soaMlmStatus
        RequestMlmSetBrightness
        RequestMlmSetMode
        RequestMlmSetRgbColor
        Get_soaMlmSwVersion
      someip required event group Eventgroup_Notification_soaMlmStatus: event-group=Eventgroup_Notification_soaMlmStatus, sd-client-event-group-timing-config=DefaultSdSubscribeConfig
      someip required event group Eventgroup_Notification_soaMlmVersion: event-group=Eventgroup_Notification_soaMlmSwVersion, sd-client-event-group-timing-config=DefaultSdSubscribeConfig
    EEVP_MonitoringManager_Consumer_OtaMonitoring: service-interface-deployment=OtaMonitoring, method-request-propss=[requestServiceInstall, requestServiceUpdate, requestVersionInfo, resetUcmTest], sd-client-config=DefaultSdClientConfig
      someip required event group Eventgroup_notifyServiceEvent: event-group=Eventgroup_notifyServiceEvent, sd-client-event-group-timing-config=DefaultSdSubscribeConfig
      someip required event group Eventgroup_notifyUpdatableService: event-group=Eventgroup_notifyUpdatableService, sd-client-event-group-timing-config=DefaultSdSubscribeConfig
    EEVP_MonitoringManager_Consumer_PDW: service-interface-deployment=Main_PDW_Service, sd-client-config=DefaultSdClientConfig
      someip required event group Eventgroup_DistanceLevel: event-group=Eventgroup_DistanceLevel, sd-client-event-group-timing-config=DefaultSdSubscribeConfig
    EEVP_MonitoringManager_Consumer_RearCurtain: service-interface-deployment=SoaRcurtain, method-request-propss=[method=Get_soaRctnStatus, Get_soaRctnSwVersion, RequestRearCurtainOperation, RequestRearCurtainPosition], sd-client-config=DefaultSdClientConfig
      someip required event group Eventgroup_Notification_soaRctnStatus: event-group=Eventgroup_Notification_soaRctnStatus, sd-client-event-group-timing-config=DefaultSdSubscribeConfig
      someip required event group Eventgroup_Notification_soaRctnSwVersion: event-group=Eventgroup_Notification_soaRctnSwVersion, sd-client-event-group-timing-config=DefaultSdSubscribeConfig
    EEVP_MonitoringManager_Consumer_SoaDriverSeat: service-interface-deployment=SoaDriverSeat, sd-client-config=DefaultSdClientConfig
      method-request-propss:
        Get_soaDrvSeatDeviceNormal
        Get_soaDrvSeatMotorDirection
        Get_soaDrvSeatMotorPosition
        Get_soaDrvSeatSwVersion
        RequestMoveDrvSeatHeight
        RequestMoveDrvSeatRecline
        RequestMoveDrvSeatSlide
        RequestMoveDrvSeatTilt
      4 x someip required event group, all with sd-client-event-group-timing-config=DefaultSdSubscribeConfig:
        Eventgroup_Notification_soaDrvSeatDeviceNormal: event-group=Eventgroup_Notification_soaDrvSeatDeviceNormal
        Eventgroup_Notification_soaDrvSeatMotorDirection: event-group=Eventgroup_Notification_soaDrvSeatMotorDirection
        Eventgroup_Notification_soaDrvSeatMotorPosition: event-group=Eventgroup_Notification_soaDrvSeatMotorPosition
        Eventgroup_Notification_soaDrvSeatSwVersion: event-group=Eventgroup_Notification_soaDrvSeatSwVersion
    EEVP_MonitoringManager_Consumer_SoaPower: service-interface-deployment=SoaPower, method-request-propss=[Get_soaPowerDeviceNormal, Get_soaPowerSwVersion], sd-client-config=DefaultSdClientConfig
      someip required event group Eventgroup_Notification_soaPowerDeviceNormal: event-group=Eventgroup_Notification_soaPowerDeviceNormal, sd-client-event-group-timing-config=DefaultSdSubscribeConfig
      someip required event group Eventgroup_Notify_soaPowerSwVersion: event-group=Eventgroup_Notify_soaPowerSwVersion, sd-client-event-group-timing-config=DefaultSdSubscribeConfig
    EEVP_MonitoringManager_Consumer_SoaRoa: service-interface-deployment=SoaRoa, sd-client-config=DefaultSdClientConfig
      method-request-propss:
        Get_soaRoaDetectCount
        Get_soaRoaDetectState
        Get_soaRoaDeviceNormal
        Get_soaRoaMode
        Get_soaRoaRunningState
        Get_soaRoaSensorError
        Get_soaRoaSwVersion
        ResetRoaDetectInfo
        SetRoaMode
        StartRoa
        StopRoa
      7 x someip required event group, all with sd-client-event-group-timing-config=DefaultSdSubscribeConfig:
        Eventgroup3_Notification_soaRoaDetectState: event-group=Eventgroup3_Notification_soaRoaDetectState
        Eventgroup_Notification_soaRoaDetectCount: event-group=Eventgroup_Notification_soaRoaDetectCount
        Eventgroup_Notification_soaRoaDeviceNormal: event-group=Eventgroup_Notification_soaRoaDeviceNormal
        Eventgroup_Notification_soaRoaMode: event-group=Eventgroup_Notification_soaRoaMode
        Eventgroup_Notification_soaRoaRunningState: event-group=Eventgroup_Notification_soaRoaRunningState
        Eventgroup_Notification_soaRoaSensorError: event-group=Eventgroup_Notification_soaRoaSensorError
        Eventgroup_Notification_soaRoaSwVersion: event-group=Eventgroup_Notification_soaRoaSwVersion
    EEVP_MonitoringManager_Consumer_StateManager: service-interface-deployment=StateManager, method-request-propss=[Get_NotifyTime, Set_NotifyTime, Get_SystemState], sd-client-config=DefaultSdClientConfig
      someip required event group Eventgroup_Notification: event-group=Eventgroup_Notification, sd-client-event-group-timing-config=DefaultSdSubscribeConfig
    EEVP_MonitoringManager_Consumer_Wiper: service-interface-deployment=SoaWiper, sd-client-config=DefaultClientConfig
      method-request-propss:
        Get_soaWiperDeviceNormal
        Get_soaWiperStatus
        Get_soaWiperSwVersion
        RequestWiperOperation
        SetWiperAutoSpeed
      someip required event group Eventgroup_Notification_isDeviceNormal: event-group=Eventgroup_Notification_soaWiperDeviceNormal, sd-client-event-group-timing-config=DefaultSdSubscribeConfig
      someip required event group Eventgroup_Notification_soaWiperStatus: event-group=Eventgroup_Notification_soaWiperStatus, sd-client-event-group-timing-config=DefaultSdSubscribeConfig
      someip required event group Eventgroup_Notification_soaWiperSwVersion: event-group=Eventgroup_Notification_soaWiperSwVersion, sd-client-event-group-timing-config=DefaultSdSubscribeConfig
package /ServiceInstance/Someip/Provider
  provided someip service instance EEVP_MonitoringManager_Provider_MonitoringManagement: service-interface-deployment=MonitoringManagement, sd-server-config=DefaultSdServerConfig, service-instance-id=1
    event-propss:
      eventServiceError
      eventServiceInfo
      eventServiceInfoSpare
      event=eventServiceStatus
      eventServiceStatusSpare
      eventUpdatableService
      Notify_soaWiperDeviceNormal
      Notify_soaWiperStatus
      Notify_soaWiperSwVersion
      Notify_soaMlmStatus
      Notify_soaMlmSwVersion
      Notify_soaRctnStatus
      Notify_soaRctnSwVersion
      DistanceLevel
      Notify_mbTemp
      Notify_soaDrvSeatDeviceNormal
      Notify_soaDrvSeatMotorDirection
      Notify_soaDrvSeatMotorPosition
      Notify_soaDrvSeatSwVersion
      Notify_soaRoaDetectCount
      Notify_soaRoaDetectState
      Notify_soaRoaDeviceNormal
      Notify_soaRoaMode
      Notify_soaRoaRunningState
      Notify_soaRoaSensorError
      Notify_soaRoaSwVersion
      Notify_soaPowerDeviceNormal
      Notify_soaPowerSwVersion
    method-response-propss:
      requestAppInstall
      requestAppUpdate
      requestControllerServiceInfo
      requestControllerServiceInfoAll
      method=requestControllerServiceInfoAllSpare
      requestControllerServiceStatus
      requestControllerServiceStatusAll
      requestControllerServiceStatusAllSpare
      setControlControllerService
      setEnableControllerService
      resetUcmTest
      RequestWiperOperation
      SetWiperAutoSpeed
      Get_soaWiperDeviceNormal
      Get_soaWiperStatus
      Get_soaWiperSwVersion
      method=Get_soaMlmStatus
      Get_soaMlmSwVersion
      Get_soaRctnStatus
      Get_soaRctnSwVersion
      RequestMlmSetRgbColor
      RequestRearCurtainOperation
      RequestRearCurtainPosition
      Get_mbTemp
      Get_soaDrvSeatDeviceNormal
      Get_soaDrvSeatMotorDirection
      Get_soaDrvSeatMotorPosition
      Get_soaDrvSeatSwVersion
      Get_soaRoaDetectCount
      Get_soaRoaDetectState
      Get_soaRoaDeviceNormal
      Get_soaRoaMode
      Get_soaRoaRunningState
      Get_soaRoaSensorError
      Get_soaRoaSwVersion
      RequestMoveDrvSeatHeight
      RequestMoveDrvSeatRecline
      RequestMoveDrvSeatSlide
      RequestMoveDrvSeatTilt
      ResetRoaDetectInfo
      SetRoaMode
      StartRoa
      StopRoa
    someip provided event group Eventgroup_eventService: event-group=Eventgroup_eventService, multicast-threshold=0
package /ServiceInterface
  service interface MonitoringManagement
    namespaces:
      symbol props eevp
      symbol props monitoring
      symbol props service
    events:
      7 x data:
        DistanceLevel: type=DistanceLevel
        eventServiceError: type=ControllerServiceErrorEvent
        eventServiceInfo: type=ControllerServiceInfoMap
        eventServiceInfoSpare: type=ControllerServiceInfoSpare
        eventServiceStatus: type=ControllerServiceStatusMap
        eventServiceStatusSpare: type=ControllerServiceStatusSpare
        eventUpdatableService: type=UpdatableServiceList
    21 x field, all with has-getter=true, has-notifier=true, has-setter=false:
      mbTemp: type=String
      soaDrvSeatDeviceNormal: type=SoaDeviceIsNormal
      soaDrvSeatMotorDirection: type=SoaSeatMotorDirection
      soaDrvSeatMotorPosition: type=SoaSeatMotorPosition
      soaDrvSeatSwVersion: type=uint8_t
      soaMlmStatus: type=SoaMlmStatus
      soaMlmSwVersion: type=uint8_t
      soaPowerDeviceNormal: type=SoaDeviceIsNormal
      soaPowerSwVersion: type=uint8_t
      soaRctnStatus: type=SoaRctnStatus
      soaRctnSwVersion: type=uint8_t
      soaRoaDetectCount: type=uint8_t
      soaRoaDetectState: type=SoaRoaDetectState
      soaRoaDeviceNormal: type=SoaDeviceIsNormal
      soaRoaMode: type=SoaRoaMode
      soaRoaRunningState: type=SoaRoaRunningState
      soaRoaSensorError: type=SoaRoaSensorError
      soaRoaSwVersion: type=uint8_t
      soaWiperDeviceNormal: type=SoaDeviceIsNormal
      soaWiperStatus: type=SoaWiperStatus
      soaWiperSwVersion: type=uint8_t
    methods:
      24 x operation, all with fire-and-forget=false:
        RequestMlmSetRgbColor
          arg colorTableIndex: type=uint8_t, direction=IN
        RequestMoveDrvSeatHeight
          arg dir: type=SoaSeatHeightDirection, direction=IN
        RequestMoveDrvSeatRecline
          arg dir: type=SoaSeatReclineDirection, direction=IN
        RequestMoveDrvSeatSlide
          arg dir: type=SoaSeatSlideDirection, direction=IN
        RequestMoveDrvSeatTilt
          arg dir: type=SoaSeatTiltDirection, direction=IN
        RequestRearCurtainOperation
          arg motorDir: type=SoaRctnMotorDir, direction=IN
          arg err: type=SoaErrorState, direction=OUT
        RequestRearCurtainPosition
          arg posPercentage: type=uint8_t, direction=IN
        RequestWiperOperation
          arg mode: type=SoaWiperMode, direction=IN
        ResetRoaDetectInfo
        SetRoaMode
          arg mode: type=SoaRoaMode, direction=IN
        SetWiperAutoSpeed
          arg isAutoSpeed: type=bool, direction=IN
        StartRoa
        StopRoa
        requestAppInstall
          arg controllerServiceName: type=String, direction=IN
          arg returnValue: type=bool, direction=OUT
        requestAppUpdate
          arg controllerServiceName: type=String, direction=IN
          arg returnValue: type=bool, direction=OUT
        requestControllerServiceInfo
          arg controllerServiceName: type=String, direction=IN
          arg controllerServiceInfo: type=ControllerServiceInfo, direction=OUT
          arg returnValue: type=bool, direction=OUT
        requestControllerServiceInfoAll
          arg controllerServiceInfoMap: type=ControllerServiceInfoMap, direction=OUT
          arg returnValue: type=bool, direction=OUT
        requestControllerServiceInfoAllSpare
          arg serviceName: type=StringArray, direction=OUT
          arg version: type=StringArray, direction=OUT
          arg lastUpdateTime: type=TimeArray, direction=OUT
        requestControllerServiceStatus
          arg controllerServiceName: type=String, direction=IN
          arg controllerServiceStatus: type=String, direction=OUT
          arg returnValue: type=bool, direction=OUT
        requestControllerServiceStatusAll
          arg controllerServiceStatusMap: type=ControllerServiceStatusMap, direction=OUT
          arg returnValue: type=bool, direction=OUT
        requestControllerServiceStatusAllSpare
          4 x arg, all with type=StringArray, direction=OUT:
            serviceName
            serviceStatus
            serviceEnable
            serviceControl
        resetUcmTest
        setControlControllerService
          arg serviceName: type=String, direction=IN
          arg serviceControl: type=String, direction=IN
          arg returnValue: type=bool, direction=OUT
        setEnableControllerService
          arg controllerServiceName: type=String, direction=IN
          arg enable: type=String, direction=IN
          arg returnValue: type=bool, direction=OUT
