AUTOSAR XML (schema 00049)
package /DataType/CppImplementationType
  9 x std cpp implementation data type:
    BCM_ReturnCode: compu {0=SUCCESS, 1=FAIL_WORKING_CONDITION_UNFULFILLED, 2=FAIL_HIGHER_PRIORITY_TASK_ONGOING, 3=FAIL_FUNCTION_UNAVAILABLE, 4=FAIL_INVALID_SOURCE_ID, 5=FAIL_DEVICE_ABNORMAL, 6=FAIL_POWER_SHORTAGE, 7=FAIL_TIMEOUT, 8=FAIL_OVERHEATING, 9=FAIL_OUT_OF_RANGE, 10=FAIL_ANTIPLAY, 11=FAIL_DRAG, 12=FAIL_OVERCURRENT, 13=FAIL_NOTLEARNED, 255=FAIL_OTHERS}, type-reference=uint8_t
      namespaces:
        symbol props eevp
        symbol props simulation
    BCM_WipingLevel: compu {0=LOW, 1=MEDIUM, 2=HIGH}, type-reference=uint8_t
      namespaces:
        symbol props eevp
        symbol props simulation
    DirectionVeh: compu {0x00=FORWARD, 0x01=BACKWARD, 0x02=UNKNOWN}, type-reference=uint8_t
      namespaces:
        symbol props eevp
        symbol props simulation
    GearStatus: compu {0x00=DEFAULT, 0x01=P, 0x02=R, 0x03=N, 0x04=D}, type-reference=uint8_t
      namespaces:
        symbol props eevp
        symbol props simulation
    SwitchStatus: compu {0x00=UNPRESSED, 0x01=PRESSED}, type-reference=uint8_t
      namespaces:
        symbol props eevp
        symbol props simulation
    VCS_AccrPedal: category=STRUCTURE
      namespaces:
        symbol props eevp
        symbol props simulation
      cpp implementation data type element valid: type-reference=bool
      cpp implementation data type element switchStatus: type-reference=SwitchStatus
    VCS_BrakeSwitch: category=STRUCTURE
      namespaces:
        symbol props eevp
        symbol props simulation
      cpp implementation data type element switchStatus: type-reference=SwitchStatus
      cpp implementation data type element switchValid: type-reference=bool
    VCS_Gear: category=STRUCTURE
      namespaces:
        symbol props eevp
        symbol props simulation
      cpp implementation data type element GearStatus: type-reference=GearStatus
      cpp implementation data type element valid: type-reference=bool
    VCS_VehSpd: category=STRUCTURE
      namespaces:
        symbol props eevp
        symbol props simulation
      5 x cpp implementation data type element:
        absoluteValue: type-reference=int32_t
        actualValue: type-reference=int32_t
        direction: type-reference=DirectionVeh
        directionValid: type-reference=bool
        valid: type-reference=bool
