AUTOSAR XML (schema 00049)
package /AdaptiveApplication/DltConfig
  dlt log channel to process mapping DltLogChannelToProcessMapping_SESLService_TO_SESLService: dlt-log-channel=SESLService, process=SESLService
package /AdaptiveApplication/Executable
  executable SESLService: category=APPLICATION_LEVEL, logging-behavior=USES-LOGGING, reporting-behavior=REPORTS-EXECUTION-STATE, version=1.0.0
    root sw component prototype AA: application-type=AA
package /AdaptiveApplication/Process
  process SESLService: executable=SESLService, state-dependent-startup-config{execution-dependency=ServiceCreator.Running, function-group-state=MachineFG.Startup, resource-group=DefaultResourceGroup, startup-config=SESLService}
    process state machine SESLService: type=ProcessState
package /AdaptiveApplication/StartupConfig
  startup config set EEVP_SESLService
    startup config SESLService: scheduling-policy=SCHED_OTHER, scheduling-priority=0
package /AdaptiveApplication/SwComponent
  adaptive application sw component type AA
    require port RPort_SESLService: required-interface=SESL_ServiceInterface
package /DataType/Implementation/CPP
  std cpp implementation data type Vehicle_Data: category=STRUCTURE
    namespaces:
      symbol props ara
      symbol props SESL
    7 x cpp implementation data type element:
      Fwd_Distance: type-reference=double
      Rear_Distance: type-reference=double
      Accel: type-reference=bool
      Brake: type-reference=double
      Beep: type-reference=bool
      Beep_Large: type-reference=bool
      Light: type-reference=double
package /PortInterface/Service
  service instance to port prototype mapping SESLService_AA_RPort_SESLService: port-prototype=AA.RPort_SESLService, service-instance=EEVP_SESL_Consumer_ServiceInterface
package /System/Service/Deployment
  someip service interface deployment SESL_ServiceInterface: service-interface=SESL_ServiceInterface, service-interface-id=21, service-interface-version={major-version=1, minor-version=0}
    someip method deployment SESL_Receive: method=SESL_Receive, method-id=1, transport-protocol=UDP
    someip method deployment SESL_Send: method=SESL_Send, method-id=2, transport-protocol=UDP
package /System/Service/Endpoint
  someip service instance to machine mapping EEVP_SESL_SomeipConsumers_ServiceInterface: communication-connector=eth0, service-instance=EEVP_SESL_Consumer_ServiceInterface, tcp-port=50131, udp-port=50131
package /System/Service/Instance
  required someip service instance EEVP_SESL_Consumer_ServiceInterface: service-interface-deployment=SESL_ServiceInterface, method-request-propss=[SESL_Receive, SESL_Send], required-minor-version=ANY, required-service-instance-id=ANY, sd-client-config=DefaultSdClientConfig, version-driven-find-behavior=EXACT-OR-ANY-MINOR-VERSION
  service interface SESL_ServiceInterface: major-version=1, minor-version=0
    namespaces:
      symbol props ara
      symbol props com
    methods:
      operation SESL_Receive: fire-and-forget=false
        arg Receive_Argument: type=Vehicle_Data, direction=OUT
      operation SESL_Send: fire-and-forget=true
        arg Send_Argument: type=Vehicle_Data, direction=IN
