AUTOSAR XML (schema 00049)
package /ServiceDeployment/Someip
  someip service interface deployment MonitoringManagement: service-interface=MonitoringManagement, service-interface-id=4881, service-interface-version={major-version=1, minor-version=0}
    6 x someip event deployment, all with transport-protocol=UDP:
      eventServiceError: event=eventServiceError, event-id=3
      eventServiceInfo: event=eventServiceInfo, event-id=1
      eventServiceInfoSpare: event=eventServiceInfoSpare, event-id=4
      eventServiceStatus: event=eventServiceStatus, event-id=2
      eventServiceStatusSpare: event=eventServiceStatusSpare, event-id=5
      eventUpdatableService: event=eventUpdatableService, event-id=6
    11 x someip method deployment, all with transport-protocol=UDP:
      requestAppInstall: method=requestAppInstall, method-id=1
      requestAppUpdate: method=requestAppUpdate, method-id=2
      requestControllerServiceInfo: method=requestControllerServiceInfo, method-id=3
      requestControllerServiceInfoAll: method=requestControllerServiceInfoAll, method-id=4
      requestControllerServiceInfoAllSpare: method=requestControllerServiceInfoAllSpare, method-id=8
      requestControllerServiceStatus: method=requestControllerServiceStatus, method-id=5
      requestControllerServiceStatusAll: method=requestControllerServiceStatusAll, method-id=6
      requestControllerServiceStatusAllSpare: method=requestControllerServiceStatusAllSpare, method-id=9
      resetUcmTest: method=resetUcmTest, method-id=12
      setControlControllerService: method=setControlControllerService, method-id=10
      setEnableControllerService: method=setEnableControllerService, method-id=7
    someip event group Eventgroup_eventService: event-group-id=3, event=[eventServiceError, eventServiceInfoSpare, eventServiceStatusSpare, eventUpdatableService]
    someip event group Eventgroup_eventServiceInfo: event-group-id=1, event=eventServiceInfo
    someip event group Eventgroup_eventServiceStatus: event-group-id=2, event=eventServiceStatus
package /ServiceInstance/Endpoint
  5 x someip service instance to machine mapping, all with communication-connector=eth0:
    EEVP_MonitoringManager_SomeipConsumers_MoodLamp: service-instance=EEVP_MonitoringManager_Consumer_MoodLamp, tcp-port=55061, udp-port=55061
    EEVP_MonitoringManager_SomeipConsumers_OtaMonitoring: service-instance=EEVP_MonitoringManager_Consumer_OtaMonitoring, tcp-port=55031, udp-port=55031
    EEVP_MonitoringManager_SomeipConsumers_RearCurtain: service-instance=EEVP_MonitoringManager_Consumer_RearCurtain, tcp-port=55071, udp-port=55071
    EEVP_MonitoringManager_SomeipConsumers_StateManager: service-instance=EEVP_MonitoringManager_Consumer_StateManager, tcp-port=55051, udp-port=55051
    EEVP_MonitoringManager_SomeipProviders_MonitoringManagement: service-instance=EEVP_MonitoringManager_Provider_MonitoringManagement, tcp-port=50011, udp-port=50011
package /ServiceInstance/Someip/Consumer
  4 x required someip service instance, all with required-minor-version=ANY, required-service-instance-id=ANY, sd-client-config=DefaultSdClientConfig, version-driven-find-behavior=EXACT-OR-ANY-MINOR-VERSION:
    EEVP_MonitoringManager_Consumer_MoodLamp: service-interface-deployment=SoaMlm, method-request-propss=[method=Get_soaMlmStatus, RequestMlmSetBrightness, RequestMlmSetMode, RequestMlmSetRgbColor]
      someip required event group Eventgroup_Notification_soaMlmStatus: event-group=Eventgroup_Notification_soaMlmStatus, sd-client-event-group-timing-config=DefaultSdSubscribeConfig
    EEVP_MonitoringManager_Consumer_OtaMonitoring: service-interface-deployment=OtaMonitoring, method-request-propss=[requestServiceInstall, requestServiceUpdate, requestVersionInfo, resetUcmTest]
      someip required event group Eventgroup_notifyServiceEvent: event-group=Eventgroup_notifyServiceEvent, sd-client-event-group-timing-config=DefaultSdSubscribeConfig
      someip required event group Eventgroup_notifyUpdatableService: event-group=Eventgroup_notifyUpdatableService, sd-client-event-group-timing-config=DefaultSdSubscribeConfig
    EEVP_MonitoringManager_Consumer_RearCurtain: service-interface-deployment=SoaRcurtain, method-request-propss=[method=Get_soaRctnStatus, RequestRearCurtainOperation]
      someip required event group Eventgroup_Notification_soaRctnStatus: event-group=Eventgroup_Notification_soaRctnStatus, sd-client-event-group-timing-config=DefaultSdSubscribeConfig
    EEVP_MonitoringManager_Consumer_StateManager: service-interface-deployment=StateManager, method-request-propss=[Get_NotifyTime, Set_NotifyTime, Get_SystemState]
      someip required event group Eventgroup_Notification: event-group=Eventgroup_Notification, sd-client-event-group-timing-config=DefaultSdSubscribeConfig
package /ServiceInstance/Someip/Provider
  provided someip service instance EEVP_MonitoringManager_Provider_MonitoringManagement: service-interface-deployment=MonitoringManagement, sd-server-config=DefaultSdServerConfig, service-instance-id=1
    event-propss:
      eventServiceError
      eventServiceInfo
      eventServiceInfoSpare
      event=eventServiceStatus
      eventServiceStatusSpare
      eventUpdatableService
    method-response-propss:
      requestAppInstall
      requestAppUpdate
      requestControllerServiceInfo
      requestControllerServiceInfoAll
      requestControllerServiceInfoAllSpare
      requestControllerServiceStatus
      requestControllerServiceStatusAll
      requestControllerServiceStatusAllSpare
      setControlControllerService
      setEnableControllerService
      resetUcmTest
    someip provided event group Eventgroup_eventService: event-group=Eventgroup_eventService, multicast-threshold=0
    someip provided event group Eventgroup_eventServiceInfo: event-group=Eventgroup_eventServiceInfo, multicast-threshold=0
    someip provided event group Eventgroup_eventServiceStatus: event-group=Eventgroup_eventServiceStatus, multicast-threshold=0
package /ServiceInterface
  service interface MonitoringManagement
    namespaces:
      symbol props eevp
      symbol props monitoring
      symbol props service
    events:
      6 x data:
        eventServiceError: type=ControllerServiceErrorEvent
        eventServiceInfo: type=ControllerServiceInfoMap
        eventServiceInfoSpare: type=ControllerServiceInfoSpare
        eventServiceStatus: type=ControllerServiceStatusMap
        eventServiceStatusSpare: type=ControllerServiceStatusSpare
        eventUpdatableService: type=UpdatableServiceList
    methods:
      11 x operation, all with fire-and-forget=false:
        requestAppInstall
          arg controllerServiceName: type=String, direction=IN
          arg returnValue: type=bool, direction=OUT
        requestAppUpdate
          arg controllerServiceName: type=String, direction=IN
          arg returnValue: type=bool, direction=OUT
        requestControllerServiceInfo
          arg controllerServiceName: type=String, direction=IN
          arg controllerServiceInfo: type=ControllerServiceInfo, direction=OUT
          arg returnValue: type=bool, direction=OUT
        requestControllerServiceInfoAll
          arg controllerServiceInfoMap: type=ControllerServiceInfoMap, direction=OUT
          arg returnValue: type=bool, direction=OUT
        requestControllerServiceInfoAllSpare
          arg serviceName: type=StringArray, direction=OUT
          arg version: type=StringArray, direction=OUT
          arg lastUpdateTime: type=TimeArray, direction=OUT
        requestControllerServiceStatus
          arg controllerServiceName: type=String, direction=IN
          arg controllerServiceStatus: type=String, direction=OUT
          arg returnValue: type=bool, direction=OUT
        requestControllerServiceStatusAll
          arg controllerServiceStatusMap: type=ControllerServiceStatusMap, direction=OUT
          arg returnValue: type=bool, direction=OUT
        requestControllerServiceStatusAllSpare
          4 x arg, all with type=StringArray, direction=OUT:
            serviceName
            serviceStatus
            serviceEnable
            serviceControl
        resetUcmTest
        setControlControllerService
          arg serviceName: type=String, direction=IN
          arg serviceControl: type=String, direction=IN
          arg returnValue: type=bool, direction=OUT
        setEnableControllerService
          arg controllerServiceName: type=String, direction=IN
          arg enable: type=String, direction=IN
          arg returnValue: type=bool, direction=OUT
