AUTOSAR XML (schema 00049)
package /ServiceInstance/Endpoint
  someip service instance to machine mapping EEVP_IntelligentWiper_SomeipConsumers_BCM_WiperWash: communication-connector=eth0, service-instance=EEVP_IntelligentWiper_Consumer_BCM_WiperWash, tcp-port=50411, udp-port=50411
package /ServiceInstance/Someip/Consumer
  required someip service instance EEVP_IntelligentWiper_Consumer_BCM_WiperWash: service-interface-deployment=BCM_WiperWash, required-minor-version=ANY, required-service-instance-id=ANY, sd-client-config=DefaultClientConfig, version-driven-find-behavior=EXACT-OR-ANY-MINOR-VERSION
    method-request-propss:
      Get_wiperInterval
      Get_wiperLevel
      getWipingInterval
      getWipingLevel
      isWiping
      setWipingInterval
      setWipingLevel
      setWipingLevelImme
      startWiping
      stopWiping
    someip required event group Eventgroup_WiperInterval: event-group=Eventgroup_Notification_wiperInterval, sd-client-event-group-timing-config=DefaultSdSubscribeConfig
    someip required event group Eventgroup_WiperLevel: event-group=Eventgroup_Notification_wiperLevel, sd-client-event-group-timing-config=DefaultSdSubscribeConfig
