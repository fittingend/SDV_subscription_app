AUTOSAR XML (schema 00049)
package /DataType/CppImplementationType
  std cpp implementation data type Direction: compu {0x01=kFront, 0x02=kRear}, type-reference=uint8_t
    namespaces:
      symbol props eevp
      symbol props pdw
      symbol props type
  std cpp implementation data type DistanceLevel: category=STRUCTURE
    namespaces:
      symbol props eevp
      symbol props pdw
      symbol props type
    4 x cpp implementation data type element:
      Left: type-reference=uint8_t
      Right: type-reference=uint8_t
      Center: type-reference=uint8_t
      SensorDirection: type-reference=Direction
