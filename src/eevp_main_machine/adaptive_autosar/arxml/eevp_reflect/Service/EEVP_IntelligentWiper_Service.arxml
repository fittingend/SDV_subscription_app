AUTOSAR XML (schema 00049)
package /ServiceInstance/Endpoint
  6 x someip service instance to machine mapping, all with communication-connector=eth0:
    EEVP_IntelligentWiper_SomeipConsumers_BCM_WiperWash: service-instance=EEVP_IntelligentWiper_Consumer_BCM_WiperWash, tcp-port=50411, udp-port=50411
    EEVP_IntelligentWiper_SomeipConsumers_Snsr_Uss: service-instance=EEVP_IntelligentWiper_Consumer_Snsr_USS, tcp-port=50416, udp-port=50416
    EEVP_IntelligentWiper_SomeipConsumers_VCS_AccelPedal: service-instance=EEVP_IntelligentWiper_Consumer_VCS_AccrPedal, tcp-port=50413, udp-port=50413
    EEVP_IntelligentWiper_SomeipConsumers_VCS_BrakePedal: service-instance=EEVP_IntelligentWiper_Consumer_VCS_BrakePedal, tcp-port=50414, udp-port=50414
    EEVP_IntelligentWiper_SomeipConsumers_VCS_Gear: service-instance=EEVP_IntelligentWiper_Consumer_VCS_Gear, tcp-port=50412, udp-port=50412
    EEVP_IntelligentWiper_SomeipConsumers_VCS_VehSpd: service-instance=EEVP_IntelligentWiper_Consumer_VCS_VehSpd, tcp-port=50415, udp-port=50415
package /ServiceInstance/Someip/Consumer
  6 x required someip service instance, all with required-minor-version=ANY, required-service-instance-id=ANY, sd-client-config=DefaultSdClientConfig:
    EEVP_IntelligentWiper_Consumer_BCM_WiperWash: service-interface-deployment=BCM_WiperWash, method-request-propss=[Get_wiperInterval, method=Get_wiperLevel, setWipingInterval, setWipingLevel, startWiping, stopWiping]
      someip required event group Eventgroup_Notification_wiperInterval: event-group=Eventgroup_Notification_wiperInterval, sd-client-event-group-timing-config=DefaultSdSubscribeConfig
      someip required event group Eventgroup_Notification_wiperLevel: event-group=Eventgroup_Notification_wiperLevel, sd-client-event-group-timing-config=DefaultSdSubscribeConfig
    EEVP_IntelligentWiper_Consumer_Snsr_USS: service-interface-deployment=Snsr_USS, method-request-propss=[ntfFltSt, ntfSonarInfo, isDetect], version-driven-find-behavior=EXACT-OR-ANY-MINOR-VERSION
    EEVP_IntelligentWiper_Consumer_VCS_AccrPedal: service-interface-deployment=VCS_AccrPedal, someip-method-props=notifyAccrPedal
    EEVP_IntelligentWiper_Consumer_VCS_BrakePedal: service-interface-deployment=VCS_BrakePedal, method-request-propss=[nofityBrakeSwitch, notifyBrakeStatus]
    EEVP_IntelligentWiper_Consumer_VCS_Gear: service-interface-deployment=VCS_Gear, method-request-propss=[notifyGear, setTarget]
    EEVP_IntelligentWiper_Consumer_VCS_VehSpd: service-interface-deployment=VCS_VehSpd, someip-method-props=notifyVehSpd
