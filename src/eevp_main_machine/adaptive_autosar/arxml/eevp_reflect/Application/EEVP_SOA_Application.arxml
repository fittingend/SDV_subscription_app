AUTOSAR XML (schema 00049)
package /Application/StartupConfig
  startup config set EEVP_SOA_StartupConfig
    startup config SOA: scheduling-policy=SCHED_OTHER, scheduling-priority=0, termination-behavior=PROCESS-IS-SELF-TERMINATING
