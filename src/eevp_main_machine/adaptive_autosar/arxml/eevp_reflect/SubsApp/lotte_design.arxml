AUTOSAR XML (schema 00049)
package /DataType/Implementation/CPP
  15 x std cpp implementation data type:
    DmsGzDtctn: category=STRUCTURE
      namespaces:
        symbol props lotte
        symbol props type
      15 x cpp implementation data type element:
        headLocX: type-reference=uint8_t
        headLocY: type-reference=uint8_t
        headLocZ: type-reference=uint8_t
        eyeLocRightX: type-reference=uint8_t
        eyeLocRightY: type-reference=uint8_t
        eyeLocRightZ: type-reference=uint8_t
        eyeLocLeftX: type-reference=uint8_t
        eyeLocLeftY: type-reference=uint8_t
        eyeLocLeftZ: type-reference=uint8_t
        headDirPitch: type-reference=uint8_t
        headDirYaw: type-reference=uint8_t
        gazeDirPitch: type-reference=uint8_t
        gazeDirYaw: type-reference=uint8_t
        gazeZone: type-reference=GazaZone
        headZone: type-reference=HeadZone
    GazaZone: compu {0x0=INFOTAINMENT, 0x1=FRONT_WINDSHIELD, 0x2=DRIVER_SIDE_MIRROR, 0x3=PASSENGER_SIDE_MIRROR, 0x4=BACK_MIRROR}, type-reference=uint8_t
      namespaces:
        symbol props lotte
        symbol props type
    HeadZone: compu {0x0=INFOTAINMENT, 0x1=FRONT_WINDSHIELD, 0x2=DRIVER_SIDE_MIRROR, 0x3=PASSENGER_SIDE_MIRROR, 0x4=BACK_MIRROR}, type-reference=uint8_t
      namespaces:
        symbol props lotte
        symbol props type
    SideTransparency: category=STRUCTURE
      namespaces:
        symbol props lotte
        symbol props type
      5 x cpp implementation data type element:
        isChanged: type-reference=bool
        zone: type-reference=uint8_t
        initTransparency: type-reference=uint8_t
        currTransparency: type-reference=uint8_t
        remainingTime: type-reference=uint16_t
    bool: category=VALUE, type-emitter=FundamentalType
    double: category=VALUE, type-emitter=FundamentalType
    float: category=VALUE, type-emitter=FundamentalType
    int16_t: category=VALUE, header-file=cstdint
    int32_t: category=VALUE, header-file=cstdint
    int64_t: category=VALUE, header-file=cstdint
    int8_t: category=VALUE, header-file=cstdint
    uint16_t: category=VALUE, header-file=cstdint
    uint32_t: category=VALUE, header-file=cstdint
    uint64_t: category=VALUE, header-file=cstdint
    uint8_t: category=VALUE, header-file=cstdint
package /DataType/Semantics/CompuMethod
  compu method OnOffType: 0x0=FALSE, 0x1=TRUE
package /PortInterface/Service
  service interface LotteService
    namespaces:
      symbol props lotte
      symbol props service
    methods:
      5 x operation, all with fire-and-forget=false:
        DmsCurr
          arg result: type=DmsGzDtctn, direction=OUT
        DmsStatus
          arg result: type=bool, direction=OUT
        SmartFilmControl
          arg windowLoc: type=int32_t, direction=IN
          arg transparence: type=int32_t, direction=IN
          arg result: type=bool, direction=OUT
        SmartFilmCurr
          arg result: type=int32_t, direction=OUT
        SmartFilmStatus
          arg result: type=bool, direction=OUT
package /System/Service/Deployment
  someip service interface deployment LotteService: service-interface=LotteService, service-interface-id=31, service-interface-version={major-version=1, minor-version=0}
    5 x someip method deployment, all with transport-protocol=UDP:
      DmsCurr: method=DmsCurr, method-id=1
      DmsStatus: method=DmsStatus, method-id=2
      SmartFilmControl: method=SmartFilmControl, method-id=4
      SmartFilmCurr: method=SmartFilmCurr, method-id=5
      SmartFilmStatus: method=SmartFilmStatus, method-id=3
package /System/Service/Endpoint
  someip service instance to machine mapping SomeipConsumers: communication-connector=eth0, service-instance=Consumer_LotteService, tcp-port=35555, udp-port=35555
  someip service instance to machine mapping SomeipProviders: communication-connector=eth0, service-instance=Provider_LotteService, tcp-port=33333, udp-port=33333
package /System/Service/Instance
  required someip service instance Consumer_LotteService: service-interface-deployment=LotteService, method-request-propss=[DmsCurr, DmsStatus, SmartFilmStatus, SmartFilmControl], required-minor-version=ANY, required-service-instance-id=ANY, sd-client-config=SdClientConfig, version-driven-find-behavior=EXACT-OR-ANY-MINOR-VERSION
  provided someip service instance Provider_LotteService: service-interface-deployment=LotteService, method-response-propss=[DmsCurr, DmsStatus, SmartFilmStatus, SmartFilmControl], sd-server-config=SdServerConfig, service-instance-id=1
package /System/Service/TimingConfig
  someip sd client service instance config SdClientConfig: initial-find-behavior={initial-delay-max-value=0.1, initial-delay-min-value=0.01, initial-repetitions-base-delay=0.2, initial-repetitions-max=3}, service-find-time-to-live=16777215
  someip sd server service instance config SdServerConfig: initial-offer-behavior={initial-delay-max-value=0.1, initial-delay-min-value=0.01, initial-repetitions-base-delay=0.2, initial-repetitions-max=3}, offer-cyclic-delay=1.0, request-response-delay={max-value=0.0, min-value=0.0}, service-offer-time-to-live=16777215
package /System/VehicleTopology/Cluster
  ethernet cluster EthernetCluster
    ethernet physical channel PhysicalChannel: category=WIRED, comm-connectors=eth0
      network endpoint EcuEndpoint: network-endpoint-addresses=ipv-4-configuration={ipv-4-address=10.0.2.15, ipv-4-address-source=FIXED}
      network endpoint SdMulticast: network-endpoint-addresses=ipv-4-configuration={ipv-4-address=224.0.0.1, ipv-4-address-source=FIXED}
package /System/VehicleTopology/Ecu
  machine design Ecu: service-discover-configs=someip-service-discovery={multicast-sd-ip-address=SdMulticast, someip-service-discovery-port=30490}
    user defined communication connector IPC
    ethernet communication connector eth0: unicast-network-endpoint=EcuEndpoint
