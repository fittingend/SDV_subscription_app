AUTOSAR XML (schema 00049)
package /ServiceDeployment/Someip
  25 x someip service interface deployment, all with service-interface-version={major-version=1, minor-version=0}:
    BCM_Horn: service-interface=BCM_Horn, service-interface-id=9030
      someip method deployment Alert: method=Alert, method-id=3, transport-protocol=UDP
      someip method deployment start: method=start, method-id=1, transport-protocol=UDP
      someip method deployment stop: method=stop, method-id=2, transport-protocol=UDP
    BCM_WiperWash: service-interface=BCM_WiperWash, service-interface-id=9005
      someip field deployment wiperInterval: field=BCM_WiperWash/wiperInterval
        get Get_wiperInterval: method-id=13, transport-protocol=UDP
        notifier Notification_wiperInterval: event-id=14, transport-protocol=UDP
      someip field deployment wiperLevel: field=BCM_WiperWash/wiperLevel
        get Get_wiperLevel: method-id=11, transport-protocol=UDP
        notifier Notification_wiperLevel: event-id=12, transport-protocol=UDP
      8 x someip method deployment, all with transport-protocol=UDP:
        getWipingInterval: method=BCM_WiperWash/getWipingInterval, method-id=8
        getWipingLevel: method=BCM_WiperWash/getWipingLevel, method-id=7
        isWiping: method=BCM_WiperWash/isWiping, method-id=1
        setWipingInterval: method=BCM_WiperWash/setWipingInterval, method-id=2
        setWipingLevel: method=BCM_WiperWash/setWipingLevel, method-id=3
        setWipingLevelImme: method=BCM_WiperWash/setWipingLevelImme, method-id=4
        startWiping: method=BCM_WiperWash/startWiping, method-id=5
        stopWiping: method=BCM_WiperWash/stopWiping, method-id=6
      someip event group Eventgroup_WiperInterval: event-group-id=2, event=Notification_wiperInterval
      someip event group Eventgroup_WiperLevel: event-group-id=1, event=Notification_wiperLevel
    BmsInfoSrv: service-interface=BmsInfoSrv, service-interface-id=9020
      someip event deployment ems_BmsInfo: event=ems_BmsInfo, event-id=1, transport-protocol=UDP
      someip event group Eventgroup_ems_BmsInfo: event-group-id=1, event=ems_BmsInfo
    Ctrl_MoodLamp: service-interface=Ctrl_MoodLamp, service-interface-id=9048
      8 x someip method deployment, all with transport-protocol=UDP:
        getBrightness: method=getBrightness, method-id=5
        getColor: method=getColor, method-id=7
        getPowerStatus: method=getPowerStatus, method-id=3
        setBrightness: method=setBrightness, method-id=6
        setColor: method=setColor, method-id=8
        setPowerStatus: method=setPowerStatus, method-id=4
        turnOff: method=Ctrl_MoodLamp/turnOff, method-id=2
        turnOn: method=Ctrl_MoodLamp/turnOn, method-id=1
    Ctrl_RearCurtain: service-interface=Ctrl_RearCurtain, service-interface-id=9049
      someip method deployment getOpeningRate: method=getOpeningRate, method-id=1, transport-protocol=UDP
      someip method deployment setOpeningRate: method=setOpeningRate, method-id=2, transport-protocol=UDP
    DMS_Func: service-interface=DMS_Func, service-interface-id=9047
      someip method deployment isDetectDrowsy: method=isDetectDrowsy, method-id=1, transport-protocol=UDP
    EevpControlSoaMlm: service-interface=EevpControlSoaMlm, service-interface-id=9022
      someip method deployment RequestMlmSetBrightness: method=RequestMlmSetBrightness, method-id=2, transport-protocol=UDP
      someip method deployment RequestMlmSetRGBColor: method=RequestMlmSetRGBColor, method-id=1, transport-protocol=UDP
    MsgInfoSrv: service-interface=MsgInfoSrv, service-interface-id=9021
      someip event deployment T_MSGINFO: event=T_MSGINFO, event-id=2, transport-protocol=UDP
      someip event deployment ems_MsgInfo: event=ems_MsgInfo, event-id=1, transport-protocol=UDP
      someip event group Eventgroup_T_MSGINFO: event-group-id=2, event=T_MSGINFO
      someip event group Eventgroup_ems_MsgInfo: event-group-id=1, event=ems_MsgInfo
    ServiceManagement: service-interface=ServiceManagement, service-interface-id=9000
      4 x someip field deployment:
        wiperInterval: field=ServiceManagement/wiperInterval
          get Get_wiperInterval: method-id=13, transport-protocol=UDP
          notifier Notify_wiperInterval: event-id=14, transport-protocol=UDP
        wiperLevel: field=ServiceManagement/wiperLevel
          get Get_wiperLevel: method-id=11, transport-protocol=UDP
          notifier Notify_wiperLevel: event-id=12, transport-protocol=UDP
        wiperRecv: field=wiperRecv
          get Get_wiperRecv: method-id=15, transport-protocol=UDP
          notifier Notify_wiperRecv: event-id=16, transport-protocol=UDP
        wiperSend: field=wiperSend
          get Get_wiperSend: method-id=17, transport-protocol=UDP
          notifier Notify_wiperSend: event-id=18, transport-protocol=UDP
      8 x someip method deployment, all with transport-protocol=UDP:
        getWipingInterval: method=ServiceManagement/getWipingInterval, method-id=8
        getWipingLevel: method=ServiceManagement/getWipingLevel, method-id=7
        isWiping: method=ServiceManagement/isWiping, method-id=1
        setWipingInterval: method=ServiceManagement/setWipingInterval, method-id=6
        setWipingLevel: method=ServiceManagement/setWipingLevel, method-id=4
        setWipingLevelImme: method=ServiceManagement/setWipingLevelImme, method-id=5
        startWiping: method=ServiceManagement/startWiping, method-id=3
        stopWiping: method=ServiceManagement/stopWiping, method-id=2
      someip event group Eventgroup_wiperEvent: event-group-id=1, event=[Notify_wiperInterval, Notify_wiperLevel, Notify_wiperRecv, Notify_wiperSend]
    SmartFilmCont: service-interface=SmartFilmCont, service-interface-id=9010
      someip method deployment SmartFilmControl: method=SmartFilmControl, method-id=2, transport-protocol=UDP
      someip method deployment SmartFilmStatus: method=SmartFilmStatus, method-id=1, transport-protocol=UDP
    Snsr_FaceDetectModule: service-interface=Snsr_FaceDetectModule, service-interface-id=9040
      4 x someip method deployment, all with transport-protocol=UDP:
        getEmotion: method=getEmotion, method-id=4
        isRunning: method=Snsr_FaceDetectModule/isRunning, method-id=3
        turnOff: method=Snsr_FaceDetectModule/turnOff, method-id=2
        turnOn: method=Snsr_FaceDetectModule/turnOn, method-id=1
    Snsr_Heartbeat: service-interface=Snsr_Heartbeat, service-interface-id=9041
      someip method deployment getHr: method=getHr, method-id=1, transport-protocol=UDP
    Snsr_USS: service-interface=Snsr_USS, service-interface-id=9034
      someip method deployment ntfFltSt: method=ntfFltSt, method-id=2, transport-protocol=UDP
      someip method deployment ntfSonarInfo: method=ntfSonarInfo, method-id=1, transport-protocol=UDP
    TMS_AC: service-interface=TMS_AC, service-interface-id=9042
      6 x someip method deployment, all with transport-protocol=UDP:
        getAirOutletTemp: method=getAirOutletTemp, method-id=6
        getTargetTemp: method=getTargetTemp, method-id=5
        isRunning: method=TMS_AC/isRunning, method-id=3
        setTargetTemp: method=setTargetTemp, method-id=4
        turnOff: method=TMS_AC/turnOff, method-id=2
        turnOn: method=TMS_AC/turnOn, method-id=1
    TMS_EnvMonitor: service-interface=TMS_EnvMonitor, service-interface-id=9046
      6 x someip method deployment, all with transport-protocol=UDP:
        getHumidity: method=getHumidity, method-id=4
        getLightIntensity: method=getLightIntensity, method-id=5
        getTemp: method=getTemp, method-id=2
        notifyHumidity: method=notifyHumidity, method-id=1
        notifyLightIntensity: method=notifyLightIntensity, method-id=6
        notifyTemp: method=notifyTemp, method-id=3
    TMS_Fragrance: service-interface=TMS_Fragrance, service-interface-id=9045
      7 x someip method deployment, all with transport-protocol=UDP:
        getConcentration: method=getConcentration, method-id=5
        getType: method=getType, method-id=7
        isRunning: method=TMS_Fragrance/isRunning, method-id=3
        setConcentration: method=setConcentration, method-id=4
        setType: method=setType, method-id=6
        turnOff: method=TMS_Fragrance/turnOff, method-id=2
        turnOn: method=TMS_Fragrance/turnOn, method-id=1
    TMS_Purifier: service-interface=TMS_Purifier, service-interface-id=9044
      someip method deployment isRunning: method=TMS_Purifier/isRunning, method-id=3, transport-protocol=UDP
      someip method deployment turnOff: method=TMS_Purifier/turnOff, method-id=2, transport-protocol=UDP
      someip method deployment turnOn: method=TMS_Purifier/turnOn, method-id=1, transport-protocol=UDP
    TMS_Ventilation: service-interface=TMS_Ventilation, service-interface-id=9043
      someip method deployment isRunning: method=TMS_Ventilation/isRunning, method-id=3, transport-protocol=UDP
      someip method deployment turnOff: method=TMS_Ventilation/turnOff, method-id=2, transport-protocol=UDP
      someip method deployment turnOn: method=TMS_Ventilation/turnOn, method-id=1, transport-protocol=UDP
    VCS_AccrPedal: service-interface=VCS_AccrPedal, service-interface-id=9003
      someip field deployment vcs_AccrPedal: field=vcs_AccrPedal
        get Get_vcs_AccrPedal: method-id=11, transport-protocol=UDP
        notifier Notification_vcs_AccrPedal: event-id=12, transport-protocol=UDP
      someip method deployment nofityStatus: method=nofityStatus, method-id=1, transport-protocol=UDP
      someip event group Eventgroup_VCSAccrPedal: event-group-id=1, event=Notification_vcs_AccrPedal
    VCS_Brake: service-interface=VCS_Brake, service-interface-id=9032
      4 x someip method deployment, all with transport-protocol=UDP:
        notifyMCPrs: method=notifyMCPrs, method-id=1
        notifyTq: method=notifyTq, method-id=2
        setTargetAx: method=setTargetAx, method-id=3
        setTotalForce: method=setTotalForce, method-id=4
    VCS_BrakePedal: service-interface=VCS_BrakePedal, service-interface-id=9002
      someip field deployment vcs_BrakePosn: field=vcs_BrakePosn
        get Get_vcs_BrakePosn: method-id=13, transport-protocol=UDP
        notifier Notification_vcs_BrakePosn: event-id=14, transport-protocol=UDP
      someip field deployment vcs_BrakeSwtich: field=vcs_BrakeSwtich
        get Get_vcs_BrakeSwtich: method-id=11, transport-protocol=UDP
        notifier Notification_vcs_BrakeSwtich: event-id=12, transport-protocol=UDP
      someip method deployment nofitySwitch: method=nofitySwitch, method-id=1, transport-protocol=UDP
      someip method deployment notifyStatus: method=VCS_BrakePedal/notifyStatus, method-id=2, transport-protocol=UDP
      someip event group Eventgroup_VCSBrakePedal: event-group-id=1, event=[Notification_vcs_BrakePosn, Notification_vcs_BrakeSwtich]
    VCS_EPB: service-interface=VCS_EPB, service-interface-id=9033
      someip method deployment notifystaticSlope: method=notifystaticSlope, method-id=1, transport-protocol=UDP
    VCS_Gear: service-interface=VCS_Gear, service-interface-id=9004
      someip field deployment vcs_Gear: field=vcs_Gear
        get Get_vcs_Gear: method-id=11, transport-protocol=UDP
        notifier Notification_vcs_Gear: event-id=12, transport-protocol=UDP
      someip method deployment notifyStatus: method=VCS_Gear/notifyStatus, method-id=1, transport-protocol=UDP
      someip method deployment setTarget: method=setTarget, method-id=2, transport-protocol=UDP
      someip event group Eventgroup_VCSGear: event-group-id=1, event=Notification_vcs_Gear
    VCS_TqDmd: service-interface=VCS_TqDmd, service-interface-id=9031
      someip method deployment setDrivePedalPosn: method=setDrivePedalPosn, method-id=1, transport-protocol=UDP
    VCS_VehSpd: service-interface=VCS_VehSpd, service-interface-id=9001
      someip field deployment vcs_VehSpd: field=vcs_VehSpd
        get Get_vcs_VehSpd: method-id=11, transport-protocol=UDP
        notifier Notification_vcs_VehSpd: event-id=12, transport-protocol=UDP
      someip method deployment notifyStatus: method=VCS_VehSpd/notifyStatus, method-id=1, transport-protocol=UDP
      someip event group Eventgroup_VCSVehSpd: event-group-id=1, event=Notification_vcs_VehSpd
package /ServiceInstance/Endpoint
  37 x someip service instance to machine mapping, all with communication-connector=eth0:
    EEVP_ServiceCreator_SomeipConsumers_BCM_Horn: service-instance=EEVP_ServiceCreator_Consumer_BCM_Horn, tcp-port=50440, udp-port=50440
    EEVP_ServiceCreator_SomeipConsumers_BCM_WiperWash: service-instance=EEVP_ServiceCreator_Consumer_BCM_WiperWash, tcp-port=50410, udp-port=50410
    EEVP_ServiceCreator_SomeipConsumers_Ctrl_MoodLamp: service-instance=EEVP_ServiceCreator_Consumer_Ctrl_MoodLamp, tcp-port=50540, udp-port=50540
    EEVP_ServiceCreator_SomeipConsumers_Ctrl_RearCurtain: service-instance=EEVP_ServiceCreator_Consumer_Ctrl_RearCurtain, tcp-port=50530, udp-port=50530
    EEVP_ServiceCreator_SomeipConsumers_EevpControlSoaMlm: service-instance=EEVP_ServiceCreator_Consumer_EevpControlSoaMlm, tcp-port=50430, udp-port=50430
    EEVP_ServiceCreator_SomeipConsumers_SmartFilmCont: service-instance=EEVP_ServiceCreator_Consumer_SmartFilmCont, tcp-port=50420, udp-port=50420
    EEVP_ServiceCreator_SomeipConsumers_Snsr_FaceDetectModule: service-instance=EEVP_ServiceCreator_Consumer_Snsr_FaceDetectModule, tcp-port=50480, udp-port=50480
    EEVP_ServiceCreator_SomeipConsumers_TMS_AC: service-instance=EEVP_ServiceCreator_Consumer_TMS_AC, tcp-port=50490, udp-port=50490
    EEVP_ServiceCreator_SomeipConsumers_TMS_EnvMonitor: service-instance=EEVP_ServiceCreator_Consumer_TMS_EnvMonitor, tcp-port=50400, udp-port=50400
    EEVP_ServiceCreator_SomeipConsumers_TMS_Fragrance: service-instance=EEVP_ServiceCreator_Consumer_TMS_Fragrance, tcp-port=50520, udp-port=50520
    EEVP_ServiceCreator_SomeipConsumers_TMS_Purifier: service-instance=EEVP_ServiceCreator_Consumer_TMS_Purifier, tcp-port=50510, udp-port=50510
    EEVP_ServiceCreator_SomeipConsumers_TMS_Ventilation: service-instance=EEVP_ServiceCreator_Consumer_TMS_Ventilation, tcp-port=50500, udp-port=50500
    EEVP_ServiceCreator_SomeipConsumers_VCS_Brake: service-instance=EEVP_ServiceCreator_Consumer_VCS_Brake, tcp-port=50470, udp-port=50470
    EEVP_ServiceCreator_SomeipConsumers_VCS_Gear: service-instance=EEVP_ServiceCreator_Consumer_VCS_Gear, tcp-port=50450, udp-port=50450
    EEVP_ServiceCreator_SomeipConsumers_VCS_TqDmd: service-instance=EEVP_ServiceCreator_Consumer_VCS_TqDmd, tcp-port=50460, udp-port=50460
    EEVP_ServiceCreator_SomeipProviders_BCM_WiperWash: service-instance=EEVP_ServiceCreator_Provider_BCM_WiperWash, tcp-port=50093, udp-port=50093
    EEVP_ServiceCreator_SomeipProviders_BmsInfoSrv: service-instance=EEVP_ServiceCreator_Provider_BmsInfoSrv, tcp-port=50110, udp-port=50110
    EEVP_ServiceCreator_SomeipProviders_Ctrl_MoodLamp: service-instance=EEVP_ServiceCreator_Provider_Ctrl_MoodLamp, tcp-port=50370, udp-port=50370
    EEVP_ServiceCreator_SomeipProviders_Ctrl_RearCurtain: service-instance=EEVP_ServiceCreator_Provider_Ctrl_RearCurtain, tcp-port=50380, udp-port=50380
    EEVP_ServiceCreator_SomeipProviders_DMS_Func: service-instance=EEVP_ServiceCreator_Provider_DMS_Func, tcp-port=50360, udp-port=50360
    EEVP_ServiceCreator_SomeipProviders_MSGInfoSrv: service-instance=EEVP_ServiceCreator_Provider_MsgInfoSrv, tcp-port=50120, udp-port=50120
    EEVP_ServiceCreator_SomeipProviders_ServiceManagement: service-instance=EEVP_ServiceCreator_Provider_ServiceManagement, tcp-port=55111, udp-port=55111
    EEVP_ServiceCreator_SomeipProviders_SmartFilmCont: service-instance=EEVP_ServiceCreator_Provider_SmartFilmCont, tcp-port=50100, udp-port=50100
    EEVP_ServiceCreator_SomeipProviders_Snsr_FaceDetectModule: service-instance=EEVP_ServiceCreator_Provider_Snsr_FaceDetectModule, tcp-port=50300, udp-port=50300
    EEVP_ServiceCreator_SomeipProviders_Snsr_Heartbeat: service-instance=EEVP_ServiceCreator_Provider_Snsr_Heartbeat, tcp-port=50310, udp-port=50310
    EEVP_ServiceCreator_SomeipProviders_Snsr_USS: service-instance=EEVP_ServiceCreator_Provider_Snsr_USS, tcp-port=50099, udp-port=50099
    EEVP_ServiceCreator_SomeipProviders_TMS_AC: service-instance=EEVP_ServiceCreator_Provider_TMS_AC, tcp-port=50320, udp-port=50320
    EEVP_ServiceCreator_SomeipProviders_TMS_EnvMonitor: service-instance=EEVP_ServiceCreator_Provider_TMS_EnvMonitor, tcp-port=50098, udp-port=50098
    EEVP_ServiceCreator_SomeipProviders_TMS_Fragrance: service-instance=EEVP_ServiceCreator_Provider_TMS_Fragrance, tcp-port=50350, udp-port=50350
    EEVP_ServiceCreator_SomeipProviders_TMS_Purifier: service-instance=EEVP_ServiceCreator_Provider_TMS_Purifier, tcp-port=50340, udp-port=50340
    EEVP_ServiceCreator_SomeipProviders_TMS_Ventilation: service-instance=EEVP_ServiceCreator_Provider_TMS_Ventilation, tcp-port=50330, udp-port=50330
    EEVP_ServiceCreator_SomeipProviders_VCS_AccrPedal: service-instance=EEVP_ServiceCreator_Provider_VCS_AccrPedal, tcp-port=50096, udp-port=50096
    EEVP_ServiceCreator_SomeipProviders_VCS_Brake: service-instance=EEVP_ServiceCreator_Provider_VCS_Brake, tcp-port=50200, udp-port=50200
    EEVP_ServiceCreator_SomeipProviders_VCS_BrakePedal: service-instance=EEVP_ServiceCreator_Provider_VCS_BrakePedal, tcp-port=50095, udp-port=50095
    EEVP_ServiceCreator_SomeipProviders_VCS_EPB: service-instance=EEVP_ServiceCreator_Provider_VCS_EPB, tcp-port=50210, udp-port=50210
    EEVP_ServiceCreator_SomeipProviders_VCS_Gear: service-instance=EEVP_ServiceCreator_Provider_VCS_Gear, tcp-port=50097, udp-port=50097
    EEVP_ServiceCreator_SomeipProviders_VCS_VehSpd: service-instance=EEVP_ServiceCreator_Provider_VCS_VehSpd, tcp-port=50094, udp-port=50094
package /ServiceInstance/Someip/Consumer
  15 x required someip service instance, all with required-minor-version=ANY, required-service-instance-id=ANY:
    EEVP_ServiceCreator_Consumer_BCM_Horn: service-interface-deployment=BCM_Horn, method-request-propss=[start, stop, Alert], sd-client-config=DefaultSdClientConfig, version-driven-find-behavior=EXACT-OR-ANY-MINOR-VERSION
    EEVP_ServiceCreator_Consumer_BCM_WiperWash: service-interface-deployment=BCM_WiperWash, sd-client-config=DefaultClientConfig
      method-request-propss:
        method=wiperLevel/Get_wiperLevel
        wiperInterval/Get_wiperInterval
        BCM_WiperWash/isWiping
        BCM_WiperWash/setWipingInterval
        BCM_WiperWash/setWipingLevel
        BCM_WiperWash/setWipingLevelImme
        BCM_WiperWash/startWiping
        BCM_WiperWash/stopWiping
        BCM_WiperWash/getWipingLevel
        BCM_WiperWash/getWipingInterval
      someip required event group Eventgroup_WiperInterval: event-group=Eventgroup_WiperInterval, sd-client-event-group-timing-config=DefaultSdSubscribeConfig
      someip required event group Eventgroup_WiperLevel: event-group=Eventgroup_WiperLevel, sd-client-event-group-timing-config=DefaultSdSubscribeConfig
    EEVP_ServiceCreator_Consumer_Ctrl_MoodLamp: service-interface-deployment=Ctrl_MoodLamp, sd-client-config=DefaultSdClientConfig, version-driven-find-behavior=EXACT-OR-ANY-MINOR-VERSION
      method-request-propss:
        Ctrl_MoodLamp/turnOn
        Ctrl_MoodLamp/turnOff
        getPowerStatus
        setPowerStatus
        getBrightness
        setBrightness
        getColor
        setColor
    EEVP_ServiceCreator_Consumer_Ctrl_RearCurtain: service-interface-deployment=Ctrl_RearCurtain, method-request-propss=[getOpeningRate, setOpeningRate], sd-client-config=DefaultSdClientConfig, version-driven-find-behavior=EXACT-OR-ANY-MINOR-VERSION
    EEVP_ServiceCreator_Consumer_EevpControlSoaMlm: service-interface-deployment=EevpControlSoaMlm, method-request-propss=[RequestMlmSetRGBColor, RequestMlmSetBrightness], sd-client-config=DefaultSdClientConfig, version-driven-find-behavior=EXACT-OR-ANY-MINOR-VERSION
    EEVP_ServiceCreator_Consumer_SmartFilmCont: service-interface-deployment=SmartFilmCont, method-request-propss=[SmartFilmStatus, SmartFilmControl], sd-client-config=DefaultSdClientConfig, version-driven-find-behavior=EXACT-OR-ANY-MINOR-VERSION
    EEVP_ServiceCreator_Consumer_Snsr_FaceDetectModule: service-interface-deployment=Snsr_FaceDetectModule, method-request-propss=[Snsr_FaceDetectModule/turnOn, Snsr_FaceDetectModule/turnOff, Snsr_FaceDetectModule/isRunning, getEmotion], sd-client-config=DefaultSdClientConfig, version-driven-find-behavior=EXACT-OR-ANY-MINOR-VERSION
    EEVP_ServiceCreator_Consumer_TMS_AC: service-interface-deployment=TMS_AC, method-request-propss=[TMS_AC/turnOn, TMS_AC/turnOff, TMS_AC/isRunning, setTargetTemp, getTargetTemp, getAirOutletTemp], sd-client-config=DefaultSdClientConfig, version-driven-find-behavior=EXACT-OR-ANY-MINOR-VERSION
    EEVP_ServiceCreator_Consumer_TMS_EnvMonitor: service-interface-deployment=TMS_EnvMonitor, method-request-propss=[notifyHumidity, getTemp, notifyTemp, getHumidity, getLightIntensity, notifyLightIntensity], sd-client-config=DefaultSdClientConfig, version-driven-find-behavior=EXACT-OR-ANY-MINOR-VERSION
    EEVP_ServiceCreator_Consumer_TMS_Fragrance: service-interface-deployment=TMS_Fragrance, sd-client-config=DefaultSdClientConfig, version-driven-find-behavior=EXACT-OR-ANY-MINOR-VERSION
      method-request-propss:
        TMS_Fragrance/turnOn
        TMS_Fragrance/turnOff
        TMS_Fragrance/isRunning
        setConcentration
        getConcentration
        setType
        getType
    EEVP_ServiceCreator_Consumer_TMS_Purifier: service-interface-deployment=TMS_Purifier, method-request-propss=[TMS_Purifier/turnOn, TMS_Purifier/turnOff, TMS_Purifier/isRunning], sd-client-config=DefaultSdClientConfig, version-driven-find-behavior=EXACT-OR-ANY-MINOR-VERSION
    EEVP_ServiceCreator_Consumer_TMS_Ventilation: service-interface-deployment=TMS_Ventilation, method-request-propss=[TMS_Ventilation/turnOn, TMS_Ventilation/turnOff, TMS_Ventilation/isRunning], sd-client-config=DefaultSdClientConfig, version-driven-find-behavior=EXACT-OR-ANY-MINOR-VERSION
    EEVP_ServiceCreator_Consumer_VCS_Brake: service-interface-deployment=VCS_Brake, method-request-propss=[notifyMCPrs, setTargetAx, setTotalForce, notifyTq], sd-client-config=DefaultSdClientConfig, version-driven-find-behavior=EXACT-OR-ANY-MINOR-VERSION
    EEVP_ServiceCreator_Consumer_VCS_Gear: service-interface-deployment=VCS_Gear, method-request-propss=[VCS_Gear/notifyStatus, setTarget], sd-client-config=DefaultSdClientConfig, version-driven-find-behavior=EXACT-OR-ANY-MINOR-VERSION
    EEVP_ServiceCreator_Consumer_VCS_TqDmd: service-interface-deployment=VCS_TqDmd, someip-method-props=setDrivePedalPosn, sd-client-config=DefaultSdClientConfig, version-driven-find-behavior=EXACT-OR-ANY-MINOR-VERSION
package /ServiceInstance/Someip/Provider
  22 x provided someip service instance, all with sd-server-config=DefaultSdServerConfig:
    EEVP_ServiceCreator_Provider_BCM_WiperWash: service-interface-deployment=BCM_WiperWash, event-propss=[Notification_wiperLevel, Notification_wiperInterval], service-instance-id=9005
      method-response-propss:
        wiperLevel/Get_wiperLevel
        wiperInterval/Get_wiperInterval
        BCM_WiperWash/isWiping
        BCM_WiperWash/setWipingInterval
        BCM_WiperWash/setWipingLevel
        BCM_WiperWash/setWipingLevelImme
        BCM_WiperWash/startWiping
        BCM_WiperWash/stopWiping
        BCM_WiperWash/getWipingLevel
        BCM_WiperWash/getWipingInterval
      someip provided event group Eventgroup_WiperInterval: event-group=Eventgroup_WiperInterval, multicast-threshold=0, sd-server-event-group-timing-config=DefaultSdPublishConfig
      someip provided event group Eventgroup_WiperLevel: event-group=Eventgroup_WiperLevel, multicast-threshold=0, sd-server-event-group-timing-config=DefaultSdPublishConfig
    EEVP_ServiceCreator_Provider_BmsInfoSrv: service-interface-deployment=BmsInfoSrv, someip-event-props=event=ems_BmsInfo, service-instance-id=9020
      someip provided event group Eventgroup_ems_BmsInfo: event-group=Eventgroup_ems_BmsInfo, multicast-threshold=0
    EEVP_ServiceCreator_Provider_Ctrl_MoodLamp: service-interface-deployment=Ctrl_MoodLamp, service-instance-id=9048
      method-response-propss:
        Ctrl_MoodLamp/turnOn
        Ctrl_MoodLamp/turnOff
        getPowerStatus
        setPowerStatus
        getBrightness
        setBrightness
        getColor
        setColor
    EEVP_ServiceCreator_Provider_Ctrl_RearCurtain: service-interface-deployment=Ctrl_RearCurtain, method-response-propss=[getOpeningRate, setOpeningRate], service-instance-id=9049
    EEVP_ServiceCreator_Provider_DMS_Func: service-interface-deployment=DMS_Func, someip-method-props=isDetectDrowsy, service-instance-id=9047
    EEVP_ServiceCreator_Provider_MsgInfoSrv: service-interface-deployment=MsgInfoSrv, event-propss=[ems_MsgInfo, T_MSGINFO], service-instance-id=9021
      someip provided event group Eventgroup_T_MSGINFO: event-group=Eventgroup_T_MSGINFO, multicast-threshold=0
      someip provided event group Eventgroup_ems_MsgInfo: event-group=Eventgroup_ems_MsgInfo, multicast-threshold=0
    EEVP_ServiceCreator_Provider_ServiceManagement: service-interface-deployment=ServiceManagement, event-propss=[Notify_wiperLevel, Notify_wiperInterval, Notify_wiperRecv, Notify_wiperSend], service-instance-id=9000
      method-response-propss:
        wiperLevel/Get_wiperLevel
        wiperInterval/Get_wiperInterval
        Get_wiperRecv
        Get_wiperSend
        ServiceManagement/isWiping
        ServiceManagement/stopWiping
        ServiceManagement/startWiping
        ServiceManagement/setWipingLevel
        ServiceManagement/setWipingLevelImme
        ServiceManagement/setWipingInterval
        ServiceManagement/getWipingLevel
        ServiceManagement/getWipingInterval
      someip provided event group Eventgroup_wiperEvent: event-group=Eventgroup_wiperEvent, multicast-threshold=0
    EEVP_ServiceCreator_Provider_SmartFilmCont: service-interface-deployment=SmartFilmCont, method-response-propss=[SmartFilmStatus, SmartFilmControl], service-instance-id=9010
    EEVP_ServiceCreator_Provider_Snsr_FaceDetectModule: service-interface-deployment=Snsr_FaceDetectModule, method-response-propss=[Snsr_FaceDetectModule/turnOn, Snsr_FaceDetectModule/turnOff, Snsr_FaceDetectModule/isRunning, getEmotion], service-instance-id=9040
    EEVP_ServiceCreator_Provider_Snsr_Heartbeat: service-interface-deployment=Snsr_Heartbeat, someip-method-props=getHr, service-instance-id=9041
    EEVP_ServiceCreator_Provider_Snsr_USS: service-interface-deployment=Snsr_USS, method-response-propss=[ntfSonarInfo, ntfFltSt], service-instance-id=9034
    EEVP_ServiceCreator_Provider_TMS_AC: service-interface-deployment=TMS_AC, method-response-propss=[TMS_AC/turnOn, TMS_AC/turnOff, TMS_AC/isRunning, setTargetTemp, getTargetTemp, getAirOutletTemp], service-instance-id=9042
    EEVP_ServiceCreator_Provider_TMS_EnvMonitor: service-interface-deployment=TMS_EnvMonitor, method-response-propss=[notifyHumidity, getTemp, notifyTemp, getHumidity, getLightIntensity, notifyLightIntensity], service-instance-id=9046
    EEVP_ServiceCreator_Provider_TMS_Fragrance: service-interface-deployment=TMS_Fragrance, service-instance-id=9045
      method-response-propss:
        TMS_Fragrance/turnOn
        TMS_Fragrance/turnOff
        TMS_Fragrance/isRunning
        setConcentration
        getConcentration
        setType
        getType
    EEVP_ServiceCreator_Provider_TMS_Purifier: service-interface-deployment=TMS_Purifier, method-response-propss=[TMS_Purifier/turnOn, TMS_Purifier/turnOff, TMS_Purifier/isRunning], service-instance-id=9044
    EEVP_ServiceCreator_Provider_TMS_Ventilation: service-interface-deployment=TMS_Ventilation, method-response-propss=[TMS_Ventilation/turnOn, TMS_Ventilation/turnOff, TMS_Ventilation/isRunning], service-instance-id=9043
    EEVP_ServiceCreator_Provider_VCS_AccrPedal: service-interface-deployment=VCS_AccrPedal, someip-event-props=Notification_vcs_AccrPedal, method-response-propss=[Get_vcs_AccrPedal, nofityStatus], service-instance-id=9003
      someip provided event group Eventgroup_VCSAccrPedal: event-group=Eventgroup_VCSAccrPedal, multicast-threshold=0
    EEVP_ServiceCreator_Provider_VCS_Brake: service-interface-deployment=VCS_Brake, method-response-propss=[notifyMCPrs, setTargetAx, setTotalForce, notifyTq], service-instance-id=9032
    EEVP_ServiceCreator_Provider_VCS_BrakePedal: service-interface-deployment=VCS_BrakePedal, event-propss=[Notification_vcs_BrakeSwtich, event=Notification_vcs_BrakePosn], method-response-propss=[Get_vcs_BrakeSwtich, Get_vcs_BrakePosn, nofitySwitch, VCS_BrakePedal/notifyStatus], service-instance-id=9002
      someip provided event group Eventgroup_VCSBrakePedal: event-group=Eventgroup_VCSBrakePedal, multicast-threshold=0
    EEVP_ServiceCreator_Provider_VCS_EPB: service-interface-deployment=VCS_EPB, someip-method-props=notifystaticSlope, service-instance-id=9033
    EEVP_ServiceCreator_Provider_VCS_Gear: service-interface-deployment=VCS_Gear, someip-event-props=event=Notification_vcs_Gear, method-response-propss=[Get_vcs_Gear, VCS_Gear/notifyStatus, method=setTarget], service-instance-id=9004
      someip provided event group Eventgroup_VCSGear: event-group=Eventgroup_VCSGear, multicast-threshold=0
    EEVP_ServiceCreator_Provider_VCS_VehSpd: service-interface-deployment=VCS_VehSpd, someip-event-props=Notification_vcs_VehSpd, method-response-propss=[Get_vcs_VehSpd, VCS_VehSpd/notifyStatus], service-instance-id=9001
      someip provided event group Eventgroup_VCSVehSpd: event-group=Eventgroup_VCSVehSpd, multicast-threshold=0
package /ServiceInterface
  25 x service interface, all with major-version=1, minor-version=0:
    BCM_Horn
      namespaces:
        symbol props eevp
        symbol props simulation
      methods:
        operation Alert: fire-and-forget=false
          arg BCM_PeriodMode: type=uint8_t, direction=IN
        operation start: fire-and-forget=false
        operation stop: fire-and-forget=false
    BCM_WiperWash
      namespaces:
        symbol props eevp
        symbol props simulation
      field wiperInterval: type=uint16_t, has-getter=true, has-notifier=true, has-setter=false
      field wiperLevel: type=BCM_WipingLevel, has-getter=true, has-notifier=true, has-setter=false
      methods:
        8 x operation, all with fire-and-forget=false:
          getWipingInterval
            arg wipingInterval: type=uint16_t, direction=OUT
          getWipingLevel
            arg wipingLevel: type=BCM_WipingLevel, direction=OUT
          isWiping
            arg status: type=bool, direction=OUT
          setWipingInterval
            arg wipingInterval: type=uint16_t, direction=IN
            arg BCM_ReturnCode: type=BCM_ReturnCode, direction=OUT
          setWipingLevel
            arg wipngLevel: type=BCM_WipingLevel, direction=IN
            arg BCM_ReturnCode: type=BCM_ReturnCode, direction=OUT
          setWipingLevelImme
            arg wipingLevel: type=BCM_WipingLevel, direction=IN
            arg BCM_ReturnCode: type=BCM_ReturnCode, direction=OUT
          startWiping
            arg returnCode: type=BCM_ReturnCode, direction=OUT
          stopWiping
            arg returnCode: type=BCM_ReturnCode, direction=OUT
    BmsInfoSrv
      namespaces:
        symbol props eevp
        symbol props simulation
      events:
        data ems_BmsInfo: type=ems_BmsInfo
    Ctrl_MoodLamp
      namespaces:
        symbol props eevp
        symbol props simulation
      methods:
        8 x operation, all with fire-and-forget=false:
          getBrightness
            arg brightness: type=brightness, direction=OUT
          getColor
            arg color: type=color, direction=OUT
          getPowerStatus
            arg lampStatus: type=lampStatus, direction=OUT
          setBrightness
            arg brightness: type=brightness, direction=IN
            arg Ctrl_ReturnCode: type=Ctrl_ReturnCode, direction=OUT
          setColor
            arg color: type=color, direction=IN
            arg Ctrl_ReturnCode: type=Ctrl_ReturnCode, direction=OUT
          setPowerStatus
            arg lampStatus: type=lampStatus, direction=IN
            arg Ctrl_ReturnCode: type=Ctrl_ReturnCode, direction=OUT
          turnOff
            arg Ctrl_ReturnCode: type=Ctrl_ReturnCode, direction=OUT
          turnOn
            arg Ctrl_ReturnCode: type=Ctrl_ReturnCode, direction=OUT
    Ctrl_RearCurtain
      namespaces:
        symbol props eevp
        symbol props simulation
      methods:
        operation getOpeningRate: fire-and-forget=false
          arg rate: type=uint8_t, direction=OUT
        operation setOpeningRate: fire-and-forget=false
          arg rate: type=uint8_t, direction=IN
          arg Ctrl_ReturnCode: type=Ctrl_ReturnCode, direction=OUT
    DMS_Func
      namespaces:
        symbol props eevp
        symbol props simulation
      methods:
        operation isDetectDrowsy: fire-and-forget=false
          arg DMS_ReturnCode: type=DMS_ReturnCode, direction=OUT
    EevpControlSoaMlm
      namespaces:
        symbol props eevp
        symbol props simulation
      methods:
        operation RequestMlmSetBrightness: fire-and-forget=false
          arg Brightness: type=uint16_t, direction=IN
        operation RequestMlmSetRGBColor: fire-and-forget=false
          arg ColorIndex: type=uint8_t, direction=IN
    MsgInfoSrv
      namespaces:
        symbol props eevp
        symbol props simulation
      events:
        data T_MSGINFO: type=T_MSGINFO
        data ems_MsgInfo: type=ems_MsgInfo
    ServiceManagement
      namespaces:
        symbol props eevp
        symbol props service
      4 x field, all with has-getter=true, has-notifier=true, has-setter=false:
        wiperInterval: type=uint16_t
        wiperLevel: type=BCM_WipingLevel
        wiperRecv: type=wiperRecv
        wiperSend: type=wiperSend
      methods:
        8 x operation, all with fire-and-forget=false:
          getWipingInterval
            arg wipingInterval: type=uint16_t, direction=OUT
          getWipingLevel
            arg wipingLevel: type=BCM_WipingLevel, direction=OUT
          isWiping
            arg status: type=bool, direction=OUT
          setWipingInterval
            arg wipingInterval: type=uint16_t, direction=IN
            arg BCM_ReturnCode: type=BCM_ReturnCode, direction=OUT
          setWipingLevel
            arg wipingLevel: type=BCM_WipingLevel, direction=IN
            arg BCM_ReturnCode: type=BCM_ReturnCode, direction=OUT
          setWipingLevelImme
            arg wipingLevel: type=BCM_WipingLevel, direction=IN
            arg BCM_ReturnCode: type=BCM_ReturnCode, direction=OUT
          startWiping
            arg bcm_returnCode: type=BCM_ReturnCode, direction=OUT
          stopWiping
            arg bcm_returnCode: type=BCM_ReturnCode, direction=OUT
    SmartFilmCont
      namespaces:
        symbol props eevp
        symbol props simulation
      methods:
        operation SmartFilmControl: fire-and-forget=false
          arg WindowLocTransparence: type=int32_t, direction=IN
        operation SmartFilmStatus: fire-and-forget=false
          arg smartFilmStatus: type=SmartFilmStatus, direction=OUT
    Snsr_FaceDetectModule
      namespaces:
        symbol props eevp
        symbol props simulation
      methods:
        4 x operation, all with fire-and-forget=false:
          getEmotion
            arg FDM_EmotionType: type=FDM_EmotionType, direction=OUT
          isRunning
            arg status: type=bool, direction=OUT
          turnOff
            arg FDM_ReturnCode: type=FDM_ReturnCode, direction=OUT
          turnOn
            arg FDM_ReturnCode: type=FDM_ReturnCode, direction=OUT
    Snsr_Heartbeat
      namespaces:
        symbol props eevp
        symbol props simulation
      methods:
        operation getHr: fire-and-forget=false
          arg hrStatus: type=uint32_t, direction=OUT
    Snsr_USS
      namespaces:
        symbol props eevp
        symbol props simulation
      methods:
        operation ntfFltSt: fire-and-forget=false
          arg ntfFltSt: type=uint8_t, direction=OUT
        operation ntfSonarInfo: fire-and-forget=false
          arg UssSonarinfo: type=USSSonarInfo, direction=OUT
    TMS_AC
      namespaces:
        symbol props eevp
        symbol props simulation
      methods:
        6 x operation, all with fire-and-forget=false:
          getAirOutletTemp
            arg outletId: type=uint8_t, direction=IN
            arg outletTemp: type=int16_t, direction=OUT
          getTargetTemp
            arg zoneId: type=uint8_t, direction=IN
            arg targetTemp: type=int16_t, direction=OUT
          isRunning
            arg status: type=bool, direction=OUT
          setTargetTemp
            arg zoneId: type=uint8_t, direction=IN
            arg targetTemp: type=int16_t, direction=IN
            arg TMS_ReturnCode: type=TMS_ReturnCode, direction=OUT
          turnOff
            arg TMS_ReturnCode: type=TMS_ReturnCode, direction=OUT
          turnOn
            arg TMS_ReturnCode: type=TMS_ReturnCode, direction=OUT
    TMS_EnvMonitor
      namespaces:
        symbol props eevp
        symbol props simulation
      methods:
        6 x operation, all with fire-and-forget=false:
          getHumidity
            arg zoneId: type=TMS_EnvZone, direction=IN
            arg humidity: type=uint8_t, direction=OUT
          getLightIntensity
            arg zoneId: type=TMS_EnvZone, direction=IN
            arg lightIntensity: type=uint16_t, direction=OUT
          getTemp
            arg zoneId: type=TMS_EnvZone, direction=IN
            arg temp: type=int16_t, direction=OUT
          notifyHumidity
            arg TMS_EnvZoneHumidityAry: type=TMS_EnvZoneHumidityAry, direction=OUT
          notifyLightIntensity
            arg TMS_EnvZoneLightIntensityAry: type=TMS_EnvZoneLightIntensityAry, direction=OUT
          notifyTemp
            arg TMS_EnvZoneTempAry: type=TMS_EnvZoneTempAry, direction=OUT
    TMS_Fragrance
      namespaces:
        symbol props eevp
        symbol props simulation
      methods:
        7 x operation, all with fire-and-forget=false:
          getConcentration
            arg concentration: type=uint16_t, direction=OUT
          getType
            arg TMS_FragranceType: type=TMS_FragranceType, direction=OUT
          isRunning
            arg state: type=bool, direction=OUT
          setConcentration
            arg concentration: type=uint16_t, direction=IN
            arg TMS_ReturnCode: type=TMS_ReturnCode, direction=OUT
          setType
            arg type: type=TMS_FragranceType, direction=IN
            arg TMS_ReturnCode: type=TMS_ReturnCode, direction=OUT
          turnOff
            arg TMS_ReturnCode: type=TMS_ReturnCode, direction=OUT
          turnOn
            arg TMS_ReturnCode: type=TMS_ReturnCode, direction=OUT
    TMS_Purifier
      namespaces:
        symbol props eevp
        symbol props simulation
      methods:
        operation isRunning: fire-and-forget=false
          arg status: type=bool, direction=OUT
        operation turnOff: fire-and-forget=false
          arg TMS_ReturnCode: type=TMS_ReturnCode, direction=OUT
        operation turnOn: fire-and-forget=false
          arg TMS_ReturnCode: type=TMS_ReturnCode, direction=OUT
    TMS_Ventilation
      namespaces:
        symbol props eevp
        symbol props simulation
      methods:
        operation isRunning: fire-and-forget=false
          arg status: type=bool, direction=OUT
        operation turnOff: fire-and-forget=false
          arg TMS_ReturnCode: type=TMS_ReturnCode, direction=OUT
        operation turnOn: fire-and-forget=false
          arg TMS_ReturnCode: type=TMS_ReturnCode, direction=OUT
    VCS_AccrPedal
      namespaces:
        symbol props eevp
        symbol props simulation
      field vcs_AccrPedal: type=VCS_AccrPedal, has-getter=true, has-notifier=true, has-setter=false
      methods:
        operation nofityStatus: fire-and-forget=false
          arg VCS_AccrPedal: type=VCS_AccrPedal, direction=OUT
    VCS_Brake
      namespaces:
        symbol props eevp
        symbol props simulation
      methods:
        4 x operation, all with fire-and-forget=false:
          notifyMCPrs
            arg VCS_MCPrs: type=VCS_MCPrs, direction=OUT
          notifyTq
            arg VCS_TqCtrl: type=VCS_TqCtrl, direction=OUT
          setTargetAx
            arg ax: type=VCS_Acceleration, direction=IN
          setTotalForce
            arg lgtBrkFTotal: type=VCS_LgtBrkFTotal, direction=IN
    VCS_BrakePedal
      namespaces:
        symbol props eevp
        symbol props simulation
      field vcs_BrakePosn: type=VCS_BrakeSwitch, has-getter=true, has-notifier=true, has-setter=false
      field vcs_BrakeSwtich: type=VCS_BrakePosn, has-getter=true, has-notifier=true, has-setter=false
      methods:
        operation nofitySwitch: fire-and-forget=false
          arg VCS_BrakeSwitch: type=VCS_BrakeSwitch, direction=OUT
        operation notifyStatus: fire-and-forget=false
          arg VCS_BrakePosn: type=VCS_BrakePosn, direction=OUT
    VCS_EPB
      namespaces:
        symbol props eevp
        symbol props simulation
      methods:
        operation notifystaticSlope: fire-and-forget=false
          arg VCS_Slope: type=VCS_Slope, direction=OUT
    VCS_Gear
      namespaces:
        symbol props eevp
        symbol props simulation
      field vcs_Gear: type=VCS_Gear, has-getter=true, has-notifier=true, has-setter=false
      methods:
        operation notifyStatus: fire-and-forget=false
          arg VCS_Gear: type=VCS_Gear, direction=OUT
        operation setTarget: fire-and-forget=false
          arg targetGear: type=VCS_Gear, direction=IN
          arg return: type=bool, direction=OUT
    VCS_TqDmd
      namespaces:
        symbol props eevp
        symbol props simulation
      methods:
        operation setDrivePedalPosn: fire-and-forget=false
          arg drivePedalPosn: type=uint16_t, direction=IN
    VCS_VehSpd
      namespaces:
        symbol props eevp
        symbol props simulation
      field vcs_VehSpd: type=VCS_VehSpd, has-getter=true, has-notifier=true, has-setter=false
      methods:
        operation notifyStatus: fire-and-forget=false
          arg VCS_VehSpd: type=VCS_VehSpd, direction=OUT
