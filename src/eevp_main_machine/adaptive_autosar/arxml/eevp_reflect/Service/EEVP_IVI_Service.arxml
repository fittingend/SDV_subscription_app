AUTOSAR XML (schema 00049)
package /ServiceDeployment/Someip
  someip service interface deployment StateManager: service-interface=StateManager, service-interface-id=5121, service-interface-version={major-version=1, minor-version=0}
    someip event deployment NotifySystemState: event=NotifySystemState, event-id=4097, transport-protocol=UDP
    someip field deployment NotifyTime: field=NotifyTime
      get Get_NotifyTime: method-id=8194, transport-protocol=UDP
      notifier Notification_NotifyTime: event-id=8194, transport-protocol=UDP
      set Set_NotifyTime: method-id=12292, transport-protocol=UDP
    someip field deployment SystemState: field=SystemState
      get Get_SystemState: method-id=8193, transport-protocol=UDP
      notifier Notification_SystemState: event-id=8193, transport-protocol=UDP
    someip event group Eventgroup_Notification: event-group-id=4097, event=[NotifySystemState, Notification_NotifyTime, Notification_SystemState]
package /ServiceInstance/Endpoint
  someip service instance to machine mapping IVI_MonitoringApp_SomeipConsumers_MonitoringManagement: communication-connector=eth0, service-instance=IVI_MonitoringApp_Consumer_MonitoringManagement, tcp-port=55011, udp-port=55011
  someip service instance to machine mapping IVI_MonitoringApp_SomeipProviders_StateManager: communication-connector=eth0, service-instance=IVI_MonitoringApp_Provider_StateManager, tcp-port=50051, udp-port=50051
package /ServiceInstance/Someip/Consumer
  required someip service instance IVI_MonitoringApp_Consumer_MonitoringManagement: service-interface-deployment=MonitoringManagement, required-minor-version=ANY, required-service-instance-id=ANY, sd-client-config=DefaultSdClientConfig, version-driven-find-behavior=EXACT-OR-ANY-MINOR-VERSION
    method-request-propss:
      requestAppInstall
      requestAppUpdate
      requestControllerServiceInfo
      requestControllerServiceInfoAll
      requestControllerServiceInfoAllSpare
      requestControllerServiceStatus
      requestControllerServiceStatusAll
      requestControllerServiceStatusAllSpare
      setControlControllerService
      setEnableControllerService
      resetUcmTest
    someip required event group Eventgroup_eventService: event-group=Eventgroup_eventService, sd-client-event-group-timing-config=DefaultSdSubscribeConfig
    someip required event group Eventgroup_eventServiceInfo: event-group=Eventgroup_eventServiceInfo, sd-client-event-group-timing-config=DefaultSdSubscribeConfig
    someip required event group Eventgroup_eventServiceStatus: event-group=Eventgroup_eventServiceStatus, sd-client-event-group-timing-config=DefaultSdSubscribeConfig
package /ServiceInstance/Someip/Provider
  provided someip service instance IVI_MonitoringApp_Provider_StateManager: service-interface-deployment=StateManager, event-propss=[NotifySystemState, Notification_NotifyTime, Notification_SystemState], method-response-propss=[Get_NotifyTime, Set_NotifyTime, Get_SystemState], sd-server-config=DefaultSdServerConfig, service-instance-id=1
    someip provided event group Eventgroup_Notification: event-group=Eventgroup_Notification, multicast-threshold=0
package /ServiceInterface
  service interface StateManager
    namespaces:
      4 x symbol props:
        ivi
        info
        statemanager
        service
    events:
      data NotifySystemState: type=State
    field NotifyTime: type=uint8_t, has-getter=true, has-notifier=true, has-setter=true
    field SystemState: type=State, has-getter=true, has-notifier=true, has-setter=false
