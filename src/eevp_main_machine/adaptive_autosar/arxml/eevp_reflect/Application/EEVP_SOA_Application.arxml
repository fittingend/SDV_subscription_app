AUTOSAR XML (schema 00049)
package /Application/StartupConfig
  startup config set EEVP_SOA_StartupConfig
    startup config SOA: scheduling-policy=SCHED_OTHER, scheduling-priority=0, timeout={enter-timeout-value=30.0, exit-timeout-value=3.0}
