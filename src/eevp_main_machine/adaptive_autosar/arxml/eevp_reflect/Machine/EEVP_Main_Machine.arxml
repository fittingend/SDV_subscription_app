AUTOSAR XML (schema 00049)
package /Machine
  machine EEVP_Main_Machine: machine-design=EEVP_MAIN, trusted-platform-executable-launch-behavior=NO-TRUSTED-PLATFORM-SUPPORT
    module-instantiations:
      log and trace instantiation LOG: dlt-ecu-id=EEVP
        32 x dlt log channel, all with log-trace-log-modes=[CONSOLE, NETWORK]:
          AppIpsvTest: application-id=IPSV, context-id=IPSV, log-trace-default-log-level=INFO
          BatteryMonitor: application-id=BATT, context-id=BATT, log-trace-default-log-level=INFO
          CM: application-id=CM, context-id=CM, log-trace-default-log-level=ERROR
          DummyTest_Consumer: application-id=TCON, context-id=TCON, log-trace-default-log-level=INFO
          DummyTest_Provider: application-id=TPRV, context-id=TPRV, log-trace-default-log-level=INFO
          EM: application-id=EM, context-id=EM, log-trace-default-log-level=ERROR
          IPCHandler: application-id=IPCH, context-id=CTX0, log-trace-default-log-level=INFO
          InfoHealthTest: application-id=HEAL, context-id=HEAL, log-trace-default-log-level=INFO
          IntelligentWiper: application-id=INTW, context-id=INTW, log-trace-default-log-level=INFO
          KATECH: application-id=KATC, context-id=KATC, log-trace-default-log-level=INFO
          LotteService: application-id=COSM, context-id=COSM, log-trace-default-log-level=INFO
          MonitoringManager: application-id=MONM, context-id=MONM, log-trace-default-log-level=INFO
          OTAClient: application-id=OTAC, context-id=OTAC, log-trace-default-log-level=INFO
          OTATestP: application-description=OTA Test PPort Applicatoin, application-id=OTAP, context-id=OTAP, log-trace-default-log-level=INFO
          OTATestR: application-description=OTA Test RPort Applicatoin, application-id=OTAR, context-id=OTAR, log-trace-default-log-level=INFO
          PHM: application-id=PHM, context-id=PHM, log-trace-default-log-level=ERROR, non-verbose-mode=true
          SC_PDW_FRONT: application-id=PDWF, context-id=PDWF, log-trace-default-log-level=INFO
          SC_PDW_REAR: application-id=PDWR, context-id=PDWR, log-trace-default-log-level=INFO
          SESLService: application-id=SESL, context-id=SESL, log-trace-default-log-level=INFO
          SM: application-id=SM, context-id=SM, log-trace-default-log-level=INFO
          SOA_Debugger: application-id=SDBG, context-id=SDBG, log-trace-default-log-level=INFO
          SOA_DriverSeat: application-id=SDST, context-id=SDST, log-trace-default-log-level=INFO
          SOA_MoodLamp: application-id=SMLM, context-id=SMLM, log-trace-default-log-level=INFO
          SOA_Power: application-id=SPWR, context-id=SPWR, log-trace-default-log-level=INFO
          SOA_ROA: application-id=SROA, context-id=SROA, log-trace-default-log-level=INFO
          SOA_RearCurtain: application-id=SRCT, context-id=SRCT, log-trace-default-log-level=INFO
          SOA_Wiper: application-id=SWIP, context-id=SWIP, log-trace-default-log-level=INFO
          ServiceCreator: application-id=SVCC, context-id=SVCC, log-trace-default-log-level=INFO
          SubscriptionManager: application-id=SUSM, context-id=SUSM, log-trace-default-log-level=INFO
          UCM: application-id=UCM, context-id=UCM, log-trace-default-log-level=ERROR
          VDI: application-id=VDI, context-id=VDI, log-trace-default-log-level=INFO
          VUCM: application-id=VUCM, context-id=VUCM, log-trace-default-log-level=ERROR
      os module instantiation POSIX
        resource group DefaultResourceGroup
      ucm module instantiation UCM: identifier=EEVP_UCM
    processor S32G2
      4 x processor core:
        Core{0..3}: core-id={0..3}
package /Machine/FunctionGroup
  function group set EEVP_Main_FunctionGroup
    function-groups:
      4 x mode declaration group prototype:
        MachineFG: type=MachineState
        OTATestFG: type=OTATestState
        SC: type=SCState
        SS: type=SSState
package /Machine/PlatformHealth
  platform health management contribution EEVP_Main_PHM
  phm contribution to machine mapping EEVP_Main_PhmContributionToMachineMapping: machine=EEVP_Main_Machine, phm-contribution=EEVP_Main_PHM
package /Machine/ProcessToMachine
  process to machine mapping set EEVP_Main_ProcessToMachineMapping
    13 x process to machine mapping, all with machine=EEVP_Main_Machine:
      ProcessToMachineMapping_BatteryMonitor_TO_EEVP_Main_Machine_TO_UnknownModule: process=BatteryMonitor
      ProcessToMachineMapping_CM_TO_EEVP_Machine_TO_UnknownModule: process=CM
      ProcessToMachineMapping_EM_TO_EEVP_Main_Machine_TO_UnknownModule: process=EM
      ProcessToMachineMapping_IPCHandler_TO_EEVP_Main_Machine_TO_UnknownModule: process=IPCHandler
      ProcessToMachineMapping_IntelligentWiper_TO_EEVP_Main_Machine_TO_UnknownModule: process=IntelligentWiper
      ProcessToMachineMapping_KATECH_TO_EEVP_Main_Machine_TO_UnknownModule: process=KATECH
      ProcessToMachineMapping_LotteService_TO_EEVP_Main_Machine_TO_UnknownModule: process=LotteService
      ProcessToMachineMapping_SESLService_TO_EEVP_Main_Machine_TO_UnknownModule: process=SESLService
      ProcessToMachineMapping_SM_TO_EEVP_Main_Machine_TO_UnknownModule: process=SM
      ProcessToMachineMapping_ServiceCreator_TO_EEVP_Main_Machine_TO_UnknownModule: process=ServiceCreator
      ProcessToMachineMapping_UCM_TO_EEVP_Main_Machine_TO_UnknownModule: process=UCM
      ProcessToMachineMapping_VDI_TO_EEVP_Main_Machine_TO_UnknownModule: process=VDI
      ProcessToMachineMapping_VUCM_TO_EEVP_Machine_TO_UnknownModule: process=VUCM
  process design to machine design mapping set ProcessDesignToMachineDesignMappingSet
package /StateMachine
  5 x mode declaration group:
    MachineState: initial-mode=MachineState/Off
      5 x mode:
        Off
        Restart
        Shutdown
        Startup
        Verify
    OTATestState: initial-mode=OTATestState/Off
      mode Off
      mode On
      mode Verify
    ProcessState: initial-mode=Idle
      4 x mode:
        Idle
        Running
        Starting
        Terminated
    SCState: initial-mode=SCState/Off
      mode Off
      mode On
      mode Verify
    SSState: initial-mode=SSState/Off
      mode Off
      mode On
      mode Verify
