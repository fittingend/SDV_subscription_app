AUTOSAR XML (schema 00049)
package /ServiceDeployment/Someip
  5 x someip service interface deployment, all with service-interface-version={major-version=1, minor-version=0}:
    BCM_WiperWash: service-interface=BCM_WiperWash, service-interface-id=9000
      9 x someip method deployment, all with transport-protocol=UDP:
        getWipingInterval: method=getWipingInterval, method-id=1
        getWipingLevel: method=getWipingLevel, method-id=2
        isWiping: method=isWiping, method-id=3
        notifyWipingStatus: method=notifyWipingStatus, method-id=4
        setWipingInterval: method=setWipingInterval, method-id=5
        setWipingLevel: method=setWipingLevel, method-id=6
        setWipingLevelImme: method=setWipingLevelImme, method-id=7
        startWiping: method=startWiping, method-id=8
        stopWiping: method=stopWiping, method-id=9
    VCS_AccrPedal: service-interface=VCS_AccrPedal, service-interface-id=9003
      someip method deployment notifyStatus: method=nofityStatus, method-id=1, transport-protocol=UDP
    VCS_BrakeSwitch: service-interface=VCS_BrakeSwitch, service-interface-id=9002
      someip method deployment notifySwitch: method=nofitySwitch, method-id=1, transport-protocol=UDP
    VCS_Gear: service-interface=VCS_Gear, service-interface-id=9004
      someip method deployment notifyStatus: method=VCS_Gear/notifyStatus, method-id=1, transport-protocol=UDP
    VCS_VehSpd: service-interface=VCS_VehSpd, service-interface-id=9001
      someip method deployment notifyStatus: method=VCS_VehSpd/notifyStatus, method-id=1, transport-protocol=UDP
package /ServiceInstance/Endpoint
  5 x someip service instance to machine mapping, all with communication-connector=eth0:
    EEVP_ServiceCreator_SomeipProviders_BCM_WiperWash: service-instance=Provider_BCM_WiperWash, tcp-port=50093, udp-port=50093
    EEVP_ServiceCreator_SomeipProviders_VCS_AccrPedal: service-instance=Provider_VCS_AccrPedal, tcp-port=50096, udp-port=50096
    EEVP_ServiceCreator_SomeipProviders_VCS_BrakeSwitch: service-instance=Provider_VCS_BrakeSwitch, tcp-port=50095, udp-port=50095
    EEVP_ServiceCreator_SomeipProviders_VCS_Gear: service-instance=Provider_VCS_Gear, tcp-port=50097, udp-port=50097
    EEVP_ServiceCreator_SomeipProviders_VCS_VehSpd: service-instance=Provider_VCS_VehSpd, tcp-port=50094, udp-port=50094
package /ServiceInstance/Someip/Provider
  5 x provided someip service instance, all with sd-server-config=DefaultSdServerConfig:
    Provider_BCM_WiperWash: service-interface-deployment=BCM_WiperWash, service-instance-id=9000
      method-response-propss:
        getWipingInterval
        getWipingLevel
        isWiping
        notifyWipingStatus
        setWipingInterval
        setWipingLevel
        setWipingLevelImme
        startWiping
        method=stopWiping
    Provider_VCS_AccrPedal: service-interface-deployment=VCS_AccrPedal, someip-method-props=VCS_AccrPedal/notifyStatus, service-instance-id=9003
    Provider_VCS_BrakeSwitch: service-interface-deployment=VCS_BrakeSwitch, someip-method-props=notifySwitch, service-instance-id=9002
    Provider_VCS_Gear: service-interface-deployment=VCS_Gear, someip-method-props=VCS_Gear/notifyStatus, service-instance-id=9004
    Provider_VCS_VehSpd: service-interface-deployment=VCS_VehSpd, someip-method-props=method=VCS_VehSpd/notifyStatus, service-instance-id=9001
package /ServiceInterface
  5 x service interface, all with major-version=1, minor-version=0:
    BCM_WiperWash
      namespaces:
        symbol props eevp
        symbol props simulation
      methods:
        9 x operation, all with fire-and-forget=false:
          getWipingInterval
            arg wipingInterval: type=uint16_t, direction=OUT
          getWipingLevel
            arg wipingLevel: type=BCM_WipingLevel, direction=OUT
          isWiping
            arg isWiping: type=bool, direction=OUT
          notifyWipingStatus
            arg isWiping: type=bool, direction=OUT
          setWipingInterval
            arg wipingInterval: type=uint16_t, direction=IN
            arg returnCode: type=BCM_ReturnCode, direction=OUT
          setWipingLevel
            arg wipingLevel: type=BCM_WipingLevel, direction=IN
            arg returnCode: type=BCM_ReturnCode, direction=OUT
          setWipingLevelImme
            arg wipingLevel: type=BCM_WipingLevel, direction=IN
            arg returnCode: type=BCM_ReturnCode, direction=OUT
          startWiping
            arg returnCode: type=BCM_ReturnCode, direction=OUT
          stopWiping
            arg returnCode: type=BCM_ReturnCode, direction=OUT
    VCS_AccrPedal
      namespaces:
        symbol props eevp
        symbol props simulation
      methods:
        operation nofityStatus: fire-and-forget=false
          arg VCS_AccrPedal: type=VCS_AccrPedal, direction=OUT
    VCS_BrakeSwitch
      namespaces:
        symbol props eevp
        symbol props simulation
      methods:
        operation nofitySwitch: fire-and-forget=false
          arg VCS_BrakeSwitch: type=VCS_BrakeSwitch, direction=OUT
    VCS_Gear
      namespaces:
        symbol props eevp
        symbol props simulation
      methods:
        operation notifyStatus: fire-and-forget=false
          arg VCS_Gear: type=VCS_Gear, direction=OUT
    VCS_VehSpd
      namespaces:
        symbol props eevp
        symbol props simulation
      methods:
        operation notifyStatus: fire-and-forget=false
          arg VCS_VehSpd: type=VCS_VehSpd, direction=OUT
