AUTOSAR XML (schema 00049)
package /ServiceDeployment/Someip
  6 x someip service interface deployment, all with service-interface-version={major-version=1, minor-version=0}:
    SoaDriverSeat: service-interface=SoaDriverSeat, service-interface-id=4946
      someip field deployment soaDrvSeatDeviceNormal: field=soaDrvSeatDeviceNormal
        get Get_soaDrvSeatDeviceNormal: method-id=1, transport-protocol=UDP
        notifier Notification_soaDrvSeatDeviceNormal: event-id=16385, transport-protocol=UDP
      someip field deployment soaDrvSeatMotorDirection: field=soaDrvSeatMotorDirection
        get Get_soaDrvSeatMotorDirection: method-id=2, transport-protocol=UDP
        notifier Notify_soaDrvSeatMotorDirection: event-id=16386, transport-protocol=UDP
      someip field deployment soaDrvSeatMotorPosition: field=soaDrvSeatMotorPosition
        get Get_soaDrvSeatMotorPosition: method-id=3, transport-protocol=UDP
        notifier Notify_soaDrvSeatMotorPosition: event-id=16387, transport-protocol=UDP
      4 x someip method deployment, all with transport-protocol=UDP:
        RequestMoveDrvSeatHeight: method=RequestMoveDrvSeatHeight, method-id=16387
        RequestMoveDrvSeatRecline: method=RequestMoveDrvSeatRecline, method-id=16386
        RequestMoveDrvSeatSlide: method=RequestMoveDrvSeatSlide, method-id=16385
        RequestMoveDrvSeatTilt: method=RequestMoveDrvSeatTilt, method-id=16388
      someip event group Eventgroup_Notification_soaDrvSeatDeviceNormal: event-group-id=8449, event=Notification_soaDrvSeatDeviceNormal
      someip event group Eventgroup_Notification_soaDrvSeatMotorDirection: event-group-id=8450, event=Notify_soaDrvSeatMotorDirection
      someip event group Eventgroup_Notification_soaDrvSeatMotorPosition: event-group-id=8451, event=Notify_soaDrvSeatMotorPosition
    SoaMlm: service-interface=SoaMlm, service-interface-id=4945
      someip field deployment soaMlmStatus: field=soaMlmStatus
        get Get_soaMlmStatus: method-id=1, transport-protocol=UDP
        notifier Notification_soaMlmStatus: event-id=16385, transport-protocol=UDP
      someip method deployment RequestMlmSetBrightness: method=RequestMlmSetBrightness, method-id=16387, transport-protocol=UDP
      someip method deployment RequestMlmSetMode: method=RequestMlmSetMode, method-id=16386, transport-protocol=UDP
      someip method deployment RequestMlmSetRgbColor: method=RequestMlmSetRgbColor, method-id=16385, transport-protocol=UDP
      someip event group Eventgroup_Notification_soaMlmStatus: event-group-id=8449, event=Notification_soaMlmStatus
    SoaPower: service-interface=SoaPower, service-interface-id=4944
      8 x someip field deployment:
        soaPwrZone1Curr: field=soaPwrZone1Curr
          get Get_soaPwrZone1Curr: method-id=2, transport-protocol=UDP
          notifier Notification_soaPwrZone1Curr: event-id=16386, transport-protocol=UDP
        soaPwrZone1Power: field=soaPwrZone1Power
          get Get_soaPwrZone1Power: method-id=1, transport-protocol=UDP
          notifier Notification_soaPwrZone1Power: event-id=16385, transport-protocol=UDP
        soaPwrZone2Curr: field=soaPwrZone2Curr
          get Get_soaPwrZone2Curr: method-id=4, transport-protocol=UDP
          notifier Notification_soaPwrZone2Curr: event-id=16388, transport-protocol=UDP
        soaPwrZone2Power: field=soaPwrZone2Power
          get Get_soaPwrZone2Power: method-id=3, transport-protocol=UDP
          notifier Notification_soaPwrZone2Power: event-id=16387, transport-protocol=UDP
        soaPwrZone3Curr: field=soaPwrZone3Curr
          get Get_soaPwrZone3Curr: method-id=6, transport-protocol=UDP
          notifier Notification_soaPwrZone3Curr: event-id=16390, transport-protocol=UDP
        soaPwrZone3Power: field=soaPwrZone3Power
          get Get_soaPwrZone3Power: method-id=5, transport-protocol=UDP
          notifier Notification_soaPwrZone3Power: event-id=16389, transport-protocol=UDP
        soaPwrZone4Curr: field=soaPwrZone4Curr
          get Get_soaPwrZone4Curr: method-id=8, transport-protocol=UDP
          notifier Notification_soaPwrZone4Curr: event-id=16392, transport-protocol=UDP
        soaPwrZone4Power: field=soaPwrZone4Power
          get Get_soaPwrZone4Power: method-id=7, transport-protocol=UDP
          notifier Notification_soaPwrZone4Power: event-id=16391, transport-protocol=TCP
      9 x someip method deployment, all with transport-protocol=UDP:
        SetEnableDrvseat: method=SetEnableDrvseat, method-id=16386
        SetEnableFrontPdw: method=SetEnableFrontPdw, method-id=16393
        SetEnableMfsw: method=SetEnableMfsw, method-id=16387
        SetEnableMlm: method=SetEnableMlm, method-id=16385
        SetEnableRainSensor: method=SetEnableRainSensor, method-id=16389
        SetEnableRearCurtain: method=SetEnableRearCurtain, method-id=16390
        SetEnableRearPdw: method=SetEnableRearPdw, method-id=16391
        SetEnableRoa: method=SetEnableRoa, method-id=16388
        SetEnableWiper: method=SetEnableWiper, method-id=16392
      8 x someip event group:
        Eventgroup_Notification_soaPwrZone1Curr: event-group-id=8194, event=Notification_soaPwrZone1Curr
        Eventgroup_Notification_soaPwrZone1Power: event-group-id=8193, event=Notification_soaPwrZone1Power
        Eventgroup_Notification_soaPwrZone2Curr: event-group-id=8196, event=Notification_soaPwrZone2Curr
        Eventgroup_Notification_soaPwrZone2Power: event-group-id=8195, event=Notification_soaPwrZone2Power
        Eventgroup_Notification_soaPwrZone3Curr: event-group-id=8198, event=Notification_soaPwrZone3Curr
        Eventgroup_Notification_soaPwrZone3Power: event-group-id=8197, event=Notification_soaPwrZone3Power
        Eventgroup_Notification_soaPwrZone4Curr: event-group-id=8200, event=Notification_soaPwrZone4Curr
        Eventgroup_Notification_soaPwrZone4Power: event-group-id=8199, event=Notification_soaPwrZone4Power
    SoaRcurtain: service-interface=SoaRcurtain, service-interface-id=4948
      someip field deployment soaRctnStatus: field=soaRctnStatus
        get Get_soaRctnStatus: method-id=1, transport-protocol=UDP
        notifier Notification_soaRctnStatus: event-id=16385, transport-protocol=UDP
      someip method deployment RequestRearCurtainOperation: method=RequestRearCurtainOperation, method-id=16385, transport-protocol=UDP
      someip event group Eventgroup_Notification_soaRctnStatus: event-group-id=8449, event=Notification_soaRctnStatus
    SoaRoa: service-interface=SoaRoa, service-interface-id=4947
      6 x someip field deployment:
        soaRoaDetectCount: field=soaRoaDetectCount
          get Get_soaRoaDetectCount: method-id=5, transport-protocol=UDP
          notifier Notify_soaRoaDetectCount: event-id=16389, transport-protocol=UDP
        soaRoaDetectState: field=soaRoaDetectState
          get Get_soaRoaDetectState: method-id=4, transport-protocol=UDP
          notifier Notify_soaRoaDetectState: event-id=16388, transport-protocol=UDP
        soaRoaDeviceNormal: field=soaRoaDeviceNormal
          get Get_soaRoaDeviceNormal: method-id=1, transport-protocol=UDP
          notifier Notify_soaRoaDeviceNormal: event-id=16385, transport-protocol=UDP
        soaRoaMode: field=soaRoaMode
          get Get_soaRoaMode: method-id=3, transport-protocol=UDP
          notifier Notify_soaRoaMode: event-id=16387, transport-protocol=UDP
        soaRoaRunningState: field=soaRoaRunningState
          get Get_soaRoaRunningState: method-id=2, transport-protocol=UDP
          notifier Notify_soaRoaRunningState: event-id=16386, transport-protocol=UDP
        soaRoaSensorError: field=soaRoaSensorError
          get Get_soaRoaSensorError: method-id=6, transport-protocol=UDP
          notifier Notify_soaRoaSensorError: event-id=16390, transport-protocol=UDP
      4 x someip method deployment, all with transport-protocol=UDP:
        ResetRoaDetectInfo: method=ResetRoaDetectInfo, method-id=16387
        SetRoaMode: method=SetRoaMode, method-id=16388
        StartRoa: method=StartRoa, method-id=16385
        StopRoa: method=StopRoa, method-id=16386
      6 x someip event group:
        Eventgroup3_Notification_soaRoaDetectState: event-group-id=8452, event=Notify_soaRoaDetectState
        Eventgroup_Notification_soaRoaDetectCount: event-group-id=8453, event=Notify_soaRoaDetectCount
        Eventgroup_Notification_soaRoaDeviceNormal: event-group-id=8449, event=Notify_soaRoaDeviceNormal
        Eventgroup_Notification_soaRoaMode: event-group-id=8451, event=Notify_soaRoaMode
        Eventgroup_Notification_soaRoaRunningState: event-group-id=8450, event=Notify_soaRoaRunningState
        Eventgroup_Notification_soaRoaSensorError: event-group-id=8454, event=Notify_soaRoaSensorError
    SoaWiper: service-interface=SoaWiper, service-interface-id=4949
      someip field deployment soaWiperDeviceNormal: field=soaWiperDeviceNormal
        get Get_soaWiperDeviceNormal: method-id=1, transport-protocol=UDP
        notifier Notify_soaWiperDeviceNormal: event-id=16385, transport-protocol=UDP
      someip field deployment soaWiperStatus: field=soaWiperStatus
        get Get_soaWiperStatus: method-id=2, transport-protocol=UDP
        notifier Notify_soaWiperStatus: event-id=16386, transport-protocol=UDP
      someip method deployment RequestWiperOperation: method=RequestWiperOperation, method-id=16386, transport-protocol=UDP
      someip method deployment SetWiperAutoSpeed: method=SetWiperAutoSpeed, method-id=16385, transport-protocol=UDP
      someip event group Eventgroup_Notification_soaWiperDeviceNormal: event-group-id=8449, event=Notify_soaWiperDeviceNormal
      someip event group Eventgroup_Notification_soaWiperStatus: event-group-id=8450, event=Notify_soaWiperStatus
package /ServiceInstance/Endpoint
  12 x someip service instance to machine mapping, all with communication-connector=eth0:
    EEVP_SOA_DriverSeat_SomeIpConsumer: service-instance=Consumer_SoaDriverSeat, tcp-port=37775, udp-port=37775
    EEVP_SOA_DriverSeat_SomeIpProvider: service-instance=Provider_SoaDriverSeat, tcp-port=37774, udp-port=37774
    EEVP_SOA_MLM_SomeIpConsumer: service-instance=Consumer_SoaMlm, tcp-port=37767, udp-port=37767
    EEVP_SOA_MLM_SomeIpProvider: service-instance=Provider_SoaMlm, tcp-port=37766, udp-port=37766
    EEVP_SOA_POWER_SomeIpConsumer: service-instance=Consumer_SoaPower, tcp-port=37763, udp-port=37763
    EEVP_SOA_POWER_SomeIpProvider: service-instance=Provider_SoaPower, tcp-port=37762, udp-port=37762
    EEVP_SOA_RCRTN_SomeIpConsumer: service-instance=Consumer_SoaRcurtain, tcp-port=37765, udp-port=37765
    EEVP_SOA_RCRTN_SomeIpProvider: service-instance=Provider_SoaRcurtain, tcp-port=37764, udp-port=37764
    EEVP_SOA_ROA_SomeIpConsumer: service-instance=[Consumer_SoaRoa, EEVP_KATECH_Consumer_SoaRoa], tcp-port=37769, udp-port=37769
    EEVP_SOA_ROA_SomeIpProvider: service-instance=Provider_SoaRoa, tcp-port=37768, udp-port=37768
    EEVP_SOA_Wiper_SomeIpConsumer: service-instance=Consumer_SoaWiper, tcp-port=37773, udp-port=37773
    EEVP_SOA_Wiper_SomeIpProvider: service-instance=Provider_SoaWiper, tcp-port=37772, udp-port=37772
package /ServiceInstance/SdTimingConfig/Client
  someip sd client service instance config DefaultClientConfig: initial-find-behavior={initial-delay-max-value=0.1, initial-delay-min-value=0.1, initial-repetitions-base-delay=0.1, initial-repetitions-max=3}, service-find-time-to-live=16777215
package /ServiceInstance/SdTimingConfig/Server
  someip sd server service instance config DefaultSdServerConfig: initial-offer-behavior={initial-delay-max-value=0.1, initial-delay-min-value=0.1, initial-repetitions-base-delay=0.1, initial-repetitions-max=2}, offer-cyclic-delay=0.5, request-response-delay={max-value=0.0, min-value=0.0}, service-offer-time-to-live=16777215
package /ServiceInstance/SdTimingConfig/Subscription
  someip sd client event group timing config DefaultSdSubscribeConfig: request-response-delay={max-value=0.0, min-value=0.0}, subscribe-eventgroup-retry-delay=0.0, subscribe-eventgroup-retry-max=3, time-to-live=16777215
package /ServiceInstance/Someip/Consumer
  6 x required someip service instance, all with required-service-instance-id=ANY:
    Consumer_SoaDriverSeat: service-interface-deployment=SoaDriverSeat, sd-client-config=DefaultSdClientConfig
      someip required event group Eventgroup_Notification_isDeviceNormal: event-group=Eventgroup_Notification_soaDrvSeatDeviceNormal, sd-client-event-group-timing-config=DefaultSdSubscribeConfig
    Consumer_SoaMlm: service-interface-deployment=SoaMlm, method-request-propss=[Get_soaMlmStatus, RequestMlmSetRgbColor, RequestMlmSetMode, RequestMlmSetBrightness], sd-client-config=DefaultSdClientConfig
      someip required event group Eventgroup_Notification_soaMlmStatus: event-group=Eventgroup_Notification_soaMlmStatus, sd-client-event-group-timing-config=DefaultSdSubscribeConfig
    Consumer_SoaPower: service-interface-deployment=SoaPower, sd-client-config=DefaultSdClientConfig
      method-request-propss:
        Get_soaPwrZone1Power
        Get_soaPwrZone1Curr
        Get_soaPwrZone2Power
        Get_soaPwrZone2Curr
        Get_soaPwrZone3Power
        Get_soaPwrZone3Curr
        Get_soaPwrZone4Power
        Get_soaPwrZone4Curr
        SetEnableMlm
        SetEnableDrvseat
        SetEnableMfsw
        SetEnableRoa
        SetEnableRainSensor
        SetEnableRearCurtain
        SetEnableRearPdw
        SetEnableWiper
        SetEnableFrontPdw
      8 x someip required event group, all with sd-client-event-group-timing-config=DefaultSdSubscribeConfig:
        Eventgroup_Notification_soaPwrZone1Curr: event-group=Eventgroup_Notification_soaPwrZone1Curr
        Eventgroup_Notification_soaPwrZone1Power: event-group=Eventgroup_Notification_soaPwrZone1Power
        Eventgroup_Notification_soaPwrZone2Curr: event-group=Eventgroup_Notification_soaPwrZone2Curr
        Eventgroup_Notification_soaPwrZone2Power: event-group=Eventgroup_Notification_soaPwrZone2Power
        Eventgroup_Notification_soaPwrZone3Curr: event-group=Eventgroup_Notification_soaPwrZone3Curr
        Eventgroup_Notification_soaPwrZone3Power: event-group=Eventgroup_Notification_soaPwrZone3Power
        Eventgroup_Notification_soaPwrZone4Curr: event-group=Eventgroup_Notification_soaPwrZone4Curr
        Eventgroup_Notification_soaPwrZone4Power: event-group=Eventgroup_Notification_soaPwrZone4Power
    Consumer_SoaRcurtain: service-interface-deployment=SoaRcurtain, method-request-propss=[Get_soaRctnStatus, RequestRearCurtainOperation], sd-client-config=DefaultClientConfig
      someip required event group Eventgroup_Notification_soaRctnStatus: event-group=Eventgroup_Notification_soaRctnStatus, sd-client-event-group-timing-config=DefaultSdSubscribeConfig
    Consumer_SoaRoa: service-interface-deployment=SoaRoa, sd-client-config=DefaultSdClientConfig
      someip required event group Eventgroup_Notification_isDeviceNormal: event-group=Eventgroup_Notification_soaRoaDeviceNormal, sd-client-event-group-timing-config=DefaultSdSubscribeConfig
    Consumer_SoaWiper: service-interface-deployment=SoaWiper, sd-client-config=DefaultClientConfig
      someip required event group Eventgroup_Notification_isDeviceNormal: event-group=Eventgroup_Notification_soaWiperDeviceNormal, sd-client-event-group-timing-config=DefaultSdSubscribeConfig
package /ServiceInstance/Someip/Provider
  6 x provided someip service instance, all with sd-server-config=DefaultSdServerConfig:
    Provider_SoaDriverSeat: service-interface-deployment=SoaDriverSeat, someip-event-props=Notification_soaDrvSeatDeviceNormal, service-instance-id=4962
      someip provided event group Eventgroup_Notification_isDeviceNormal: event-group=Eventgroup_Notification_soaDrvSeatDeviceNormal, multicast-threshold=0
    Provider_SoaMlm: service-interface-deployment=SoaMlm, someip-event-props=Notification_soaMlmStatus, method-response-propss=[Get_soaMlmStatus, RequestMlmSetRgbColor, RequestMlmSetMode, RequestMlmSetBrightness], service-instance-id=4961
      someip provided event group Eventgroup_Notification_soaMlmStatus: event-group=Eventgroup_Notification_soaMlmStatus, multicast-threshold=0
    Provider_SoaPower: service-interface-deployment=SoaPower, service-instance-id=4960
      event-propss:
        Notification_soaPwrZone1Power
        Notification_soaPwrZone1Curr
        Notification_soaPwrZone2Power
        Notification_soaPwrZone2Curr
        Notification_soaPwrZone3Power
        Notification_soaPwrZone3Curr
        Notification_soaPwrZone4Power
        Notification_soaPwrZone4Curr
      method-response-propss:
        Get_soaPwrZone1Power
        Get_soaPwrZone1Curr
        Get_soaPwrZone2Power
        Get_soaPwrZone2Curr
        Get_soaPwrZone3Power
        Get_soaPwrZone3Curr
        Get_soaPwrZone4Power
        Get_soaPwrZone4Curr
        SetEnableMlm
        SetEnableDrvseat
        SetEnableMfsw
        SetEnableRoa
        SetEnableRainSensor
        SetEnableRearCurtain
        SetEnableRearPdw
        SetEnableWiper
        SetEnableFrontPdw
      8 x someip provided event group, all with multicast-threshold=0:
        Eventgroup_Notification_soaPwrZone1Curr: event-group=Eventgroup_Notification_soaPwrZone1Curr
        Eventgroup_Notification_soaPwrZone1Power: event-group=Eventgroup_Notification_soaPwrZone1Power
        Eventgroup_Notification_soaPwrZone2Curr: event-group=Eventgroup_Notification_soaPwrZone2Curr
        Eventgroup_Notification_soaPwrZone2Power: event-group=Eventgroup_Notification_soaPwrZone2Power
        Eventgroup_Notification_soaPwrZone3Curr: event-group=Eventgroup_Notification_soaPwrZone3Curr
        Eventgroup_Notification_soaPwrZone3Power: event-group=Eventgroup_Notification_soaPwrZone3Power
        Eventgroup_Notification_soaPwrZone4Curr: event-group=Eventgroup_Notification_soaPwrZone4Curr
        Eventgroup_Notification_soaPwrZone4Power: event-group=Eventgroup_Notification_soaPwrZone4Power
    Provider_SoaRcurtain: service-interface-deployment=SoaRcurtain, someip-event-props=Notification_soaRctnStatus, method-response-propss=[Get_soaRctnStatus, RequestRearCurtainOperation], service-instance-id=4964
      someip provided event group Eventgroup_Notification_soaRctnStatus: event-group=Eventgroup_Notification_soaRctnStatus, multicast-threshold=0
    Provider_SoaRoa: service-interface-deployment=SoaRoa, someip-event-props=event=Notify_soaRoaDeviceNormal, service-instance-id=4963
      someip provided event group Eventgroup_Notification_isDeviceNormal: event-group=Eventgroup_Notification_soaRoaDeviceNormal, multicast-threshold=0
    Provider_SoaWiper: service-interface-deployment=SoaWiper, someip-event-props=Notify_soaWiperDeviceNormal, service-instance-id=4965
      someip provided event group Eventgroup_Notification_isDeviceNormal: event-group=Eventgroup_Notification_soaWiperDeviceNormal, multicast-threshold=0
package /ServiceInterface
  6 x service interface, all with category=COMMUNICATION_GROUP, major-version=1, minor-version=0:
    SoaDriverSeat
      namespaces:
        symbol props eevp
        symbol props control
      field soaDrvSeatDeviceNormal: type=SoaDeviceIsNormal, has-getter=true, has-notifier=true, has-setter=false
      field soaDrvSeatMotorDirection: type=SoaSeatMotorDirection, has-getter=true, has-notifier=true, has-setter=false
      field soaDrvSeatMotorPosition: type=SoaSeatMotorPosition, has-getter=true, has-notifier=true, has-setter=false
      methods:
        4 x operation, all with fire-and-forget=true:
          RequestMoveDrvSeatHeight
            arg dir: type=SoaSeatHeightDirection, direction=IN
          RequestMoveDrvSeatRecline
            arg dir: type=SoaSeatReclineDirection, direction=IN
          RequestMoveDrvSeatSlide
            arg dir: type=SoaSeatSlideDirection, direction=IN
          RequestMoveDrvSeatTilt
            arg dir: type=SoaSeatTiltDirection, direction=IN
    SoaMlm
      namespaces:
        symbol props eevp
        symbol props control
      field soaMlmStatus: type=SoaMlmStatus, has-getter=true, has-notifier=true, has-setter=false
      methods:
        operation RequestMlmSetBrightness: fire-and-forget=true
          arg brightness: type=uint16_t, direction=IN
        operation RequestMlmSetMode: fire-and-forget=true
          arg mood: type=SoaMlmMoodMode, direction=IN
        operation RequestMlmSetRgbColor: fire-and-forget=true
          arg colorTableIndex: type=uint8_t, direction=IN
    SoaPower
      namespaces:
        symbol props eevp
        symbol props control
      8 x field, all with has-getter=true, has-notifier=true, has-setter=false:
        soaPwrZone1Curr: type=SoaPwrZone1Curr
        soaPwrZone1Power: type=SoaPwrZone1Power
        soaPwrZone2Curr: type=SoaPwrZone2Curr
        soaPwrZone2Power: type=SoaPwrZone2Power
        soaPwrZone3Curr: type=SoaPwrZone3Curr
        soaPwrZone3Power: type=SoaPwrZone3Power
        soaPwrZone4Curr: type=SoaPwrZone4Curr
        soaPwrZone4Power: type=SoaPwrZone4Power
      methods:
        9 x operation, all with fire-and-forget=true:
          SetEnableDrvseat
            arg mlmSoaPowerState: type=uint8_t, direction=IN
            arg drvseatSoaPowerState: type=uint8_t, direction=IN
            arg mfswSoaPowerState: type=uint8_t, direction=IN
          SetEnableFrontPdw
            arg rpdwTurnOn: type=bool, direction=IN
          SetEnableMfsw
            arg mfswTurnOn: type=bool, direction=IN
          SetEnableMlm
            arg mlmTurnOn: type=bool, direction=IN
          SetEnableRainSensor
            arg rainSnsrTurnOn: type=bool, direction=IN
          SetEnableRearCurtain
            arg rCurtTurnOn: type=bool, direction=IN
          SetEnableRearPdw
            arg rpdwTurnOn: type=bool, direction=IN
          SetEnableRoa
            arg roaTurnOn: type=bool, direction=IN
          SetEnableWiper
            arg rCurtTurnOn: type=bool, direction=IN
    SoaRcurtain
      namespaces:
        symbol props eevp
        symbol props control
      field soaRctnStatus: type=SoaRctnStatus, has-getter=true, has-notifier=true, has-setter=false
      methods:
        operation RequestRearCurtainOperation: fire-and-forget=false
          arg motorDir: type=SoaRctnMotorDir, direction=IN
          arg err: type=SoaErrorState, direction=OUT
    SoaRoa
      namespaces:
        symbol props eevp
        symbol props control
      6 x field, all with has-getter=true, has-notifier=true, has-setter=false:
        soaRoaDetectCount: type=uint8_t
        soaRoaDetectState: type=SoaRoaDetectState
        soaRoaDeviceNormal: type=SoaDeviceIsNormal
        soaRoaMode: type=SoaRoaMode
        soaRoaRunningState: type=SoaRoaRunningState
        soaRoaSensorError: type=SoaRoaSensorError
      methods:
        4 x operation, all with fire-and-forget=true:
          ResetRoaDetectInfo
          SetRoaMode
            arg mode: type=SoaRoaMode, direction=IN
          StartRoa
          StopRoa
    SoaWiper
      namespaces:
        symbol props eevp
        symbol props control
      field soaWiperDeviceNormal: type=SoaDeviceIsNormal, has-getter=true, has-notifier=true, has-setter=false
      field soaWiperStatus: type=SoaWiperStatus, has-getter=true, has-notifier=true, has-setter=false
      methods:
        operation RequestWiperOperation: fire-and-forget=true
          arg mode: type=SoaWiperMode, direction=IN
        operation SetWiperAutoSpeed: fire-and-forget=true
          arg isAutoSpeed: type=bool, direction=IN
