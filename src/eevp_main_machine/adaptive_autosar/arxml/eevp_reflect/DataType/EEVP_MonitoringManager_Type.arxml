AUTOSAR XML (schema 00049)
package /DataType/CppImplementationType
  12 x std cpp implementation data type:
    ControllerServiceErrorEvent: category=STRUCTURE
      namespaces:
        symbol props eevp
        symbol props monitoring
        symbol props type
      cpp implementation data type element serviceName: type-reference=String
      cpp implementation data type element serviceStatus: type-reference=String
      cpp implementation data type element serviceError: type-reference=String
    ControllerServiceInfo: category=STRUCTURE
      namespaces:
        symbol props eevp
        symbol props monitoring
        symbol props type
      cpp implementation data type element serviceName: type-reference=String
      cpp implementation data type element version: type-reference=String
      cpp implementation data type element lastUpdateTime: type-reference=uint64_t
    ControllerServiceInfoError: compu {0x00=NO_ERROR, 0x01=INVALID}, type-reference=uint8_t
      namespaces:
        symbol props eevp
        symbol props monitoring
        symbol props type
    ControllerServiceInfoMap: category=ASSOCIATIVE_MAP, template-arguments=[String, ControllerServiceInfo]
      namespaces:
        symbol props eevp
        symbol props monitoring
        symbol props type
    ControllerServiceInfoSpare: category=STRUCTURE
      namespaces:
        symbol props eevp
        symbol props monitoring
        symbol props type
      cpp implementation data type element serviceName: type-reference=String
      cpp implementation data type element version: type-reference=String
      cpp implementation data type element lastUpdateTime: type-reference=uint64_t
    ControllerServiceStatus: compu {0x00=NORMAL, 0x01=ABNORMAL, 0x02=STATUS_3, 0x03=STATUS_4}, type-reference=uint8_t
      namespaces:
        symbol props eevp
        symbol props monitoring
        symbol props type
    ControllerServiceStatusError: compu {0x00=NO_ERROR, 0x01=INVALID}, type-reference=uint8_t
      namespaces:
        symbol props eevp
        symbol props monitoring
        symbol props type
    ControllerServiceStatusMap: category=ASSOCIATIVE_MAP, template-arguments=[String, ControllerServiceStatus]
      namespaces:
        symbol props eevp
        symbol props monitoring
        symbol props type
    ControllerServiceStatusSpare: category=STRUCTURE
      namespaces:
        symbol props eevp
        symbol props monitoring
        symbol props type
      4 x cpp implementation data type element, all with type-reference=String:
        serviceName
        serviceStatus
        serviceEnable
        serviceControl
    StringArray: category=ARRAY, array-size=16, cpp-template-argument=String
      namespaces:
        symbol props eevp
        symbol props monitoring
        symbol props type
    TimeArray: category=ARRAY, array-size=16, cpp-template-argument=uint64_t
      namespaces:
        symbol props eevp
        symbol props monitoring
        symbol props type
    UpdatableServiceList: category=STRUCTURE
      namespaces:
        symbol props eevp
        symbol props monitoring
        symbol props type
      cpp implementation data type element serviceName: type-reference=String
      cpp implementation data type element version: type-reference=String
      cpp implementation data type element actionType: type-reference=String
