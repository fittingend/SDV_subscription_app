AUTOSAR XML (schema 00049)
package /ServiceDeployment/Someip
  someip service interface deployment SubscriptionManagement: service-interface=SubscriptionManagement, service-interface-id=4887, service-interface-version={major-version=1, minor-version=0}
    someip event deployment notifySubscriptionEvent: event=notifySubscriptionEvent, event-id=11, transport-protocol=UDP
    someip method deployment registerSubscriptionApp: method=registerSubscriptionApp, method-id=1, transport-protocol=UDP
    someip event group Eventgroup_notifySubscriptionEvent: event-group-id=21, event=notifySubscriptionEvent
package /ServiceInstance/Endpoint
  someip service instance to machine mapping EEVP_SubscriptionManager_SomeipConsumers_OtaSubscription: communication-connector=eth0, service-instance=EEVP_SubscriptionManager_Consumer_OtaSubscription, tcp-port=55041, udp-port=55041
  someip service instance to machine mapping EEVP_SubscriptionManager_SomeipProviders_SubscriptionManagement: communication-connector=eth0, service-instance=EEVP_SubscriptionManager_Provider_SubscriptionManagement, tcp-port=50021, udp-port=50021
package /ServiceInstance/Someip/Consumer
  required someip service instance EEVP_SubscriptionManager_Consumer_OtaSubscription: service-interface-deployment=OtaSubscription, method-request-propss=[requestAppInstall, requestAppUpdate, requestVersionInfo, method=requestAppRollback], required-minor-version=ANY, required-service-instance-id=ANY, sd-client-config=DefaultSdClientConfig, version-driven-find-behavior=EXACT-OR-ANY-MINOR-VERSION
    someip required event group Eventgroup_notifyAppEvent: event-group=Eventgroup_notifyAppEvent, sd-client-event-group-timing-config=DefaultSdSubscribeConfig
    someip required event group Eventgroup_notifyUpdatableApp: event-group=Eventgroup_notifyUpdatableApp, sd-client-event-group-timing-config=DefaultSdSubscribeConfig
    someip required event group Eventgroup_verifySubScription: event-group=Eventgroup_verifySubScription, sd-client-event-group-timing-config=DefaultSdSubscribeConfig
package /ServiceInstance/Someip/Provider
  provided someip service instance EEVP_SubscriptionManager_Provider_SubscriptionManagement: service-interface-deployment=SubscriptionManagement, someip-event-props=notifySubscriptionEvent, someip-method-props=registerSubscriptionApp, sd-server-config=DefaultSdServerConfig, service-instance-id=1
    someip provided event group Eventgroup_notifySubscriptionEvent: event-group=Eventgroup_notifySubscriptionEvent, multicast-threshold=0
package /ServiceInterface
  service interface SubscriptionManagement
    namespaces:
      symbol props eevp
      symbol props subscription
      symbol props service
    events:
      data notifySubscriptionEvent: type=SubscriptionInfoMap
    methods:
      operation registerSubscriptionApp: fire-and-forget=false
        arg subscriptionAppName: type=String, direction=IN
        arg returnValue: type=bool, direction=OUT
