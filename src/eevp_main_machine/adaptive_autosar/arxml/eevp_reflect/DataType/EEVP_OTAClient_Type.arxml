AUTOSAR XML (schema 00049)
package /DataType/CppImplementationType
  8 x std cpp implementation data type:
    AppEventError: compu {0x00=SUCCESS, 0x01=INSTALL_FAIL, 0x02=UPDATE_FAIL}, type-reference=uint8_t
      namespaces:
        4 x symbol props:
          eevp
          ota
          monitoring
          type
    RequestAppInfo: category=STRUCTURE
      namespaces:
        4 x symbol props:
          eevp
          ota
          subscription
          type
      4 x cpp implementation data type element:
        appName: type-reference=String
        version: type-reference=String
        lastUpdateTime: type-reference=uint64_t
        actionType: type-reference=String
    RequestAppInfoMap: category=ASSOCIATIVE_MAP, template-arguments=[String, RequestAppInfo]
      namespaces:
        4 x symbol props:
          eevp
          ota
          subscription
          type
    RequestServiceInfo: category=STRUCTURE
      namespaces:
        4 x symbol props:
          eevp
          ota
          monitoring
          type
      4 x cpp implementation data type element:
        serviceName: type-reference=String
        version: type-reference=String
        lastUpdateTime: type-reference=uint64_t
        actionType: type-reference=String
    RequestServiceInfoMap: category=ASSOCIATIVE_MAP, template-arguments=[String, RequestServiceInfo]
      namespaces:
        4 x symbol props:
          eevp
          ota
          monitoring
          type
    ServiceEventError: compu {0x00=SUCCESS, 0x01=INSTALL_FAIL, 0x02=UPDATE_FAIL}, type-reference=uint8_t
      namespaces:
        4 x symbol props:
          eevp
          ota
          monitoring
          type
    UpdatableAppInfo: category=STRUCTURE
      namespaces:
        4 x symbol props:
          eevp
          ota
          subscription
          type
      cpp implementation data type element appName: type-reference=String
      cpp implementation data type element version: type-reference=String
      cpp implementation data type element actionType: type-reference=String
    UpdatableServiceInfo: category=STRUCTURE
      namespaces:
        4 x symbol props:
          eevp
          ota
          monitoring
          type
      cpp implementation data type element serviceName: type-reference=String
      cpp implementation data type element version: type-reference=String
      cpp implementation data type element actionType: type-reference=String
