AUTOSAR XML (schema 00049)
package /DataType/CppImplementationType
  std cpp implementation data type SubscriptionInfo: category=STRUCTURE
    namespaces:
      symbol props eevp
      symbol props subscription
      symbol props type
    cpp implementation data type element subscriptionAppName: type-reference=String
    cpp implementation data type element version: type-reference=String
    cpp implementation data type element isSubscription: type-reference=bool
  std cpp implementation data type SubscriptionInfoMap: category=ASSOCIATIVE_MAP, template-arguments=[String, SubscriptionInfo]
    namespaces:
      symbol props eevp
      symbol props subscription
      symbol props type
