AUTOSAR XML (schema 00049)
package /ServiceInstance/Someip/Consumer
  required someip service instance EEVP_KATECH_Consumer_SoaRoa: service-interface-deployment=SoaRoa, required-minor-version=ANY, sd-client-config=DefaultClientConfig, version-driven-find-behavior=EXACT-OR-ANY-MINOR-VERSION
    method-request-propss:
      Get_soaRoaDetectCount
      Get_soaRoaDetectState
      Get_soaRoaDeviceNormal
      Get_soaRoaMode
      Get_soaRoaRunningState
      Get_soaRoaSensorError
      ResetRoaDetectInfo
      SetRoaMode
      StartRoa
      StopRoa
    someip required event group Eventgroup3_Notification_soaRoaDetectState: event-group=Eventgroup3_Notification_soaRoaDetectState, sd-client-event-group-timing-config=DefaultSdSubscribeConfig
    someip required event group Eventgroup_Notification_soaRoaDetectCount: event-group=Eventgroup_Notification_soaRoaDetectCount, sd-client-event-group-timing-config=DefaultSdSubscribeConfig
