AUTOSAR XML (schema 00049)
package /DataType/CppImplementationType
  32 x std cpp implementation data type:
    AppVer: category=ARRAY, array-size=6, cpp-template-argument=uint8_t
      namespaces:
        symbol props eevp
        symbol props simulation
    BCM_ReturnCode: compu {0=SUCCESS, 1=FAIL_WORKING_CONDITION_UNFULFILLED, 2=FAIL_HIGHER_PRIORITY_TASK_ONGOING, 3=FAIL_FUNCTION_UNAVAILABLE, 4=FAIL_INVALID_SOURCE_ID, 5=FAIL_DEVICE_ABNORMAL, 6=FAIL_POWER_SHORTAGE, 7=FAIL_TIMEOUT, 8=FAIL_OVERHEATING, 9=FAIL_OUT_OF_RANGE, 10=FAIL_ANTIPLAY, 11=FAIL_DRAG, 12=FAIL_OVERCURRENT, 13=FAIL_NOTLEARNED, 255=FAIL_OTHERS}, type-reference=uint8_t
      namespaces:
        symbol props eevp
        symbol props simulation
    BCM_WipingLevel: compu {0=LOW, 1=MEDIUM, 2=HIGH, 3=STOP}, type-reference=uint8_t
      namespaces:
        symbol props eevp
        symbol props simulation
    BrakePedalRecv: category=STRUCTURE
      namespaces:
        symbol props eevp
        symbol props service
        symbol props type
      cpp implementation data type element brakePosn: type-reference=VCS_BrakePosn
      cpp implementation data type element brakeSwitch: type-reference=VCS_BrakeSwitch
    BrakePedalSend: category=STRUCTURE
      namespaces:
        symbol props eevp
        symbol props service
        symbol props type
      cpp implementation data type element brakePosn: type-reference=VCS_BrakePosn
      cpp implementation data type element brakeSwitch: type-reference=VCS_BrakeSwitch
    Brightness: compu {0x9=START, 0x0=END}, type-reference=uint16_t
      namespaces:
        symbol props eevp
        symbol props simulation
    ColorIndex: compu {1=RED, 3=BLUE}, type-reference=uint8_t
      namespaces:
        symbol props eevp
        symbol props simulation
    CompleteTime: category=ARRAY, array-size=2, cpp-template-argument=uint8_t
      namespaces:
        symbol props eevp
        symbol props simulation
    Ctrl_ReturnCode: compu {0=SUCCESS, 1=FAILURE}, type-reference=uint8_t
      namespaces:
        symbol props eevp
        symbol props simulation
    DMS_ReturnCode: compu {0=SUCCESS, 1=FAILURE}, type-reference=uint8_t
      namespaces:
        symbol props eevp
        symbol props simulation
    Date: category=ARRAY, array-size=8, cpp-template-argument=uint8_t
      namespaces:
        symbol props eevp
        symbol props simulation
    DirectionVeh: compu {0x00=FORWARD, 0x01=BACKWARD, 0x02=UNKNOWN}, type-reference=uint8_t
      namespaces:
        symbol props eevp
        symbol props simulation
    DmsStatus: compu {0=UNACTIVATED, 1=ACTIVATED}, type-reference=uint8_t
      namespaces:
        symbol props eevp
        symbol props simulation
    ElapsedTime: category=ARRAY, array-size=2, cpp-template-argument=uint8_t
      namespaces:
        symbol props eevp
        symbol props simulation
    FDM_EmotionType: compu {0=EMOTION_NORMAL, 1=EMOTION_ANGRY, 2=EMOTION_HAPPY, 3=EMOTION_SAD, 4=EMOTION_DROWSY}, type-reference=uint8_t
      namespaces:
        symbol props eevp
        symbol props simulation
    FDM_ReturnCode: compu {0=SUCCESS, 1=FAILURE}, type-reference=uint8_t
      namespaces:
        symbol props eevp
        symbol props simulation
    FinishedTime: category=ARRAY, array-size=7, cpp-template-argument=uint8_t
      namespaces:
        symbol props eevp
        symbol props simulation
    GearStatus: compu {0x00=DEFAULT, 0x01=P, 0x02=R, 0x03=N, 0x04=D}, type-reference=uint8_t
      namespaces:
        symbol props eevp
        symbol props simulation
    KickdownStatus: compu {0x00=UNACTIVATED, 0x01=ACTIVATED}, type-reference=uint8_t
      namespaces:
        symbol props eevp
        symbol props simulation
    MAXdata: category=ARRAY, array-size=2, cpp-template-argument=uint8_t
      namespaces:
        symbol props eevp
        symbol props simulation
    MINdata: category=ARRAY, array-size=2, cpp-template-argument=uint8_t
      namespaces:
        symbol props eevp
        symbol props simulation
    RCdata: category=ARRAY, array-size=20, cpp-template-argument=uint8_t
      namespaces:
        symbol props eevp
        symbol props simulation
    SmartFilmStatus: compu {0=UNACTIVATED, 1=ACTIVATED}, type-reference=uint8_t
      namespaces:
        symbol props eevp
        symbol props simulation
    SoaMlmStatus: category=STRUCTURE
      namespaces:
        symbol props eevp
        symbol props simulation
      cpp implementation data type element colorTableIndex: type-reference=uint8_t
      cpp implementation data type element brightMode: type-reference=uint8_t
      cpp implementation data type element SoaDeviceIsNormal: type-reference=int8_t
    SwitchStatus: compu {0x00=UNPRESSED, 0x01=PRESSED}, type-reference=uint8_t
      namespaces:
        symbol props eevp
        symbol props simulation
    TMS_EnvZone: compu {0=INTERIOR_ZONE, 1=EXTERIOR_ZONE}, type-reference=uint8_t
      namespaces:
        symbol props eevp
        symbol props simulation
    TMS_EnvZoneHumidityAry: category=ARRAY, array-size=2, cpp-template-argument=TMS_EnvZoneHumiditySt
      namespaces:
        symbol props eevp
        symbol props simulation
    TMS_EnvZoneHumiditySt: category=STRUCTURE
      namespaces:
        symbol props eevp
        symbol props simulation
      cpp implementation data type element zoneId: type-reference=TMS_EnvZone
      cpp implementation data type element humidity: type-reference=uint8_t
    TMS_EnvZoneLightIntensityAry: category=ARRAY, array-size=2, cpp-template-argument=TMS_EnvZoneLightIntensitySt
      namespaces:
        symbol props eevp
        symbol props simulation
    TMS_EnvZoneLightIntensitySt: category=STRUCTURE
      namespaces:
        symbol props eevp
        symbol props simulation
      cpp implementation data type element zoneId: type-reference=TMS_EnvZone
      cpp implementation data type element lightIntensity: type-reference=uint16_t
    TMS_EnvZoneTempAry: category=ARRAY, array-size=2, cpp-template-argument=TMS_EnvZoneTempSt
      namespaces:
        symbol props eevp
        symbol props simulation
    TMS_EnvZoneTempSt: category=STRUCTURE
      namespaces:
        symbol props eevp
        symbol props simulation
      cpp implementation data type element ZoneId: type-reference=TMS_EnvZone
      cpp implementation data type element temp: type-reference=int16_t
  compu method TMS_FragranceType: 0=GULONG, 1=OCEAN, 2=APPLE, 3=LEMON, 4=ROSE
  compu method TMS_ReturnCode: 0=SUCCESS, 1=FAILURE
  22 x std cpp implementation data type:
    T_MSGINFO: category=STRUCTURE
      namespaces:
        symbol props eevp
        symbol props simulation
      8 x cpp implementation data type element:
        tRslt: type-reference=uint8_t
        XaxisScale: type-reference=uint8_t
        YaxisValidCnt: type-reference=uint8_t
        Ydata: type-reference=Ydata
        RCValidCnt: type-reference=uint8_t
        RCdata: type-reference=RCdata
        MAXdata: type-reference=MAXdata
        MINdata: type-reference=MINdata
    USSSonarInfo: category=STRUCTURE
      namespaces:
        symbol props eevp
        symbol props simulation
      8 x cpp implementation data type element:
        pasSonarEchoTof1: type-reference=uint16_t
        pasSonarEchoWidth1: type-reference=uint16_t
        pasSonarEchoPeak1: type-reference=uint16_t
        pasSonarEchoTof2: type-reference=uint16_t
        pasSonarEchoWidth2: type-reference=uint16_t
        pasSonarEchoPeak2: type-reference=uint16_t
        pasSonarEmit: type-reference=uint8_t
        sonarRingingTimer: type-reference=uint16_t
    VCS_Acceleration: category=STRUCTURE
      namespaces:
        symbol props eevp
        symbol props simulation
      cpp implementation data type element value: type-reference=int16_t
      cpp implementation data type element valid: type-reference=bool
    VCS_AccrPedal: category=STRUCTURE
      namespaces:
        symbol props eevp
        symbol props simulation
      6 x cpp implementation data type element:
        valid: type-reference=bool
        switchStatus: type-reference=SwitchStatus
        position: type-reference=uint16_t
        kickdownStatus: type-reference=KickdownStatus
        faultStatus: type-reference=uint8_t
        positionRate: type-reference=int32_t
    VCS_BrakePosn: category=STRUCTURE
      namespaces:
        symbol props eevp
        symbol props simulation
      6 x cpp implementation data type element:
        stroke: type-reference=int16_t
        strokeValid: type-reference=bool
        position: type-reference=int16_t
        positionValid: type-reference=bool
        strokeRate: type-reference=int16_t
        strokeRateValid: type-reference=bool
    VCS_BrakeSwitch: category=STRUCTURE
      namespaces:
        symbol props eevp
        symbol props simulation
      cpp implementation data type element switchStatus: type-reference=SwitchStatus
      cpp implementation data type element switchValid: type-reference=bool
    VCS_Gear: category=STRUCTURE
      namespaces:
        symbol props eevp
        symbol props simulation
      cpp implementation data type element GearStatus: type-reference=GearStatus
      cpp implementation data type element valid: type-reference=bool
    VCS_LgtBrkFTotal: category=STRUCTURE
      namespaces:
        symbol props eevp
        symbol props simulation
      cpp implementation data type element value: type-reference=uint32_t
      cpp implementation data type element valid: type-reference=bool
    VCS_MCPrs: category=STRUCTURE
      namespaces:
        symbol props eevp
        symbol props simulation
      cpp implementation data type element value: type-reference=int16_t
      cpp implementation data type element valid: type-reference=bool
    VCS_Slope: category=STRUCTURE
      namespaces:
        symbol props eevp
        symbol props simulation
      cpp implementation data type element staticValue: type-reference=uint16_t
      cpp implementation data type element staticValid: type-reference=bool
    VCS_TqCtrl: category=STRUCTURE
      namespaces:
        symbol props eevp
        symbol props simulation
      cpp implementation data type element value: type-reference=int32_t
      cpp implementation data type element valid: type-reference=bool
    VCS_VehSpd: category=STRUCTURE
      namespaces:
        symbol props eevp
        symbol props simulation
      5 x cpp implementation data type element:
        absoluteValue: type-reference=int32_t
        actualValue: type-reference=int32_t
        direction: type-reference=DirectionVeh
        directionValid: type-reference=bool
        valid: type-reference=bool
    Ydata: category=ARRAY, array-size=100, cpp-template-argument=uint8_t
      namespaces:
        symbol props eevp
        symbol props simulation
    brightness: category=ARRAY, array-size=15, cpp-template-argument=uint8_t
      namespaces:
        symbol props eevp
        symbol props simulation
    color: category=ARRAY, array-size=15, cpp-template-argument=uint32_t
      namespaces:
        symbol props eevp
        symbol props simulation
    dataRecv: category=STRING
      namespaces:
        symbol props eevp
        symbol props service
        symbol props type
    dataSend: category=STRING
      namespaces:
        symbol props eevp
        symbol props service
        symbol props type
    ems_BmsInfo: category=STRUCTURE
      namespaces:
        symbol props eevp
        symbol props simulation
      26 x cpp implementation data type element, all with type-reference=uint32_t:
        InterfaceIDforDbg
        DataSerialNumber
        VehicleuniqueSnr
        EMS_BatteryAvgTemperature
        EMS_ChargerOutputVolt
        EMS_ChargerOutputCurr
        EMS_ReturnCode
        EMS_ConnectionStatus
        EMS_TargetVolt
        EMS_TargetCurr
        EMS_RemainHour
        EMS_RemainMin
        EMS_HVBattSOC
        EMS_HVBattSOE
        EMS_HVBattSOH
        EMS_BattVolt
        EMS_BattCurr
        EMS_Obc_dcVolt
        EMS_Obc_dcCurr
        EMS_Anv_ChargeCurrSetSts
        EMS_HvBatt_MainRlyCloseReq
        EMS_HvBatt_preChrgRlyStatus
        EMS_HvBatt_posRlyStatus
        EMS_HvBatt_negRlyStatus
        EMS_Avn_DcChargingTartgetSetSts
        EMS_Avn_AcChargingTartgetSetSts
    ems_MsgInfo: category=STRUCTURE
      namespaces:
        symbol props eevp
        symbol props simulation
      25 x cpp implementation data type element:
        InterfaceIDforDbg: type-reference=uint32_t
        VehicleUniqueSnr: type-reference=uint32_t
        AppVer: type-reference=AppVer
        ChargeStatus: type-reference=uint8_t
        EMS_ConnectionStatus: type-reference=uint8_t
        Date: type-reference=Date
        BattSOC: type-reference=uint16_t
        DTE: type-reference=uint16_t
        BatteryStatus: type-reference=uint16_t
        SOH: type-reference=uint16_t
        SOE: type-reference=uint16_t
        TargetSOC: type-reference=uint8_t
        CompleteTime: type-reference=CompleteTime
        FinishedTime: type-reference=FinishedTime
        GetCount: type-reference=uint32_t
        MissedCount: type-reference=uint32_t
        ChargeResult: type-reference=uint16_t
        ChargedSOE: type-reference=uint16_t
        ChargedSOC: type-reference=uint16_t
        Current: type-reference=T_MSGINFO
        Voltage: type-reference=T_MSGINFO
        SOC: type-reference=T_MSGINFO
        Temp: type-reference=T_MSGINFO
        ElapsedTime: type-reference=ElapsedTime
        ChargeStopReason: type-reference=uint32_t
    lampStatus: category=ARRAY, array-size=15, cpp-template-argument=bool
      namespaces:
        symbol props eevp
        symbol props simulation
    wiperRecv: category=STRUCTURE
      namespaces:
        symbol props eevp
        symbol props service
        symbol props type
      cpp implementation data type element wipingLevel: type-reference=BCM_WipingLevel
      cpp implementation data type element wipingInterval: type-reference=uint16_t
    wiperSend: category=STRUCTURE
      namespaces:
        symbol props eevp
        symbol props service
        symbol props type
      cpp implementation data type element wipingLevel: type-reference=BCM_WipingLevel
      cpp implementation data type element wipingInterval: type-reference=uint16_t
package /DataType/Semantics
  compu method TMS_AirMode: 0=FACE, 1=FACE_FOOT, 2=FOOT, 3=FOOT_DEFROST, 4=DEFROST, 5=FACE_DEFROST, 6=FACE_FOOT_WINDOW
  compu method TMS_CyclingMode: 0=INTERIOR_CYCLE, 1=EXTERIOR_CYCLE, 2=AUTO_CYCLE
  compu method TMS_ParticleDetectMode: 0=SILENT_MODE, 1=NORMAL_MODE
