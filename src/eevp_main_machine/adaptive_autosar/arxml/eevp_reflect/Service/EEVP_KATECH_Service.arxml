AUTOSAR XML (schema 00049)
package /ServiceInstance/Endpoint
  someip service instance to machine mapping EEVP_KATECH_SomeipConsumers_RearCurtain: communication-connector=eth0, service-instance=EEVP_KATECH_Consumer_RearCurtain, tcp-port=50092, udp-port=50092
  someip service instance to machine mapping EEVP_KATECH_SomeipConsumers_Roa: communication-connector=eth0, service-instance=EEVP_KATECH_Consumer_SoaRoa, tcp-port=55090, udp-port=55090
  someip service instance to machine mapping EEVP_KATECH_SomeipConsumers_Wiper: communication-connector=eth0, service-instance=EEVP_KATECH_Consumer_Wiper, tcp-port=50093, udp-port=50093
package /ServiceInstance/Someip/Consumer
  required someip service instance EEVP_KATECH_Consumer_RearCurtain: service-interface-deployment=SoaRcurtain, method-request-propss=[method=Get_soaRctnStatus, RequestRearCurtainOperation, method=RequestRearCurtainPosition], required-minor-version=ANY, required-service-instance-id=ANY, sd-client-config=DefaultClientConfig, version-driven-find-behavior=EXACT-OR-ANY-MINOR-VERSION
    someip required event group Eventgroup_Notification_soaRctnStatus: event-group=Eventgroup_Notification_soaRctnStatus, sd-client-event-group-timing-config=DefaultSdSubscribeConfig
  required someip service instance EEVP_KATECH_Consumer_SoaRoa: service-interface-deployment=SoaRoa, required-minor-version=ANY, required-service-instance-id=ANY, sd-client-config=DefaultClientConfig, version-driven-find-behavior=EXACT-OR-ANY-MINOR-VERSION
    method-request-propss:
      Get_soaRoaDetectCount
      Get_soaRoaDetectState
      Get_soaRoaDeviceNormal
      Get_soaRoaMode
      Get_soaRoaRunningState
      Get_soaRoaSensorError
      ResetRoaDetectInfo
      SetRoaMode
      StartRoa
      StopRoa
    someip required event group Eventgroup3_Notification_soaRoaDetectState: event-group=Eventgroup3_Notification_soaRoaDetectState, sd-client-event-group-timing-config=DefaultSdSubscribeConfig
    someip required event group Eventgroup_Notification_soaRoaDetectCount: event-group=Eventgroup_Notification_soaRoaDetectCount, sd-client-event-group-timing-config=DefaultSdSubscribeConfig
  required someip service instance EEVP_KATECH_Consumer_Wiper: service-interface-deployment=BCM_WiperWash, required-minor-version=ANY, required-service-instance-id=ANY, sd-client-config=DefaultClientConfig, version-driven-find-behavior=EXACT-OR-ANY-MINOR-VERSION
    method-request-propss:
      Get_wiperInterval
      Get_wiperLevel
      getWipingInterval
      getWipingLevel
      isWiping
      setWipingInterval
      setWipingLevel
      setWipingLevelImme
      startWiping
      stopWiping
    someip required event group Eventgroup_Notification_wiperInterval: event-group=Eventgroup_Notification_wiperInterval, sd-client-event-group-timing-config=DefaultSdSubscribeConfig
    someip required event group Eventgroup_Notification_wiperLevel: event-group=Eventgroup_Notification_wiperLevel, sd-client-event-group-timing-config=DefaultSdSubscribeConfig
package /ServiceInstance/Someip/Provider
  provided someip service instance EEVP_ServiceCreator_Provider_BCM_WiperWash: service-interface-deployment=BCM_WiperWash, event-propss=[Notification_wiperInterval, Notification_wiperLevel], sd-server-config=DefaultSdServerConfig, service-instance-id=9009
    method-response-propss:
      Get_wiperInterval
      Get_wiperLevel
      getWipingInterval
      getWipingLevel
      isWiping
      setWipingInterval
      setWipingLevel
      setWipingLevelImme
      startWiping
      stopWiping
    someip provided event group Eventgroup_Notification_wiperInterval: event-group=Eventgroup_Notification_wiperInterval, multicast-threshold=0, sd-server-event-group-timing-config=DefaultSdPublishConfig
    someip provided event group Eventgroup_Notification_wiperLevel: event-group=Eventgroup_Notification_wiperLevel, multicast-threshold=0, sd-server-event-group-timing-config=DefaultSdPublishConfig
