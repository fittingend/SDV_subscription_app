AUTOSAR XML (schema 00049)
package /DataType/CppImplementationType
  28 x std cpp implementation data type:
    SoaDeviceIsNormal: compu {0=kNORMAL, 1=kABNORMAL}, type-reference=uint8_t
      namespaces:
        symbol props eevp
        symbol props control
    SoaErrorState: compu {0=kOK, 1=kERROR}, type-reference=uint8_t
      namespaces:
        symbol props eevp
        symbol props control
    SoaMlmMoodMode: compu {1=kCARE_MOOD, 2=kCOMPORT_MOOD, 3=kDELIGHT_MOOD, 4=kMOOD_THERAPHY, 5=kVITALITY_MOOD}, type-reference=uint8_t
      namespaces:
        symbol props eevp
        symbol props control
    SoaMlmStatus: category=STRUCTURE
      namespaces:
        symbol props eevp
        symbol props control
      4 x cpp implementation data type element:
        colorTableIndex: type-reference=uint8_t
        moodMode: type-reference=SoaMlmMoodMode
        brightness: type-reference=uint16_t
        isNormal: type-reference=SoaDeviceIsNormal
    SoaPowerState: compu {1=kON, 2=kOFF, 3=kERROR}, type-reference=uint8_t
      namespaces:
        symbol props eevp
        symbol props control
    SoaPwrZone1Curr: category=STRUCTURE
      namespaces:
        symbol props eevp
        symbol props control
      cpp implementation data type element mlmCurrentValue: type-reference=uint16_t
      cpp implementation data type element drvseatCurrentValue: type-reference=uint16_t
      cpp implementation data type element mfswCurrentValue: type-reference=uint16_t
    SoaPwrZone1Power: category=STRUCTURE
      namespaces:
        symbol props eevp
        symbol props control
      cpp implementation data type element mlmPowerState: type-reference=SoaPowerState
      cpp implementation data type element drvseatPowerState: type-reference=SoaPowerState
      cpp implementation data type element mfswPowerState: type-reference=SoaPowerState
    SoaPwrZone2Curr: category=STRUCTURE
      namespaces:
        symbol props eevp
        symbol props control
      cpp implementation data type element roaCurrentValue: type-reference=uint16_t
      cpp implementation data type element rainSnsrCurrentValue: type-reference=uint16_t
    SoaPwrZone2Power: category=STRUCTURE
      namespaces:
        symbol props eevp
        symbol props control
      cpp implementation data type element roaPowerState: type-reference=SoaPowerState
      cpp implementation data type element rainSnsrPowerState: type-reference=SoaPowerState
    SoaPwrZone3Curr: category=STRUCTURE
      namespaces:
        symbol props eevp
        symbol props control
      cpp implementation data type element rcurtCurrentValue: type-reference=uint16_t
      cpp implementation data type element rpdwCurrentValue: type-reference=uint16_t
    SoaPwrZone3Power: category=STRUCTURE
      namespaces:
        symbol props eevp
        symbol props control
      cpp implementation data type element rcurtPowerState: type-reference=SoaPowerState
      cpp implementation data type element rpdwPowerState: type-reference=SoaPowerState
    SoaPwrZone4Curr: category=STRUCTURE
      namespaces:
        symbol props eevp
        symbol props control
      cpp implementation data type element wiperCurrentValue: type-reference=uint16_t
      cpp implementation data type element fpdwCurrentValue: type-reference=uint16_t
    SoaPwrZone4Power: category=STRUCTURE
      namespaces:
        symbol props eevp
        symbol props control
      cpp implementation data type element wiperPowerState: type-reference=SoaPowerState
      cpp implementation data type element fpdwPowerState: type-reference=SoaPowerState
    SoaRctnMotorDir: compu {1=kSTOP, 2=kUP, 3=kDOWN}, type-reference=uint8_t
      namespaces:
        symbol props eevp
        symbol props control
    SoaRctnState: compu {1=kFULLY_UP, 2=kFULLY_DOWN, 3=kPARTLY_OPENED, 4=kMOVING_UP, 5=kMOVING_DOWN}, type-reference=uint8_t
      namespaces:
        symbol props eevp
        symbol props control
    SoaRctnStatus: category=STRUCTURE
      namespaces:
        symbol props eevp
        symbol props control
      4 x cpp implementation data type element:
        errorState: type-reference=SoaErrorState
        curMotorDirection: type-reference=SoaRctnMotorDir
        curtainState: type-reference=SoaRctnState
        isNormal: type-reference=SoaDeviceIsNormal
    SoaRoaDetectState: compu {0=kEMPTY, 1=kDETECTED_ONCE, 2=kDETECTED_SEVERAL, 3=kUNKNOWN}, type-reference=uint8_t
      namespaces:
        symbol props eevp
        symbol props control
    SoaRoaMode: compu {0=kOFF, 1=kNORMAL, 2=kADVANCED}, type-reference=uint8_t
      namespaces:
        symbol props eevp
        symbol props control
    SoaRoaRunningState: compu {0=kOFF, 1=kON, 2=kUNKNOWN}, type-reference=uint8_t
      namespaces:
        symbol props eevp
        symbol props control
    SoaRoaSensorError: compu {0=kOK, 1=kERR_SNSR, 2=kERR_BLCKGE}, type-reference=uint8_t
      namespaces:
        symbol props eevp
        symbol props control
    SoaSeatHeightDirection: compu {0=kSTOP, 1=kUP, 2=kDOWN}, type-reference=uint8_t
      namespaces:
        symbol props eevp
        symbol props control
    SoaSeatMotorDirection: category=STRUCTURE
      namespaces:
        symbol props eevp
        symbol props control
      4 x cpp implementation data type element:
        slide: type-reference=SoaSeatSlideDirection
        recline: type-reference=SoaSeatReclineDirection
        height: type-reference=SoaSeatHeightDirection
        tilt: type-reference=SoaSeatTiltDirection
    SoaSeatMotorPosition: category=STRUCTURE
      namespaces:
        symbol props eevp
        symbol props control
      4 x cpp implementation data type element, all with type-reference=uint8_t:
        slidePosition
        reclinePosition
        heightPosition
        tiltPosition
    SoaSeatReclineDirection: compu {0=kSTOP, 1=kFORWARD, 2=kBACKWARD}, type-reference=uint8_t
      namespaces:
        symbol props eevp
        symbol props control
    SoaSeatSlideDirection: compu {0=kSTOP, 1=kFORWARD, 2=kBACKWARD}, type-reference=uint8_t
      namespaces:
        symbol props eevp
        symbol props control
    SoaSeatTiltDirection: compu {0=kSTOP, 1=kUP, 2=kDOWN}, type-reference=uint8_t
      namespaces:
        symbol props eevp
        symbol props control
    SoaWiperMode: compu {0=kOFF, 1=kMIST, 2=kLOW, 3=kHIGH, 4..8=kINT1..kINT5}, type-reference=uint8_t
      namespaces:
        symbol props eevp
        symbol props control
    SoaWiperStatus: category=STRUCTURE
      namespaces:
        symbol props eevp
        symbol props control
      cpp implementation data type element isAutoMode: type-reference=bool
      cpp implementation data type element mode: type-reference=SoaWiperMode
